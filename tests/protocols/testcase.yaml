## tests/protocols/testcase.yaml
```yaml
tests:
  skywalker.protocols.contracts:
    platform_allow: [native_sim/native/64]
    tags: [communication, dr16, referee, interboard, protocol]
    extra_args: CONFIG_SKYWALKER_REFEREE_RM2027=y
    harness: ztest

  skywalker.protocols.contracts_rm2026:
    platform_allow: [native_sim/native/64]
    tags: [communication, dr16, referee, interboard, protocol]
    extra_args: CONFIG_SKYWALKER_REFEREE_RM2026=y
    harness: ztest
```

## tests/robotics_contracts/testcase.yaml
```yaml
tests:
  skywalker.robotics_contracts.unit:
    platform_allow: [native_sim/native/64]
    tags: [robotics, yaw, safety, lifecycle]
    harness: ztest
```

## tests/sentry_control/testcase.yaml
```yaml
tests:
  skywalker.sentry_control:
    platform_allow: native_sim/native/64
    tags: robotics motor swerve
    integration_platforms:
      - native_sim/native/64
```

## tests/vision_imu/testcase.yaml
```yaml
tests:
  skywalker.vision_imu.flow:
    platform_allow: [native_sim/native/64]
    tags: [imu, vision]
```

## west.yml
```yaml
manifest:
  self:
    path: skywalker_code

  remotes:
    - name: zephyrproject-rtos
      url-base: https://www.github.com/zephyrproject-rtos

  projects:
    - name: zephyr
      remote: zephyrproject-rtos
      revision: 6085aadeb337f27ee7411fa2ecbe8cf49164e360
      import:
        name-allowlist:
          - cmsis
          - cmsis_6
          - cmsis-dsp
          - hal_st
          - hal_stm32
          - mcuboot
          - segger
```
