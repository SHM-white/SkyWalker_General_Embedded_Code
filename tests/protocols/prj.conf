## CMakeLists.txt
```
cmake_minimum_required(VERSION 3.20.0)
find_package(Zephyr REQUIRED HINTS $ENV{ZEPHYR_BASE})
project(protocol_contracts LANGUAGES C CXX)
target_sources(app PRIVATE src/remote.cpp src/referee.cpp src/interboard.cpp src/wire.cpp)
```

## prj.conf
```kconfig
CONFIG_ZTEST=y
CONFIG_CPP=y
CONFIG_STD_CPP20=y
CONFIG_REQUIRES_FULL_LIBCPP=y
CONFIG_MAIN_STACK_SIZE=8192
CONFIG_TEST_EXTRA_STACK_SIZE=8192
CONFIG_ASSERT=y
CONFIG_SKYWALKER_LIB_COMMUNICATION=y
CONFIG_SKYWALKER_REMOTE_DR16=y
CONFIG_SKYWALKER_REFEREE=y
CONFIG_SKYWALKER_INTERBOARD=y
CONFIG_SKYWALKER_INTERBOARD_ENDPOINT=n
```

## src/interboard.cpp
```c
#include <array>
#include <cerrno>
#include <cstdint>
#include <communication/interboard/interboard_codec.hpp>
#include <communication/interboard/interboard_link.hpp>
#include <communication/interboard/interboard_parser.hpp>
#include <communication/wire.hpp>
#include <zephyr/ztest.h>

namespace {
using namespace skywalker;
using namespace skywalker::communication;
using namespace skywalker::robotics;
std::array<std::uint8_t, kMaxFrame> bytes{};
int heartbeat(std::uint32_t seq = 1, std::uint64_t boot = 123) {
    BoardHeartbeat hb{};
    hb.role = BoardRole::GimbalController;
    hb.sender_boot_id = boot;
    hb.safety_state = SafetyState::Ready;
    hb.ready = true;
    hb.sender_uptime_ms = 99;
    return InterBoardCodec::encodeHeartbeat(hb, seq, bytes.data(), bytes.size());
}
}
ZTEST(protocol_interboard, test_fragmented_heartbeat_frame_has_exact_metadata_and_payload) {
    using namespace skywalker::communication;
    InterBoardParser parser;
    const int n = heartbeat(77);
    zassert_equal(n, 34);
    zassert_equal(bytes[0], 0xa5);
    zassert_equal(bytes[1], 0x5a);
    zassert_equal(bytes[2], kInterBoardProtocolVersion);
    zassert_ok(parser.consume(bytes.data(), 11, 50));
    FrameMeta meta{};
    std::uint8_t payload[kMaxPayload]{};
    std::size_t size = 0;
    zassert_false(parser.popFrame(meta, payload, sizeof(payload), size));
    zassert_ok(parser.consume(bytes.data() + 11, n - 11, 51));
    zassert_true(parser.popFrame(meta, payload, sizeof(payload), size));
    zassert_equal(size, 20u);
    zassert_equal(meta.frame_sequence, 77u);
    zassert_equal(meta.local_receive_ms, 51u);
    zassert_equal(meta.message_id, MessageId::Heartbeat);
    robotics::BoardHeartbeat decoded{};
    zassert_ok(InterBoardCodec::decodeHeartbeat(meta, payload, size, decoded));
    zassert_equal(decoded.sender_boot_id, 123u);
    zassert_true(decoded.ready);
    zassert_equal(decoded.stamp.timestamp_ms, 51u);
    zassert_false(parser.popFrame(meta, payload, sizeof(payload), size));
}

ZTEST(protocol_interboard, test_crc_version_and_length_recovery) {
    using namespace skywalker::communication;
    InterBoardParser parser;
    const int n = heartbeat();
    auto bad = bytes;
    bad[n - 1] ^= 0x20;
    zassert_ok(parser.consume(bad.data(), n, 10));
    zassert_true(parser.stats().crc_errors > 0);
    bad = bytes;
    bad[2]++;
    zassert_ok(parser.consume(bad.data(), n, 11));
    zassert_true(parser.stats().version_errors > 0);
    bad = bytes;
    wire::storeLe16(bad.data() + 6, kMaxPayload + 1);
    zassert_ok(parser.consume(bad.data(), n, 12));
    zassert_true(parser.stats().length_errors > 0);
    zassert_ok(parser.consume(bytes.data(), n, 20));
    FrameMeta meta{};
    std::uint8_t payload[kMaxPayload]{};
    std::size_t size = 0;
    zassert_true(parser.popFrame(meta, payload, sizeof(payload), size));
    zassert_equal(parser.stats().valid_frames, 1u);
}

ZTEST(protocol_interboard, test_queue_overflow_discards_oldest_and_reset_restarts_counters) {
    using namespace skywalker::communication;
    InterBoardParser parser;
    for (unsigned i = 1; i <= 6; ++i) {
        const int n = heartbeat(i);
        zassert_ok(parser.consume(bytes.data(), n, i));
    }
    zassert_equal(parser.stats().queue_overflows, 2u);
    FrameMeta meta{};
    std::uint8_t payload[kMaxPayload]{};
    std::size_t size = 0;
    for (unsigned i = 3; i <= 6; ++i) {
        zassert_true(parser.popFrame(meta, payload, sizeof(payload), size));
        zassert_equal(meta.frame_sequence, i);
    }
    zassert_false(parser.popFrame(meta, payload, sizeof(payload), size));
    zassert_ok(parser.reset());
    zassert_equal(parser.stats().queue_overflows, 0u);
    zassert_equal(parser.stats().valid_frames, 0u);
}

ZTEST(protocol_interboard, test_link_rejects_control_without_session_and_replay) {
    using namespace skywalker;
    using namespace skywalker::communication;
    using namespace skywalker::robotics;
    InterBoardLink link(BoardRole::ChassisController);
    RemoteChassisControl control{};
    control.command.stamp = {10, 8, true};
    control.command.mode = ChassisMode::BodyVelocity;
    control.command.vx_m_s = 1.25f;
    control.global_action = SafetyAction::Active;
    control.receiver_boot_id = 77;
    std::array<std::uint8_t, kMaxFrame> control_frame{};
    const int csize = InterBoardCodec::encodeChassisControl(control, 2, control_frame.data(), control_frame.size());
    zassert_true(csize > 0);
    zassert_ok(link.processRxBytes(control_frame.data(), csize, 10));
    zassert_equal(link.rejectedFrames(), 1u);
    zassert_false(link.peerOnline(10));
    const int hsize = heartbeat(1);
    zassert_ok(link.processRxBytes(bytes.data(), hsize, 11));
    zassert_true(link.peerOnline(11, 100));
    zassert_ok(link.processRxBytes(control_frame.data(), csize, 12));
    RemoteChassisControl observed{};
    zassert_ok(link.latestChassisControl(observed));
    zassert_within(observed.command.vx_m_s, 1.25f, 0.000001f);
    zassert_equal(observed.command.stamp.sequence, 8u);
    zassert_ok(link.processRxBytes(control_frame.data(), csize, 13));
    zassert_equal(link.rejectedFrames(), 2u);
    zassert_equal(observed.stamp.timestamp_ms, 12u);
    zassert_false(link.peerOnline(112, 100));
    const int reboot = heartbeat(2, 456);
    zassert_ok(link.processRxBytes(bytes.data(), reboot, 113));
    zassert_equal(link.latestChassisControl(observed), -EAGAIN);
    zassert_true(link.peerOnline(113, 100));
}

ZTEST(protocol_interboard, test_encoder_rejects_invalid_power_without_writing_output) {
    using namespace skywalker;
    using namespace skywalker::communication;
    robotics::ChassisConstraint value{};
    std::array<std::uint8_t, kMaxFrame> output{};
    output.fill(0x7d);
    value.power_limit_w = -1;
    zassert_equal(InterBoardCodec::encodeChassisConstraint(value, 1, output.data(), output.size()), -EINVAL);
    zassert_equal(output[0], 0x7d);
    value.power_limit_w = 80;
    value.buffer_energy_j = 12;
    const int n = InterBoardCodec::encodeChassisConstraint(value, 2, output.data(), output.size());
    zassert_equal(n, 34);
    zassert_equal(InterBoardCodec::encodeChassisConstraint(value, 2, output.data(), n - 1), -ENOSPC);
}

ZTEST(protocol_interboard, test_reference_v4_feedback_status_wire_numbers) {
    using namespace skywalker::robotics;
    ChassisFeedbackSummary output{};
    output.execution_state = ExecutionState::Active;
    output.safety_state = SafetyState::Active;
    const int n = InterBoardCodec::encodeChassisFeedback(output, 12, bytes.data(), bytes.size());
    zassert_equal(n, 46);
    // Reference protocol (alg_board_link.h): 2=Running, not local Ready.
    zassert_equal(bytes[12], 2);
    ChassisFeedbackSummary received{};
    FrameMeta meta{BoardRole::ChassisController, MessageId::ChassisFeedback, 12, 100};
    zassert_ok(InterBoardCodec::decodeChassisFeedback(meta, bytes.data() + 12, 32, received));
    zassert_equal(received.execution_state, ExecutionState::Active);
    auto reference = bytes;
    // Reference 5=Disabled is local Waiting; reference 4=Fault is ConfigBlocked.
    reference[12] = 5;
    zassert_ok(InterBoardCodec::decodeChassisFeedback(meta, reference.data() + 12, 32, received));
    zassert_equal(received.execution_state, ExecutionState::Waiting);
    reference[12] = 4;
    zassert_ok(InterBoardCodec::decodeChassisFeedback(meta, reference.data() + 12, 32, received));
    zassert_equal(received.execution_state, ExecutionState::ConfigBlocked);
    BigYawFeedback yaw{};
    yaw.execution_state = ExecutionState::Active;
    zassert_equal(InterBoardCodec::encodeBigYawFeedback(yaw, 13, bytes.data(), bytes.size()), 38);
    zassert_equal(bytes[12], 2);
}

ZTEST(protocol_interboard, test_reference_v4_0404_heading_payload) {
    using namespace skywalker::robotics;
    GimbalImuYaw value{};
    value.valid = true;
    value.yaw_rad = 0.5f;
    value.yaw_rate_rad_s = -0.25f;
    value.source_age_ms = 5;
    value.sample_sequence = 17;
    value.zero_generation = 3;
    value.receiver_boot_id = 0x1122334455667788ULL;
    const int n = InterBoardCodec::encodeGimbalImuYaw(value, 4, bytes.data(), bytes.size());
    zassert_equal(n, 46); // Reference's 0x0404 is 32B payload (not 0x0405/40B).
    zassert_equal(bytes[2], 4);
    zassert_equal(bytes[3], 1);
    zassert_equal(bytes[4], 4);
    zassert_equal(bytes[5], 4);
    zassert_equal(bytes[6], 32);
    zassert_equal(bytes[7], 0);
    zassert_equal(bytes[12], 1);
    zassert_equal(bytes[13], 0);
    zassert_equal(wire::loadLe32(bytes.data() + 12 + 16), 17u);
    zassert_equal(wire::loadLe32(bytes.data() + 12 + 20), 3u);
    zassert_equal(wire::loadLe64(bytes.data() + 12 + 24), value.receiver_boot_id);
    zassert_equal(wire::loadLe16(bytes.data() + n - 2), interboardCrc16(bytes.data(), n - 2));
    FrameMeta meta{BoardRole::GimbalController, MessageId::GimbalImuYaw, 4, 123};
    GimbalImuYaw decoded{};
    zassert_ok(InterBoardCodec::decodeGimbalImuYaw(meta, bytes.data() + 12, 32, decoded));
    zassert_true(decoded.valid);
    zassert_within(decoded.yaw_rad, .5f, 1e-6f);
    zassert_within(decoded.yaw_rate_rad_s, -.25f, 1e-6f);
    zassert_equal(decoded.receiver_boot_id, value.receiver_boot_id);
}

ZTEST(protocol_interboard, test_reference_v4_rejects_non_reference_yaw_mode) {
    BigYawRequest r{};
    r.mode = BigYawMode::ImuHeadingHold;
    r.receiver_boot_id = 123;
    r.stamp = {100, 1, true};
    r.permission = {true, true, {100, 1, true}};
    // Reference codec only accepts mode 0/1; preserve that invariant.
    zassert_equal(InterBoardCodec::encodeBigYawRequest(r, 1, bytes.data(), bytes.size()), -EINVAL);
}

ZTEST_SUITE(protocol_interboard, nullptr, nullptr, nullptr, nullptr, nullptr);
```

## src/referee.cpp
```c
#include <array>
#include <cstdint>
#include <communication/referee/referee_parser.hpp>
#include <communication/referee/referee_protocol.hpp>
#if defined(CONFIG_SKYWALKER_REFEREE_RM2026)
#include <communication/referee/referee_2026_parser.hpp>
#elif defined(CONFIG_SKYWALKER_REFEREE_RM2027)
#include <communication/referee/referee_2027_parser.hpp>
#else
#error "Select one referee protocol for the test"
#endif
#include <communication/wire.hpp>
#include <zephyr/ztest.h>

namespace {
using namespace skywalker::communication;
#if defined(CONFIG_SKYWALKER_REFEREE_RM2026)
using SeasonParser = Referee2026Parser;
#else
using SeasonParser = Referee2027Parser;
#endif

std::array<std::uint8_t, 22> robotFrame2026() {
    std::array<std::uint8_t, 22> bytes{};
    bytes[0] = 0xa5;
    wire::storeLe16(bytes.data() + 1, 13);
    bytes[3] = 4;
    bytes[4] = refereeCrc8(bytes.data(), 4);
    wire::storeLe16(bytes.data() + 5, 0x0201);
    bytes[7] = 9;
    wire::storeLe16(bytes.data() + 7 + 10, 120);
    bytes[7 + 12] = 0x05;
    wire::storeLe16(bytes.data() + 20, refereeCrc16(bytes.data(), 20));
    return bytes;
}

std::array<std::uint8_t, 26> robotFrame2027() {
    std::array<std::uint8_t, 26> bytes{};
    bytes[0] = 0xa5;
    wire::storeLe16(bytes.data() + 1, 17);
    bytes[3] = 5;
    bytes[4] = refereeCrc8(bytes.data(), 4);
    wire::storeLe16(bytes.data() + 5, 0x0201);
    bytes[7] = 7;
    wire::storeLe16(bytes.data() + 7 + 10, 200);
    wire::storeFloatLe(bytes.data() + 7 + 12, 30.5f);
    bytes[7 + 16] = 0x05;
    wire::storeLe16(bytes.data() + 24, refereeCrc16(bytes.data(), 24));
    return bytes;
}

auto selectedRobotFrame() {
#if defined(CONFIG_SKYWALKER_REFEREE_RM2026)
    return robotFrame2026();
#else
    return robotFrame2027();
#endif
}

auto incompatibleRobotFrame() {
#if defined(CONFIG_SKYWALKER_REFEREE_RM2026)
    return robotFrame2027();
#else
    return robotFrame2026();
#endif
}

std::array<std::uint8_t, 23> powerFrame() {
    std::array<std::uint8_t, 23> bytes{};
    bytes[0] = 0xa5;
    wire::storeLe16(bytes.data() + 1, 14);
    bytes[4] = refereeCrc8(bytes.data(), 4);
    wire::storeLe16(bytes.data() + 5, 0x0202);
    wire::storeLe16(bytes.data() + 7 + 8, 42);
    wire::storeLe16(bytes.data() + 21, refereeCrc16(bytes.data(), 21));
    return bytes;
}
} // namespace

ZTEST(protocol_referee, test_selected_season_robot_status) {
    RefereeParser parser;
    const auto frame = selectedRobotFrame();
    zassert_ok(parser.consume(frame.data(), 4, 30));
    zassert_false(parser.state().stamp.valid);
    zassert_ok(parser.consume(frame.data() + 4, frame.size() - 4, 31));
    const auto &state = parser.state();
    zassert_true(state.online);
#if defined(CONFIG_SKYWALKER_REFEREE_RM2026)
    zassert_equal(state.robot.robot_id, 9u);
    zassert_equal(state.power.chassis_power_limit_w, 120.0f);
    zassert_false(state.robot.bullet_speed_limit_stamp.valid);
#else
    zassert_equal(state.robot.robot_id, 7u);
    zassert_equal(state.power.chassis_power_limit_w, 200.0f);
    zassert_equal(state.robot.bullet_speed_limit_m_s, 30.5f);
    zassert_true(state.robot.bullet_speed_limit_stamp.valid);
    zassert_equal(state.robot.bullet_speed_limit_stamp.timestamp_ms, 31u);
#endif
    zassert_true(state.robot.gimbal_output.enabled);
    zassert_false(state.robot.chassis_output.enabled);
    zassert_true(state.robot.shooter_output.enabled);
    zassert_equal(state.stamp.timestamp_ms, 31u);
    zassert_equal(state.power.limit_stamp.sequence, state.stamp.sequence);
    zassert_equal(parser.stats().valid_frames, 1u);
}

ZTEST(protocol_referee, test_power_buffer_does_not_refresh_permissions) {
    RefereeParser parser;
    const auto robot = selectedRobotFrame();
    const auto power = powerFrame();
    zassert_ok(parser.consume(robot.data(), robot.size(), 50));
    const auto permission_stamp = parser.state().robot.chassis_output.stamp;
    const auto speed_stamp = parser.state().robot.bullet_speed_limit_stamp;
    zassert_ok(parser.consume(power.data(), power.size(), 60));
    const auto &state = parser.state();
    zassert_equal(state.power.buffer_energy_j, 42.0f);
    zassert_equal(state.robot.chassis_output.stamp.sequence, permission_stamp.sequence);
    zassert_equal(state.robot.chassis_output.stamp.timestamp_ms, 50u);
    zassert_equal(state.robot.bullet_speed_limit_stamp.sequence, speed_stamp.sequence);
    zassert_equal(state.power.stamp.timestamp_ms, 60u);
    zassert_equal(state.power.chassis_power_w, 0.0f);
    zassert_equal(state.stamp.sequence, 2u);
}

ZTEST(protocol_referee, test_crc_unknown_command_and_reset) {
    RefereeParser parser;
    const auto frame = selectedRobotFrame();
    auto bad = frame;
    bad[4] ^= 1;
    zassert_ok(parser.consume(bad.data(), bad.size(), 10));
    zassert_true(parser.stats().crc8_errors > 0);
    bad = frame;
    bad[8] ^= 1;
    zassert_ok(parser.consume(bad.data(), bad.size(), 20));
    zassert_true(parser.stats().crc16_errors > 0);
    zassert_false(parser.state().stamp.valid);
    // Valid frame with a command unknown to this selected decoder.
    bad = frame;
    wire::storeLe16(bad.data() + 5, 0x1234);
    wire::storeLe16(bad.data() + bad.size() - 2, refereeCrc16(bad.data(), bad.size() - 2));
    zassert_ok(parser.consume(bad.data(), bad.size(), 25));
    zassert_equal(parser.stats().unknown_commands, 1u);
    zassert_false(parser.state().stamp.valid);
    zassert_ok(parser.consume(frame.data(), frame.size(), 30));
    zassert_true(parser.state().stamp.valid);
    zassert_ok(parser.reset());
    zassert_false(parser.state().stamp.valid);
    zassert_equal(parser.stats().valid_frames, 0u);
}

ZTEST(protocol_referee, test_other_season_is_rejected_without_changing_state) {
    RefereeParser parser;
    const auto frame = selectedRobotFrame();
    const auto other = incompatibleRobotFrame();
    zassert_ok(parser.consume(frame.data(), frame.size(), 10));
    const auto stamp = parser.state().stamp;
    const auto robot_id = parser.state().robot.robot_id;
    zassert_ok(parser.consume(other.data(), other.size(), 20));
    zassert_equal(parser.stats().length_errors, 1u);
    zassert_equal(parser.state().robot.robot_id, robot_id);
    zassert_equal(parser.state().stamp.sequence, stamp.sequence);
    zassert_equal(parser.state().stamp.timestamp_ms, stamp.timestamp_ms);
}

ZTEST(protocol_referee, test_selected_decoder_is_directly_testable) {
    using namespace skywalker::communication;
    const auto frame = selectedRobotFrame();
    const auto other = incompatibleRobotFrame();
    const skywalker::robotics::MessageStamp stamp{123, 5, true};
    skywalker::robotics::RefereeState state{};
    zassert_true(SeasonParser::decode(0x0201, frame.data() + 7, frame.size() - 9, stamp, state) ==
                 RefereeDecodeResult::Decoded);
    const auto robot_id = state.robot.robot_id;
    zassert_true(SeasonParser::decode(0x0201, other.data() + 7, other.size() - 9, stamp, state) ==
                 RefereeDecodeResult::InvalidLength);
    zassert_equal(state.robot.robot_id, robot_id);
    zassert_true(SeasonParser::decode(0x1234, frame.data() + 7, frame.size() - 9, stamp, state) ==
                 RefereeDecodeResult::UnknownCommand);
    zassert_equal(state.robot.robot_id, robot_id);
}
ZTEST_SUITE(protocol_referee, nullptr, nullptr, nullptr, nullptr, nullptr);
```

## src/remote.cpp
```c
#include <array>
#include <cerrno>
#include <cstdint>
#include <communication/remote/dr16_decoder.hpp>
#include <communication/remote/remote_service.hpp>
#include <communication/wire.hpp>
#include <zephyr/ztest.h>

namespace {
using namespace skywalker;
std::array<std::uint8_t, 18> frame(int ch0 = 1024, int ch1 = 1024, int ch2 = 1024, int ch3 = 1024) {
    std::array<std::uint8_t, 18> bytes{};
    const std::uint64_t packed = std::uint64_t(ch0) | (std::uint64_t(ch1) << 11) | (std::uint64_t(ch2) << 22) |
                                 (std::uint64_t(ch3) << 33) | (std::uint64_t(3) << 44) | (std::uint64_t(3) << 46);
    for (unsigned i = 0; i != 6; ++i)
        bytes[i] = static_cast<std::uint8_t>(packed >> (8 * i));
    communication::wire::storeLe16(bytes.data() + 16, 1024);
    return bytes;
}
}
ZTEST(protocol_remote, test_neutral_frame_and_channel_bounds) {
    using namespace skywalker;
    communication::Dr16Decoder decoder({});
    robotics::RemoteState out{};
    const auto neutral = frame();
    zassert_ok(decoder.decodeFrame(neutral.data(), neutral.size(), 100, out));
    zassert_true(out.online);
    zassert_equal(out.left_switch, robotics::RcSwitch::Middle);
    zassert_equal(out.right_switch, robotics::RcSwitch::Middle);
    zassert_equal(out.analog.left_y, 0);
    zassert_equal(out.analog.wheel, 0);
    zassert_equal(out.stamp.sequence, 1);
    const auto extremes = frame(364, 1684, 364, 1684);
    zassert_ok(decoder.decodeFrame(extremes.data(), extremes.size(), 101, out));
    zassert_equal(out.analog.right_x, -660);
    zassert_equal(out.analog.right_y, 660);
    zassert_equal(out.stamp.sequence, 2);
    zassert_equal(decoder.validFrameCount(), 2u);
}

ZTEST(protocol_remote, test_failed_decode_does_not_mutate_publication) {
    using namespace skywalker;
    communication::Dr16Decoder decoder({});
    auto good = frame();
    robotics::RemoteState out{};
    zassert_ok(decoder.decodeFrame(good.data(), good.size(), 7, out));
    const auto previous = out.stamp;
    good[5] &= static_cast<std::uint8_t>(~0x30u); // Invalid switch 0.
    zassert_equal(decoder.decodeFrame(good.data(), good.size(), 8, out), -EBADMSG);
    zassert_equal(out.stamp.sequence, previous.sequence);
    zassert_equal(decoder.decodeFrame(nullptr, good.size(), 8, out), -EINVAL);
    zassert_equal(decoder.decodeFrame(good.data(), good.size() - 1, 8, out), -EINVAL);
    zassert_equal(decoder.invalidFrameCount(), 3u);
    zassert_ok(decoder.reset());
    zassert_equal(decoder.invalidFrameCount(), 0u);
    zassert_equal(decoder.validFrameCount(), 0u);
}

ZTEST(protocol_remote, test_stream_fragmentation_and_expiry_without_refreshing_stamp) {
    using namespace skywalker;
    communication::RemoteService service({}, {.offline_timeout_ms = 100, .assembly_gap_ms = 10});
    auto good = frame();
    robotics::RemoteState value{};
    zassert_equal(service.snapshot(100, value), -EAGAIN);
    zassert_ok(service.processBytes(good.data(), 7, 100));
    zassert_equal(service.snapshot(100, value), -EAGAIN);
    zassert_ok(service.processBytes(good.data() + 7, good.size() - 7, 101));
    zassert_ok(service.snapshot(101, value));
    zassert_equal(value.stamp.timestamp_ms, 101u);
    zassert_equal(value.stamp.sequence, 1u);
    zassert_ok(service.snapshot(201, value));
    zassert_equal(value.stamp.sequence, 1u);
    zassert_equal(service.snapshot(202, value), -ESTALE);
    zassert_false(value.online);
    zassert_equal(value.stamp.timestamp_ms, 101u);
    zassert_equal(service.processBytes(nullptr, 1, 202), -EINVAL);
}

ZTEST(protocol_remote, test_partial_frame_gap_does_not_publish_ghost_input) {
    using namespace skywalker;
    communication::RemoteService service({}, {.offline_timeout_ms = 100, .assembly_gap_ms = 5});
    const auto good = frame();
    robotics::RemoteState value{};
    zassert_ok(service.processBytes(good.data(), 12, 10));
    zassert_ok(service.processBytes(good.data() + 12, 6, 20));
    zassert_equal(service.snapshot(20, value), -EAGAIN);
    service.discardPartial();
    zassert_ok(service.processBytes(good.data(), good.size(), 30));
    zassert_ok(service.snapshot(30, value));
    zassert_equal(value.stamp.sequence, 1u);
}

ZTEST_SUITE(protocol_remote, nullptr, nullptr, nullptr, nullptr, nullptr);
```

## src/wire.cpp
```c
#include <array>
#include <cstdint>
#include <communication/wire.hpp>
#include <core/byte_codec.hpp>
#include <robotics/messages/common.hpp>
#include <robotics/messages/interboard.hpp>
#include <zephyr/ztest.h>

using namespace skywalker;

ZTEST(protocol_wire, test_little_endian_known_vectors_and_roundtrip) {
    std::array<std::uint8_t, 18> bytes{};
    communication::wire::storeLe16(bytes.data(), 0x1234);
    communication::wire::storeLe32(bytes.data() + 2, 0x89abcdef);
    communication::wire::storeLe64(bytes.data() + 6, 0x0123456789abcdefULL);
    communication::wire::storeFloatLe(bytes.data() + 14, -2.5f);
    constexpr std::uint8_t expected[] = {0x34, 0x12, 0xef, 0xcd, 0xab, 0x89, 0xef, 0xcd, 0xab,
                                         0x89, 0x67, 0x45, 0x23, 0x01, 0x00, 0x00, 0x20, 0xc0};
    zassert_mem_equal(bytes.data(), expected, sizeof(expected));
    zassert_equal(communication::wire::loadLe16(bytes.data()), 0x1234);
    zassert_equal(communication::wire::loadLe32(bytes.data() + 2), 0x89abcdefu);
    zassert_equal(communication::wire::loadLe64(bytes.data() + 6), 0x0123456789abcdefULL);
    zassert_within(communication::wire::loadFloatLe(bytes.data() + 14), -2.5f, 0.000001f);
    zassert_equal(core::wire::u32(bytes.data() + 2), 0x89abcdefu);
    zassert_within(core::wire::f32(bytes.data() + 14), -2.5f, 0.000001f);
}

ZTEST(protocol_wire, test_sequence_wraparound_and_freshness_boundaries) {
    using namespace robotics;
    zassert_true(sequenceAfter(0, 0xffffffffu));
    zassert_true(sequenceAfter(0x10u, 0xfffffff0u));
    zassert_false(sequenceAfter(42, 42));
    zassert_false(sequenceAfter(0x80000000u, 0));
    zassert_false(sequenceAfter(0, 1));
    MessageStamp stamp{100, 4, true};
    zassert_true(isFresh(stamp, 150, 50));
    zassert_false(isFresh(stamp, 151, 50));
    zassert_false(isFresh(stamp, 99, 50));
    stamp.valid = false;
    zassert_false(isFresh(stamp, 100, 50));
}

ZTEST(protocol_wire, test_forwarded_age_never_renews_original_producer) {
    const robotics::MessageStamp stamp{100, 7, true};
    zassert_true(robotics::forwardedFresh(stamp, 30, 150, 100));
    zassert_true(robotics::forwardedFresh(stamp, 30, 170, 100));
    zassert_false(robotics::forwardedFresh(stamp, 30, 171, 100));
    zassert_false(robotics::forwardedFresh(stamp, 101, 101, 100));
    zassert_false(robotics::forwardedFresh(stamp, 0, 99, 100));
}

ZTEST_SUITE(protocol_wire, nullptr, nullptr, nullptr, nullptr, nullptr);
```
