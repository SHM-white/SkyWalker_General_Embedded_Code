## CMakeLists.txt
```
cmake_minimum_required(VERSION 3.20.0)
find_package(Zephyr REQUIRED HINTS $ENV{ZEPHYR_BASE})
project(vision_imu_flow LANGUAGES C CXX)
target_sources(app PRIVATE src/main.cpp)
```

## prj.conf
```kconfig
CONFIG_ZTEST=y
CONFIG_CPP=y
CONFIG_STD_CPP20=y
CONFIG_REQUIRES_FULL_LIBCPP=y
CONFIG_MAIN_STACK_SIZE=8192
CONFIG_TEST_EXTRA_STACK_SIZE=8192
CONFIG_ASSERT=y
CONFIG_SPIN_VALIDATE=y
CONFIG_PWM=y
CONFIG_SKYWALKER_IMU=y
CONFIG_SKYWALKER_IMU_HEATER=y
CONFIG_SKYWALKER_IMU_DM_PROTOCOL=y
CONFIG_SKYWALKER_ATTITUDE_EKF=y
CONFIG_SKYWALKER_LIB_COMMUNICATION=y
CONFIG_SKYWALKER_VISION=y
CONFIG_SKYWALKER_VISION_AB=y
CONFIG_SKYWALKER_REMOTE_DR16=n
CONFIG_SKYWALKER_REFEREE=n
CONFIG_SKYWALKER_INTERBOARD=n
```

## src/main.cpp
```c
#include <zephyr/ztest.h>
#include <core/attitude.hpp>
#include <core/byte_codec.hpp>
#include <core/clock.hpp>
#include <drivers/imu/dm_imu_protocol.hpp>
#include <drivers/imu/imu_heater.hpp>
#include <control/attitude_ekf.hpp>
#include <communication/vision/ab_protocol.hpp>
#include <communication/vision/vision_link.hpp>
#include <cerrno>
#include <cstring>
#include <type_traits>
#include <array>

namespace core = skywalker::core;
namespace imu = skywalker::imu;
namespace vision = skywalker::communication::vision;
namespace {
std::uint32_t pulse_cycles = 0;
int pwmSet(const device *, std::uint32_t, std::uint32_t, std::uint32_t pulse, pwm_flags_t) {
    pulse_cycles = pulse;
    return 0;
}
int pwmFrequency(const device *, std::uint32_t, std::uint64_t *hz) {
    *hz = 1000000;
    return 0;
}
static DEVICE_API(pwm, pwm_api){.set_cycles = pwmSet, .get_cycles_per_sec = pwmFrequency};
DEVICE_DEFINE(flow_pwm, "flow_pwm", nullptr, nullptr, nullptr, nullptr, POST_KERNEL, 90, &pwm_api);
class Sink final : public imu::DmImuSink {
public:
    explicit Sink(imu::ImuState &s) : state(s) {
    }
    int acceptDm(const imu::Update &raw) override {
        auto u = raw;
        u.sample.reference = {2, 1};
        return state.publish(u);
    }
    imu::ImuState &state;
};
}
ZTEST(vision_imu, test_end_to_end) {
    using Ekf = skywalker::control::QuaternionEkf;
    Ekf first({}), second({});
    zassert_ok(first.init());
    zassert_ok(second.init());
    const core::Quaternion tilted = core::fromEuler({0.4f, 0, 0});
    const auto tilted_accel = core::rotate(core::conjugate(tilted), {0, 0, 9.80665f});
    for (unsigned i = 1; i <= 150; ++i) {
        const int a = first.update({{0, 0, 9.80665f}, {}, i * 2000u});
        const int b = second.update({tilted_accel, {}, i * 2000u});
        zassert_true(a == 0 || a == -EAGAIN);
        zassert_true(b == 0 || b == -EAGAIN);
    }
    zassert_within(core::euler(second.attitude()).roll, 0.4f, 0.02f);
    for (unsigned i = 151; i <= 650; ++i)
        zassert_ok(first.update({{0, 0, 9.80665f}, {0, 0, 1}, i * 2000u}));
    zassert_within(core::euler(first.attitude()).yaw, 1.0f, 0.03f);
    zassert_within(core::euler(second.attitude()).yaw, 0.0f, 0.01f);
    zassert_ok(first.update({{0, 0, 20}, {0, 0, 1}, 1302000}));
    zassert_equal(first.quality(), Ekf::Quality::Degraded);
    const auto generation = first.generation();
    zassert_equal(first.update({{0, 0, 9.80665f}, {}, 1500000}), -EAGAIN);
    zassert_not_equal(first.generation(), generation);

    imu::ImuState state({5000, 5000, 5000, 5000});
    zassert_ok(state.init(imu::Accel | imu::Gyro | imu::Orientation | imu::Temperature, {2, 1}));
    Sink sink(state);
    imu::DmImuParser parser({});
    zassert_ok(parser.init());
    k_sleep(K_MSEC(1));
    auto now = core::monotonicTimeUs();
    // Captured manufacturer-manual frame, CRC 0x268f, not generated by our decoder.
    const std::uint8_t gyro[] = {0x55, 0xaa, 1,    2,    0x02, 0x6d, 0xf1, 0x3b, 0xeb, 0xe2,
                                 0x0e, 0xbd, 0x5a, 0x59, 0x0f, 0x3c, 0x8f, 0x26, 0x0a};
    zassert_equal(imu::dmImuCrc16(gyro, 16), 0x268f);
    zassert_equal(parser.consume(gyro, 5, now, sink), 0);
    zassert_equal(parser.consume(gyro + 5, sizeof(gyro) - 5, now, sink), 1);
    zassert_within(state.snapshot().sample.gyro_rad_s.value.x, 0.00736773f, 1e-6f);
    const std::uint8_t accel[] = {0x55, 0xaa, 1,    1,    0x07, 0xf0, 0x40, 0x3f, 0xa0, 0x43,
                                  0xc6, 0xbd, 0xf1, 0xa5, 0x1b, 0x41, 0x87, 0x6c, 0x0a};
    zassert_equal(parser.consume(accel, sizeof(accel), now, sink), 1);
    // Synthetic quaternion exercises the complete stream-to-state path, not target firmware.
    std::uint8_t quaternion[23] = {0x55, 0xaa, 1, 4};
    core::wire::putFloat(quaternion + 4, 1);
    core::wire::put16(quaternion + 20, imu::dmImuCrc16(quaternion, 20));
    quaternion[22] = 0x0a;
    zassert_equal(parser.consume(quaternion, sizeof(quaternion), now, sink), 1);
    const auto good = state.snapshot();
    zassert_equal(good.sample.attitude_quality, imu::AttitudeQuality::Unknown);
    zassert_equal(good.fresh_mask, imu::Accel | imu::Gyro | imu::Orientation);
    auto corrupt = std::array<std::uint8_t, 23>{};
    std::memcpy(corrupt.data(), quaternion, 23);
    corrupt[7] ^= 1;
    zassert_equal(parser.consume(corrupt.data(), 23, now, sink), 0);
    zassert_equal(parser.consume(quaternion, 23, now, sink), 1);
    zassert_equal(parser.statistics().crc_errors, 1);
    zassert_equal(state.snapshot().sample.orientation.stamp.sequence, 2);

    vision::AbProtocol protocol({.command_reference = {2, 1}});
    vision::VisionLink link(protocol,
                            {.aim_timeout_us = 5000, .orientation_timeout_us = 5000, .gyro_timeout_us = 5000});
    zassert_ok(link.init());
    const std::uint8_t command[] = {0x41, 0x42, 0x02, 0,    0,    0x80, 0x3e, 0,    0, 0, 0x3f, 0,    0,    0x80, 0x3f,
                                    0xcd, 0xcc, 0x4c, 0xbe, 0x9a, 0x99, 0x99, 0xbe, 0, 0, 0x80, 0x3e, 0x39, 0x77};
    zassert_equal(vision::AbProtocol::crc16(command, 27), 0x7739);
    zassert_equal(link.processRxBytes(command, 7, now), 0);
    zassert_equal(link.processRxBytes(command + 7, 22, now), 1);
    zassert_true(link.snapshot().aim.value.fire_requested);
    zassert_within(link.snapshot().aim.value.pitch.angle_rad, -0.2f, 1e-6f);
    std::uint8_t stop[29];
    std::memcpy(stop, command, 29);
    stop[2] = 0;
    core::wire::put16(stop + 27, vision::AbProtocol::crc16(stop, 27));
    std::uint8_t combined[58];
    std::memcpy(combined, command, 29);
    std::memcpy(combined + 29, stop, 29);
    zassert_equal(link.processRxBytes(combined, 58, now), 2);
    zassert_false(link.snapshot().aim.value.control_requested);
    zassert_equal(link.snapshot().aim.stamp.sequence, 3);
    std::uint8_t noise[31] = {0xff, 0x41};
    std::memcpy(noise + 2, command, 29);
    noise[10] ^= 1;
    link.processRxBytes(noise, sizeof(noise), now);
    zassert_equal(link.processRxBytes(command, 29, now), 1);
    zassert_true(link.snapshot().protocol.crc_errors > 0);

    vision::Feedback f{};
    f.reference = good.sample.reference;
    f.orientation = good.sample.orientation;
    f.gyro_rad_s = good.sample.gyro_rad_s;
    f.bullet_speed_m_s = {20, {now, 1, true}};
    f.bullet_count = {42, {now, 1, true}};
    zassert_ok(link.setFeedback(f));
    std::uint8_t feedback[43]{};
    zassert_equal(link.encodeFeedback(feedback, sizeof(feedback)), 43);
    zassert_equal(core::wire::u16(feedback + 39), 42);
    zassert_equal(core::wire::u16(feedback + 41), vision::AbProtocol::crc16(feedback, 41));
    zassert_within(core::wire::f32(feedback + 3), 1.0f, 1e-6f);
    zassert_equal(link.encodeFeedback(feedback, 42), -EMSGSIZE);

    imu::ImuHeater heater({.pwm = {DEVICE_GET(flow_pwm), 4, PWM_MSEC(20), 0}, .temperature_timeout_us = 5000});
    zassert_ok(heater.init());
    zassert_equal(pulse_cycles, 0);
    core::Measurement<float> temperature{25, {now, 1, true}};
    zassert_ok(heater.update(temperature, now));
    zassert_true(pulse_cycles > 0);
    k_sleep(K_MSEC(10));
    const auto later = core::monotonicTimeUs();
    zassert_equal(heater.update(temperature, later), -ESTALE);
    zassert_equal(pulse_cycles, 0);
    zassert_false(link.snapshot().aim_fresh);
    zassert_equal(link.encodeFeedback(feedback, 43), -ENODATA);
    zassert_equal(state.snapshot().fresh_mask, 0);
    imu::Update only_accel{};
    only_accel.updated_mask = imu::Accel;
    only_accel.sample.accel_m_s2 = {{0, 0, 9.80665f}, {later, 0, true}};
    zassert_ok(state.publish(only_accel));
    zassert_equal(state.snapshot().fresh_mask, imu::Accel);
    zassert_equal(state.snapshot().sample.orientation.stamp.sequence, 2);
    state.resetOrientation({2, 2});
    zassert_false(state.snapshot().sample.orientation.stamp.valid);
    state.setState(imu::State::Fault);
    zassert_equal(state.snapshot().fresh_mask, 0);
}
ZTEST_SUITE(vision_imu, nullptr, nullptr, nullptr, nullptr, nullptr);
```
