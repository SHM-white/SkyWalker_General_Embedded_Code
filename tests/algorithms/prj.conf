## CMakeLists.txt
```
cmake_minimum_required(VERSION 3.20.0)
find_package(Zephyr REQUIRED HINTS $ENV{ZEPHYR_BASE})
project(algorithm_units LANGUAGES C CXX)

target_sources(app PRIVATE
  src/attitude_ekf.cpp
  src/core_attitude.cpp
  src/control.cpp
  src/kalman_matrix.cpp
  src/robotics.cpp
)
include(${CMAKE_CURRENT_SOURCE_DIR}/../common/benchmark.cmake)
```

## prj.conf
```kconfig
CONFIG_ZTEST=y
CONFIG_CPP=y
CONFIG_STD_CPP20=y
CONFIG_REQUIRES_FULL_LIBCPP=y
CONFIG_MAIN_STACK_SIZE=8192
CONFIG_TEST_EXTRA_STACK_SIZE=8192
CONFIG_ASSERT=y
CONFIG_TIMING_FUNCTIONS=y
CONFIG_SPEED_OPTIMIZATIONS=y
CONFIG_SKYWALKER_LIB_CONTROL=y
CONFIG_SKYWALKER_ATTITUDE_EKF=y
CONFIG_SKYWALKER_LIB_KALMAN_FILTER=y
CONFIG_CMSIS_DSP_MATRIXCHECK=y
CONFIG_SKYWALKER_LIB_MATRIX_STORAGE=n
CONFIG_SKYWALKER_LIB_ROBOTICS=y
CONFIG_SKYWALKER_ROBOTICS_COMMAND=n
CONFIG_SKYWALKER_ROBOTICS_SWERVE=y
```

## src/attitude_ekf.cpp
```c
#include <benchmark.hpp>
#include <control/attitude_ekf.hpp>
#include <zephyr/ztest.h>
#include <algorithm>
#include <array>
#include <cerrno>
#include <cmath>
#include <cstdint>
#include <limits>

namespace {
using Ekf = skywalker::control::QuaternionEkf;
using Quaternion = skywalker::core::Quaternion;
using Vec3 = skywalker::core::Vec3;
using TimeUs = skywalker::core::TimeUs;
constexpr double pi = 3.14159265358979323846;
constexpr float gravity = 9.80665f;
constexpr TimeUs sample_us = 2000;
constexpr double sample_s = 0.002;

// Independent double-precision ZYX attitude and gravity model. None of the
// expected values use core::fromEuler/rotate or EKF output as their oracle.
Quaternion referenceAttitude(double roll, double pitch, double yaw) {
    const double cr = std::cos(roll * 0.5), sr = std::sin(roll * 0.5);
    const double cp = std::cos(pitch * 0.5), sp = std::sin(pitch * 0.5);
    const double cy = std::cos(yaw * 0.5), sy = std::sin(yaw * 0.5);
    return {float(cr * cp * cy + sr * sp * sy), float(sr * cp * cy - cr * sp * sy), float(cr * sp * cy + sr * cp * sy),
            float(cr * cp * sy - sr * sp * cy)};
}

Vec3 referenceGravity(double roll, double pitch) {
    return {float(-double(gravity) * std::sin(pitch)), float(double(gravity) * std::sin(roll) * std::cos(pitch)),
            float(double(gravity) * std::cos(roll) * std::cos(pitch))};
}

double angularError(Quaternion actual, Quaternion expected) {
    const double an = std::sqrt(double(actual.w) * double(actual.w) + double(actual.x) * double(actual.x) +
                                double(actual.y) * double(actual.y) + double(actual.z) * double(actual.z));
    const double en = std::sqrt(double(expected.w) * double(expected.w) + double(expected.x) * double(expected.x) +
                                double(expected.y) * double(expected.y) + double(expected.z) * double(expected.z));
    const double dot = (double(actual.w) * double(expected.w) + double(actual.x) * double(expected.x) +
                        double(actual.y) * double(expected.y) + double(actual.z) * double(expected.z)) /
                       (an * en);
    // q and -q describe the same rotation.
    return 2.0 * std::acos(std::clamp(std::fabs(dot), 0.0, 1.0));
}

void assertAttitude(Quaternion actual, Quaternion expected, double tolerance_rad) {
    zassert_true(std::isfinite(actual.w) && std::isfinite(actual.x) && std::isfinite(actual.y) &&
                     std::isfinite(actual.z),
                 "attitude must stay finite");
    const double n2 = double(actual.w) * double(actual.w) + double(actual.x) * double(actual.x) +
                      double(actual.y) * double(actual.y) + double(actual.z) * double(actual.z);
    zassert_within(n2, 1.0, 2e-5, "quaternion must stay normalized");
    const double error = angularError(actual, expected);
    zassert_true(error <= tolerance_rad, "angular error %g rad exceeds %g rad", error, tolerance_rad);
}

Ekf::Config testConfig() {
    Ekf::Config config;
    config.initialization_samples = 16;
    return config;
}

TimeUs initialize(Ekf &filter, const Ekf::Config &config, Vec3 accel = {0, 0, gravity}, Vec3 gyro = {}) {
    zassert_ok(filter.init());
    TimeUs time = 0;
    for (unsigned i = 0; i < config.initialization_samples; ++i) {
        time += sample_us;
        const int expected = i + 1 == config.initialization_samples ? 0 : -EAGAIN;
        zassert_equal(filter.update({accel, gyro, time}), expected);
    }
    zassert_equal(filter.quality(), Ekf::Quality::Tracking);
    return time;
}

Vec3 add(Vec3 a, Vec3 b) {
    return {a.x + b.x, a.y + b.y, a.z + b.z};
}
}

ZTEST(attitude_ekf, test_static_gravity_initializes_known_roll_and_pitch) {
    const std::array<std::array<double, 2>, 7> cases{{
        {0.0, 0.0},
        {pi / 6, 0.0},
        {-pi / 3, 0.0},
        {0.0, pi / 4},
        {0.0, -pi / 3},
        {0.55, -0.4},
        {-0.7, 0.6},
    }};
    for (const auto &angles : cases) {
        const auto config = testConfig();
        Ekf filter(config);
        auto time = initialize(filter, config, referenceGravity(angles[0], angles[1]));
        const auto expected = referenceAttitude(angles[0], angles[1], 0);
        assertAttitude(filter.attitude(), expected, 1e-4);
        for (unsigned i = 0; i < 500; ++i) {
            time += sample_us;
            zassert_ok(filter.update({referenceGravity(angles[0], angles[1]), {}, time}));
            zassert_equal(filter.quality(), Ekf::Quality::Tracking);
        }
        assertAttitude(filter.attitude(), expected, 1e-3);
    }
}

ZTEST(attitude_ekf, test_constant_yaw_rate_over_multiple_turns) {
    const auto config = testConfig();
    Ekf filter(config);
    auto time = initialize(filter, config);
    constexpr double rate = 2.0;
    for (unsigned i = 1; i <= 4000; ++i) {
        time += sample_us;
        zassert_ok(filter.update({{0, 0, gravity}, {0, 0, float(rate)}, time}));
        if (i % 100 == 0)
            assertAttitude(filter.attitude(), referenceAttitude(0, 0, rate * i * sample_s), 0.01);
    }
    zassert_equal(filter.quality(), Ekf::Quality::Tracking);
}

ZTEST(attitude_ekf, test_yaw_rotation_with_fixed_roll_and_pitch) {
    const auto config = testConfig();
    Ekf filter(config);
    constexpr double roll = 0.4, pitch = -0.3, rate = 0.8;
    const auto accel = referenceGravity(roll, pitch);
    const Vec3 body_rate{float(-rate * std::sin(pitch)), float(rate * std::sin(roll) * std::cos(pitch)),
                         float(rate * std::cos(roll) * std::cos(pitch))};
    auto time = initialize(filter, config, accel);
    for (unsigned i = 1; i <= 2000; ++i) {
        time += sample_us;
        zassert_ok(filter.update({accel, body_rate, time}));
        if (i % 100 == 0)
            assertAttitude(filter.attitude(), referenceAttitude(roll, pitch, rate * i * sample_s), 0.015);
    }
}

ZTEST(attitude_ekf, test_instances_keep_attitude_bias_and_reset_independent) {
    const auto config = testConfig();
    Ekf first(config), second(config);
    const Vec3 bias_a{0.01f, -0.02f, 0.03f}, bias_b{-0.025f, 0.015f, -0.01f};
    const auto accel_b = referenceGravity(-0.5, 0.25);
    auto time_a = initialize(first, config, {0, 0, gravity}, bias_a);
    auto time_b = initialize(second, config, accel_b, bias_b);
    for (unsigned i = 1; i <= 500; ++i) {
        time_a += sample_us;
        time_b += sample_us;
        zassert_ok(first.update({{0, 0, gravity}, add(bias_a, {0, 0, 1}), time_a}));
        zassert_ok(second.update({accel_b, bias_b, time_b}));
    }
    assertAttitude(first.attitude(), referenceAttitude(0, 0, 1), 0.01);
    assertAttitude(second.attitude(), referenceAttitude(-0.5, 0.25, 0), 0.002);
    const auto other_generation = second.generation();
    first.reset();
    zassert_equal(first.quality(), Ekf::Quality::Initializing);
    for (unsigned i = 0; i < 100; ++i) {
        time_b += sample_us;
        zassert_ok(second.update({accel_b, bias_b, time_b}));
    }
    zassert_equal(second.generation(), other_generation);
    assertAttitude(second.attitude(), referenceAttitude(-0.5, 0.25, 0), 0.002);
}

ZTEST(attitude_ekf, test_initial_stationary_bias_is_removed_from_rotation) {
    const auto config = testConfig();
    const Vec3 bias{0.012f, -0.009f, 0.025f};
    Ekf filter(config);
    auto time = initialize(filter, config, {0, 0, gravity}, bias);
    for (unsigned i = 0; i < 1000; ++i) {
        time += sample_us;
        zassert_ok(filter.update({{0, 0, gravity}, bias, time}));
    }
    assertAttitude(filter.attitude(), referenceAttitude(0, 0, 0), 0.002);
    for (unsigned i = 1; i <= 1500; ++i) {
        time += sample_us;
        zassert_ok(filter.update({{0, 0, gravity}, add(bias, {0, 0, 0.7f}), time}));
    }
    assertAttitude(filter.attitude(), referenceAttitude(0, 0, 2.1), 0.01);
}

ZTEST(attitude_ekf, test_stationary_with_deterministic_sensor_noise) {
    const auto config = testConfig();
    const Vec3 bias{0.01f, -0.015f, 0.02f};
    constexpr double roll = 0.35, pitch = -0.45;
    const auto gravity_vector = referenceGravity(roll, pitch);
    Ekf filter(config);
    auto time = initialize(filter, config, gravity_vector, bias);
    double squared_error_sum = 0;
    for (unsigned i = 1; i <= 3000; ++i) {
        const double phase = i * 0.137;
        const Vec3 accel_noise{float(0.025 * std::sin(phase)), float(0.02 * std::cos(phase * 1.3)),
                               float(0.015 * std::sin(phase * 0.7))};
        const Vec3 gyro_noise{float(0.003 * std::sin(phase * 0.9)), float(0.002 * std::cos(phase * 1.1)),
                              float(0.002 * std::sin(phase * 1.7))};
        time += sample_us;
        zassert_ok(filter.update({add(gravity_vector, accel_noise), add(bias, gyro_noise), time}));
        zassert_equal(filter.quality(), Ekf::Quality::Tracking);
        const auto expected = referenceAttitude(roll, pitch, 0);
        assertAttitude(filter.attitude(), expected, 0.01); // < 0.6 degree maximum.
        const double error = angularError(filter.attitude(), expected);
        squared_error_sum += error * error;
    }
    zassert_true(std::sqrt(squared_error_sum / 3000) < 0.005, "stationary RMS error must be < 0.3 degree");
}

ZTEST(attitude_ekf, test_noisy_three_axis_trajectory_tracks_analytic_attitude) {
    auto config = testConfig();
    config.stationary_gyro_rad_s = 0.01f;
    const Vec3 bias{0.002f, -0.003f, 0.004f};
    Ekf filter(config);
    auto time = initialize(filter, config, {0, 0, gravity}, bias);
    double squared_error_sum = 0;
    for (unsigned i = 1; i <= 2500; ++i) {
        const double t = i * sample_s;
        const double roll = 0.25 * std::sin(0.7 * t), pitch = 0.18 * std::sin(0.5 * t), yaw = 0.45 * t;
        const double roll_rate = 0.175 * std::cos(0.7 * t), pitch_rate = 0.09 * std::cos(0.5 * t);
        const Vec3 rate{float(roll_rate - 0.45 * std::sin(pitch)),
                        float(pitch_rate * std::cos(roll) + 0.45 * std::sin(roll) * std::cos(pitch)),
                        float(-pitch_rate * std::sin(roll) + 0.45 * std::cos(roll) * std::cos(pitch))};
        const double phase = i * 0.173;
        const Vec3 accel_noise{float(0.02 * std::sin(phase)), float(0.025 * std::cos(phase * 1.3)),
                               float(0.015 * std::sin(phase * 0.7))};
        const Vec3 gyro_noise{float(0.002 * std::sin(phase * 0.9)), float(0.003 * std::cos(phase * 1.1)),
                              float(0.002 * std::sin(phase * 1.7))};
        time += sample_us;
        zassert_ok(
            filter.update({add(referenceGravity(roll, pitch), accel_noise), add(add(rate, bias), gyro_noise), time}));
        zassert_equal(filter.quality(), Ekf::Quality::Tracking);
        const auto expected = referenceAttitude(roll, pitch, yaw);
        assertAttitude(filter.attitude(), expected, 0.025); // < 1.5 degree through the whole motion.
        const double error = angularError(filter.attitude(), expected);
        squared_error_sum += error * error;
    }
    zassert_true(std::sqrt(squared_error_sum / 2500) < 0.015, "motion RMS error must be < 0.9 degree");
}

ZTEST(attitude_ekf, test_acceleration_magnitude_gate_preserves_prediction_and_recovers) {
    const auto config = testConfig();
    Ekf filter(config);
    auto time = initialize(filter, config);
    const auto generation = filter.generation();
    for (unsigned i = 1; i <= 100; ++i) {
        time += sample_us;
        zassert_ok(filter.update({{6, 0, gravity}, {0, 0, 1}, time}));
        zassert_equal(filter.quality(), Ekf::Quality::Degraded);
        assertAttitude(filter.attitude(), referenceAttitude(0, 0, i * sample_s), 0.002);
    }
    for (unsigned i = 0; i < 500; ++i) {
        time += sample_us;
        zassert_ok(filter.update({{0, 0, gravity}, {}, time}));
    }
    zassert_equal(filter.generation(), generation);
    zassert_equal(filter.quality(), Ekf::Quality::Tracking);
    assertAttitude(filter.attitude(), referenceAttitude(0, 0, 0.2), 0.025);
}

ZTEST(attitude_ekf, test_innovation_gate_rejects_direction_outlier_and_recovers) {
    auto config = testConfig();
    config.accel_tau_s = 0.00001f;
    config.innovation_gate = 0.05f;
    Ekf filter(config);
    auto time = initialize(filter, config);
    for (unsigned i = 0; i < 100; ++i) {
        time += sample_us;
        zassert_ok(filter.update({{0, 0, gravity}, {}, time}));
    }
    time += sample_us;
    // Its magnitude is exactly g, so only the innovation gate can reject it.
    zassert_ok(filter.update({{gravity, 0, 0}, {}, time}));
    zassert_equal(filter.quality(), Ekf::Quality::Degraded);
    assertAttitude(filter.attitude(), referenceAttitude(0, 0, 0), 0.001);
    for (unsigned i = 0; i < 20; ++i) {
        time += sample_us;
        zassert_ok(filter.update({{0, 0, gravity}, {}, time}));
    }
    zassert_equal(filter.quality(), Ekf::Quality::Tracking);
    assertAttitude(filter.attitude(), referenceAttitude(0, 0, 0), 0.002);
}

ZTEST(attitude_ekf, test_initialization_requires_consecutive_stationary_samples) {
    auto config = testConfig();
    config.initialization_samples = 5;
    Ekf filter(config);
    zassert_ok(filter.init());
    TimeUs time = 0;
    for (unsigned i = 0; i < 3; ++i) {
        time += sample_us;
        zassert_equal(filter.update({{0, 0, gravity}, {}, time}), -EAGAIN);
    }
    time += sample_us;
    zassert_equal(filter.update({{0, 0, gravity}, {0, 0, 1}, time}), -EAGAIN);
    for (unsigned i = 0; i < 5; ++i) {
        time += sample_us;
        zassert_equal(filter.update({referenceGravity(0.3, -0.2), {}, time}), i == 4 ? 0 : -EAGAIN);
    }
    assertAttitude(filter.attitude(), referenceAttitude(0.3, -0.2, 0), 1e-4);
}

ZTEST(attitude_ekf, test_time_bounds_stale_timestamps_and_gap_reset) {
    auto config = testConfig();
    config.dt_min_s = 0.001f;
    config.dt_max_s = 0.01f;
    Ekf filter(config);
    auto time = initialize(filter, config);
    const auto generation = filter.generation();
    zassert_equal(filter.update({{0, 0, gravity}, {}, time}), -ESTALE);
    zassert_equal(filter.update({{0, 0, gravity}, {}, time - 1}), -ESTALE);
    zassert_equal(filter.update({{0, 0, gravity}, {}, time + 500}), -EAGAIN);
    time += 1000; // Rejected short samples must not advance the accepted timestamp.
    zassert_ok(filter.update({{0, 0, gravity}, {}, time}));
    time += 10000;
    zassert_ok(filter.update({{0, 0, gravity}, {}, time}));
    zassert_equal(filter.generation(), generation);
    time += 10001;
    zassert_equal(filter.update({{0, 0, gravity}, {}, time}), -EAGAIN);
    zassert_equal(filter.generation(), generation + 1);
    zassert_equal(filter.quality(), Ekf::Quality::Initializing);
    assertAttitude(filter.attitude(), referenceAttitude(0, 0, 0), 1e-4);
    for (unsigned i = 0; i < config.initialization_samples; ++i) {
        time += sample_us;
        zassert_equal(filter.update({referenceGravity(-0.4, 0.1), {}, time}),
                      i + 1 == config.initialization_samples ? 0 : -EAGAIN);
    }
    assertAttitude(filter.attitude(), referenceAttitude(-0.4, 0.1, 0), 1e-4);
}

ZTEST(attitude_ekf, test_init_contract_and_invalid_configuration) {
    const auto good = testConfig();
    Ekf uninitialized(good);
    zassert_equal(uninitialized.generation(), 0);
    zassert_equal(uninitialized.update({{0, 0, gravity}, {}, sample_us}), -EACCES);
    zassert_ok(uninitialized.init());
    const auto generation = uninitialized.generation();
    zassert_true(generation > 0);
    zassert_equal(uninitialized.init(), -EALREADY);
    zassert_equal(uninitialized.generation(), generation);

    float Ekf::Config::*members[] = {
        &Ekf::Config::dt_min_s,        &Ekf::Config::dt_max_s,      &Ekf::Config::gravity_m_s2,
        &Ekf::Config::accel_gate_m_s2, &Ekf::Config::process_noise, &Ekf::Config::measurement_noise,
        &Ekf::Config::innovation_gate, &Ekf::Config::accel_tau_s,   &Ekf::Config::stationary_gyro_rad_s,
        &Ekf::Config::bias_tau_s,
    };
    const float invalid[] = {0, -1, std::numeric_limits<float>::quiet_NaN(), std::numeric_limits<float>::infinity()};
    for (auto member : members)
        for (float value : invalid) {
            auto config = good;
            config.*member = value;
            Ekf filter(config);
            zassert_equal(filter.init(), -EINVAL);
            zassert_equal(filter.generation(), 0);
        }
    auto reversed = good;
    reversed.dt_min_s = reversed.dt_max_s * 2;
    Ekf invalid_interval(reversed);
    zassert_equal(invalid_interval.init(), -EINVAL);
    auto too_few = good;
    too_few.initialization_samples = 1;
    Ekf invalid_samples(too_few);
    zassert_equal(invalid_samples.init(), -EINVAL);
}

ZTEST(attitude_ekf, test_invalid_samples_do_not_consume_time_and_range_error_resets) {
    const auto config = testConfig();
    Ekf filter(config);
    auto time = initialize(filter, config);
    const auto generation = filter.generation();
    const auto expected = referenceAttitude(0, 0, 0);
    time += sample_us;
    const float nan = std::numeric_limits<float>::quiet_NaN();
    const float infinity = std::numeric_limits<float>::infinity();
    zassert_equal(filter.update({{nan, 0, gravity}, {}, time}), -EINVAL);
    zassert_equal(filter.update({{0, 0, gravity}, {0, infinity, 0}, time}), -EINVAL);
    zassert_equal(filter.generation(), generation);
    assertAttitude(filter.attitude(), expected, 1e-4);
    zassert_ok(filter.update({{0, 0, gravity}, {}, time}));
    time += sample_us;
    const float huge = std::numeric_limits<float>::max();
    zassert_equal(filter.update({{huge, huge, huge}, {}, time}), -ERANGE);
    zassert_equal(filter.generation(), generation + 1);
    zassert_equal(filter.quality(), Ekf::Quality::Initializing);
    assertAttitude(filter.attitude(), expected, 1e-4);
}

ZTEST(attitude_ekf, test_manual_reset_clears_previous_attitude_bias_and_history) {
    const auto config = testConfig();
    Ekf filter(config);
    auto time = initialize(filter, config, referenceGravity(0.6, -0.3), {0.01f, 0.02f, -0.03f});
    const auto generation = filter.generation();
    filter.reset();
    zassert_equal(filter.generation(), generation + 1);
    zassert_equal(filter.quality(), Ekf::Quality::Initializing);
    assertAttitude(filter.attitude(), referenceAttitude(0, 0, 0), 1e-4);
    // A fresh stream is allowed to start with an earlier timestamp after reset.
    time = 0;
    for (unsigned i = 0; i < config.initialization_samples; ++i) {
        time += sample_us;
        zassert_equal(filter.update({{0, 0, gravity}, {}, time}), i + 1 == config.initialization_samples ? 0 : -EAGAIN);
    }
    for (unsigned i = 0; i < 1000; ++i) {
        time += sample_us;
        zassert_ok(filter.update({{0, 0, gravity}, {}, time}));
    }
    assertAttitude(filter.attitude(), referenceAttitude(0, 0, 0), 0.002);
}

ZTEST(attitude_ekf, test_benchmark_tracking_update) {
    const auto config = testConfig();
    Ekf filter(config);
    auto time = initialize(filter, config);
    int last_status = 0;
    unsigned failures = 0;
    Ekf::Input input{{0, 0, gravity}, {}, time};
    skywalker::test::benchmark("ekf.update.tracking", 4000, [&](std::uint32_t) {
        input.time_us += sample_us;
        last_status = filter.update(input);
        failures += last_status != 0 || filter.quality() != Ekf::Quality::Tracking;
    });
    zassert_ok(last_status);
    zassert_equal(failures, 0);
    assertAttitude(filter.attitude(), referenceAttitude(0, 0, 0), 0.002);
}

ZTEST(attitude_ekf, test_benchmark_degraded_prediction_update) {
    const auto config = testConfig();
    Ekf filter(config);
    auto time = initialize(filter, config);
    int last_status = 0;
    unsigned failures = 0, calls = 0;
    Ekf::Input input{{0, 0, 2 * gravity}, {0, 0, 0.8f}, time};
    skywalker::test::benchmark("ekf.update.degraded", 4000, [&](std::uint32_t) {
        input.time_us += sample_us;
        last_status = filter.update(input);
        failures += last_status != 0 || filter.quality() != Ekf::Quality::Degraded;
        ++calls;
    });
    zassert_ok(last_status);
    zassert_equal(failures, 0);
    // Include warmup calls in the expected trajectory, without timing trig.
    assertAttitude(filter.attitude(), referenceAttitude(0, 0, 0.8 * calls * sample_s), 0.01);
}

ZTEST_SUITE(attitude_ekf, nullptr, nullptr, nullptr, nullptr, nullptr);
```

## src/core_attitude.cpp
```c
#include <benchmark.hpp>
#include <core/attitude.hpp>
#include <zephyr/ztest.h>
#include <array>
#include <cmath>
#include <cstdint>
#include <limits>

namespace {
namespace core = skywalker::core;
constexpr float pi = 3.14159265358979323846f;
constexpr float half_sqrt = 0.7071067811865475244f;

void assertQuaternion(core::Quaternion actual, core::Quaternion expected, float tolerance = 2e-6f) {
    zassert_true(core::finite(actual));
    zassert_within(actual.w, expected.w, tolerance);
    zassert_within(actual.x, expected.x, tolerance);
    zassert_within(actual.y, expected.y, tolerance);
    zassert_within(actual.z, expected.z, tolerance);
}

void assertVector(core::Vec3 actual, core::Vec3 expected, float tolerance = 2e-6f) {
    zassert_true(core::finite(actual));
    zassert_within(actual.x, expected.x, tolerance);
    zassert_within(actual.y, expected.y, tolerance);
    zassert_within(actual.z, expected.z, tolerance);
}
}

ZTEST(core_attitude, test_finite_norm_and_normalization_contract) {
    zassert_true(core::finite(core::Vec3{3, 4, 12}));
    zassert_within(core::norm({3, 4, 12}), 13.0f, 1e-6f);
    zassert_false(core::finite(core::Vec3{0, std::numeric_limits<float>::quiet_NaN(), 0}));
    zassert_false(core::finite(core::Quaternion{1, 0, 0, std::numeric_limits<float>::infinity()}));
    core::Quaternion slight_error{1.02f, 0, 0, 0};
    zassert_true(core::normalize(slight_error));
    assertQuaternion(slight_error, {1, 0, 0, 0});
    const std::array<core::Quaternion, 5> corrupt{{
        {0, 0, 0, 0}, {1e-6f, 0, 0, 0}, {2, 0, 0, 0},
        {std::numeric_limits<float>::quiet_NaN(), 0, 0, 0},
        {1, std::numeric_limits<float>::infinity(), 0, 0},
    }};
    for (auto value : corrupt)
        zassert_false(core::normalize(value));
}

ZTEST(core_attitude, test_hamilton_product_and_conjugate_known_values) {
    const core::Quaternion x90{half_sqrt, half_sqrt, 0, 0};
    const core::Quaternion y90{half_sqrt, 0, half_sqrt, 0};
    assertQuaternion(core::multiply(x90, y90), {0.5f, 0.5f, 0.5f, 0.5f});
    assertQuaternion(core::multiply(y90, x90), {0.5f, 0.5f, 0.5f, -0.5f});
    assertQuaternion(core::conjugate({0.5f, 0.5f, -0.5f, 0.5f}), {0.5f, -0.5f, 0.5f, -0.5f});
    assertQuaternion(core::multiply({1, 0, 0, 0}, x90), x90);
}

ZTEST(core_attitude, test_axis_rotation_matches_right_handed_basis_vectors) {
    const core::Quaternion z90{half_sqrt, 0, 0, half_sqrt};
    assertVector(core::rotate(z90, {1, 0, 0}), {0, 1, 0});
    assertVector(core::rotate(z90, {0, 1, 0}), {-1, 0, 0});
    assertVector(core::rotate(z90, {0, 0, 1}), {0, 0, 1});
    assertVector(core::rotate({half_sqrt, half_sqrt, 0, 0}, {0, 1, 0}), {0, 0, 1});
    assertVector(core::rotate({half_sqrt, 0, half_sqrt, 0}, {0, 0, 1}), {1, 0, 0});
    assertVector(core::rotate({-half_sqrt, 0, 0, -half_sqrt}, {1, 0, 0}), {0, 1, 0});
}

ZTEST(core_attitude, test_rotation_matches_independent_zyx_matrix) {
    constexpr double roll = 0.4, pitch = -0.3, yaw = 0.7;
    const double cr = std::cos(roll), sr = std::sin(roll);
    const double cp = std::cos(pitch), sp = std::sin(pitch);
    const double cy = std::cos(yaw), sy = std::sin(yaw);
    const core::Vec3 input{1.2f, -0.7f, 2.3f};
    const core::Vec3 expected{
        float(cy * cp * double(input.x) + (cy * sp * sr - sy * cr) * double(input.y) +
              (cy * sp * cr + sy * sr) * double(input.z)),
        float(sy * cp * double(input.x) + (sy * sp * sr + cy * cr) * double(input.y) +
              (sy * sp * cr - cy * sr) * double(input.z)),
        float(-sp * double(input.x) + cp * sr * double(input.y) + cp * cr * double(input.z)),
    };
    const auto attitude = core::fromEuler({float(roll), float(pitch), float(yaw)});
    assertVector(core::rotate(attitude, input), expected, 3e-6f);
}

ZTEST(core_attitude, test_euler_conversion_known_attitudes_and_pitch_clamp) {
    assertQuaternion(core::fromEuler({0, 0, 0}), {1, 0, 0, 0});
    assertQuaternion(core::fromEuler({pi / 2, 0, 0}), {half_sqrt, half_sqrt, 0, 0});
    assertQuaternion(core::fromEuler({0, -pi / 2, 0}), {half_sqrt, 0, -half_sqrt, 0});
    assertQuaternion(core::fromEuler({0, 0, pi / 2}), {half_sqrt, 0, 0, half_sqrt});
    assertQuaternion(core::fromEuler({pi / 2, 0, pi / 2}), {0.5f, 0.5f, 0.5f, 0.5f});

    const auto angles = core::euler({0.5f, 0.5f, 0.5f, 0.5f});
    zassert_within(angles.roll, pi / 2, 2e-6f);
    zassert_within(angles.pitch, 0.0f, 2e-6f);
    zassert_within(angles.yaw, pi / 2, 2e-6f);
    const auto negative_yaw = core::euler({half_sqrt, 0, 0, -half_sqrt});
    zassert_within(negative_yaw.yaw, -pi / 2, 2e-6f);
    // Rounding can place sin(pitch) just above one at the singularity.
    const auto pole = core::euler({half_sqrt, 0, half_sqrt * 1.000001f, 0});
    zassert_true(std::isfinite(pole.pitch));
    zassert_within(pole.pitch, pi / 2, 2e-6f);
}

ZTEST(core_attitude, test_benchmark_rotate) {
    const core::Quaternion attitude{half_sqrt, 0, 0, half_sqrt};
    const std::array<core::Vec3, 3> inputs{{{1, 0, 0}, {0, 1, 0}, {0, 0, 1}}};
    const std::array<core::Vec3, 3> expected{{{0, 1, 0}, {-1, 0, 0}, {0, 0, 1}}};
    core::Vec3 output{};
    std::uint32_t last_index = 0;
    skywalker::test::benchmark("attitude.rotate", 6000, [&](std::uint32_t index) {
        last_index = index % inputs.size();
        auto measured_attitude = attitude;
        auto measured_input = inputs[last_index];
        skywalker::test::doNotOptimize(measured_attitude);
        skywalker::test::doNotOptimize(measured_input);
        output = core::rotate(measured_attitude, measured_input);
        skywalker::test::doNotOptimize(output);
    });
    assertVector(output, expected[last_index]);
}

ZTEST_SUITE(core_attitude, nullptr, nullptr, nullptr, nullptr, nullptr);
```

## src/kalman_matrix.cpp
```c
#include <zephyr/ztest.h>
#include <benchmark.hpp>
#include <control/kalman_filter.h>
#include <cerrno>
#include <cmath>
#include <cstring>

namespace {
template <unsigned N, unsigned M> struct Filter {
    float f[N * N]{}, h[N * M]{}, r[M * M]{}, x[N]{}, p[N * N]{}, q[N * N]{}, k[N * M]{};
    KalmanFilter value{};
    KalmanBuffers buffers() {
        return {{f, N * N}, {h, N * M}, {r, M * M}, {x, N}, {p, N * N}, {q, N * N}, {k, N * M}};
    }
    void init() {
        auto storage = buffers();
        zassert_ok(KalmanFilter_Init(&value, N, M, &storage));
    }
};
void expect_values(const float *actual, const float *expected, unsigned count, float tolerance = 1e-5f) {
    for (unsigned i = 0; i < count; ++i) {
        zassert_true(std::isfinite(actual[i]), "nonfinite element %u", i);
        zassert_within(actual[i], expected[i], tolerance, "element %u", i);
    }
}
}

ZTEST(matrix_math, test_rectangular_helpers) {
    float data[6] = {1, 2, 3, 4, 5, 6};
    Matrix matrix;
    Matrix_Init(&matrix, 2, 3, data);
    Matrix_SetDiag(&matrix, 2.5f);
    const float diagonal[] = {2.5f, 0, 0, 0, 2.5f, 0};
    expect_values(data, diagonal, 6);
    Matrix_Zero(&matrix);
    const float zero[6]{};
    expect_values(data, zero, 6);
}

ZTEST(matrix_math, test_rectangular_product_and_transpose) {
    float left[] = {1, 2, 3, 4, 5, 6}, right[] = {7, 8, 9, 10, 11, 12};
    float result[4]{}, transpose[6]{};
    Matrix a, b, c, at;
    Matrix_Init(&a, 2, 3, left);
    Matrix_Init(&b, 3, 2, right);
    Matrix_Init(&c, 2, 2, result);
    Matrix_Init(&at, 3, 2, transpose);
    zassert_equal(Matrix_Multiply(&a, &b, &c), ARM_MATH_SUCCESS);
    const float product[] = {58, 64, 139, 154};
    expect_values(result, product, 4);
    zassert_equal(Matrix_Transpose(&a, &at), ARM_MATH_SUCCESS);
    const float transposed[] = {1, 4, 2, 5, 3, 6};
    expect_values(transpose, transposed, 6);
}

ZTEST(matrix_math, test_addition_subtraction_and_alias) {
    float left[] = {1, -2, 3, -4}, right[] = {-2, 3, 0.5f, 4}, result[4]{};
    Matrix a, b, out;
    Matrix_Init(&a, 2, 2, left);
    Matrix_Init(&b, 2, 2, right);
    Matrix_Init(&out, 2, 2, result);
    zassert_equal(Matrix_Add(&a, &b, &out), ARM_MATH_SUCCESS);
    const float sum[] = {-1, 1, 3.5f, 0};
    expect_values(result, sum, 4);
    zassert_equal(Matrix_Subtract(&out, &b, &out), ARM_MATH_SUCCESS);
    expect_values(result, left, 4);
}

ZTEST(matrix_math, test_inverse_known_solution_and_identity) {
    const float original[] = {3, 0, 2, 2, 0, -2, 0, 1, 1};
    float working[9], inverse[9]{}, identity[9]{};
    std::memcpy(working, original, sizeof(working));
    Matrix a, ai, product;
    Matrix_Init(&a, 3, 3, working);
    Matrix_Init(&ai, 3, 3, inverse);
    Matrix_Init(&product, 3, 3, identity);
    zassert_equal(Matrix_Inverse(&a, &ai), ARM_MATH_SUCCESS);
    const float expected[] = {0.2f, 0.2f, 0, -0.2f, 0.3f, 1, 0.2f, -0.3f, 0};
    expect_values(inverse, expected, 9);
    // CMSIS inversion can modify the source; restore before A * inverse(A).
    std::memcpy(working, original, sizeof(working));
    zassert_equal(Matrix_Multiply(&a, &ai, &product), ARM_MATH_SUCCESS);
    const float unit[] = {1, 0, 0, 0, 1, 0, 0, 0, 1};
    expect_values(identity, unit, 9);
}

ZTEST(matrix_math, test_singular_and_dimension_errors) {
    float singular[] = {1, 2, 2, 4}, result[4]{}, bad_data[6]{};
    Matrix a, out, bad;
    Matrix_Init(&a, 2, 2, singular);
    Matrix_Init(&out, 2, 2, result);
    Matrix_Init(&bad, 3, 2, bad_data);
    zassert_equal(Matrix_Inverse(&a, &out), ARM_MATH_SINGULAR);
    zassert_equal(Matrix_Multiply(&a, &bad, &out), ARM_MATH_SIZE_MISMATCH);
    zassert_equal(Matrix_Add(&a, &bad, &out), ARM_MATH_SIZE_MISMATCH);
    zassert_equal(Matrix_Transpose(&a, &bad), ARM_MATH_SIZE_MISMATCH);
}

ZTEST(matrix_math, test_benchmark_product_and_inverse) {
    float a_data[] = {4, 1, 0, 0, 1, 4, 1, 0, 0, 1, 4, 1, 0, 0, 1, 4};
    float b_data[] = {1, 0, 0, 0, 0, 1, 0, 0, 0, 0, 1, 0, 0, 0, 0, 1}, product[16]{};
    Matrix a, b, out;
    Matrix_Init(&a, 4, 4, a_data);
    Matrix_Init(&b, 4, 4, b_data);
    Matrix_Init(&out, 4, 4, product);
    int failures = 0;
    skywalker::test::benchmark("matrix.multiply.4x4", 4096,
                               [&](std::uint32_t) { failures += Matrix_Multiply(&a, &b, &out) != ARM_MATH_SUCCESS; });
    zassert_equal(failures, 0);
    expect_values(product, a_data, 16);
    const float input[] = {4, 7, 2, 6};
    float scratch[4], inverse[4]{};
    Matrix_Init(&a, 2, 2, scratch);
    Matrix_Init(&out, 2, 2, inverse);
    skywalker::test::benchmark("matrix.inverse.2x2_with_input_copy", 4096, [&](std::uint32_t) {
        std::memcpy(scratch, input, sizeof(scratch));
        failures += Matrix_Inverse(&a, &out) != ARM_MATH_SUCCESS;
    });
    zassert_equal(failures, 0);
    const float expected[] = {0.6f, -0.7f, -0.2f, 0.4f};
    expect_values(inverse, expected, 4);
}

ZTEST(linear_kalman, test_default_model_rectangular_storage) {
    Filter<3, 2> filter;
    filter.init();
    zassert_equal(filter.value.F.pData, filter.f);
    zassert_equal(filter.value.X.pData, filter.x);
    zassert_equal(filter.value.H.numRows, 2);
    zassert_equal(filter.value.H.numCols, 3);
    zassert_equal(filter.value.K.numRows, 3);
    zassert_equal(filter.value.K.numCols, 2);
    const float identity[] = {1, 0, 0, 0, 1, 0, 0, 0, 1};
    const float observation[] = {1, 0, 0, 0, 1, 0};
    expect_values(filter.f, identity, 9);
    expect_values(filter.h, observation, 6);
    for (unsigned i = 0; i < 9; ++i) {
        zassert_within(filter.p[i], identity[i] * 1000, 1e-6f);
        zassert_within(filter.q[i], identity[i] * 0.001f, 1e-6f);
    }
    const float noise[] = {1, 0, 0, 1}, zero3[3]{}, zero6[6]{};
    expect_values(filter.r, noise, 4);
    expect_values(filter.x, zero3, 3);
    expect_values(filter.k, zero6, 6);

    Filter<2, 3> more_measurements;
    more_measurements.init();
    const float tall_observation[] = {1, 0, 0, 1, 0, 0};
    expect_values(more_measurements.h, tall_observation, 6);
}

ZTEST(linear_kalman, test_rejects_invalid_storage_without_mutation) {
    Filter<2, 1> filter;
    filter.init();
    filter.x[0] = 17;
    filter.f[1] = 2;
    const auto before = filter.value;
    auto storage = filter.buffers();
    zassert_equal(KalmanFilter_Init(nullptr, 2, 1, &storage), -EINVAL);
    zassert_equal(KalmanFilter_Init(&filter.value, 0, 1, &storage), -EINVAL);
    zassert_equal(KalmanFilter_Init(&filter.value, 2, 0, &storage), -EINVAL);
    zassert_equal(KalmanFilter_Init(&filter.value, 2, 1, nullptr), -EINVAL);
    zassert_equal(KalmanFilter_Init(&filter.value, 65535, 65535, &storage), -EOVERFLOW);
    KalmanBuffer *buffers[] = {&storage.F, &storage.H, &storage.R, &storage.X, &storage.P, &storage.Q, &storage.K};
    for (auto buffer : buffers) {
        const auto saved = *buffer;
        buffer->data = nullptr;
        zassert_equal(KalmanFilter_Init(&filter.value, 2, 1, &storage), -EINVAL);
        *buffer = saved;
        buffer->capacity = saved.capacity - 1;
        zassert_equal(KalmanFilter_Init(&filter.value, 2, 1, &storage), -ENOSPC);
        *buffer = saved;
    }
    zassert_mem_equal(&filter.value, &before, sizeof(before));
    zassert_equal(filter.x[0], 17);
    zassert_equal(filter.f[1], 2);
}

ZTEST(linear_kalman, test_scalar_closed_form) {
    Filter<1, 1> filter;
    filter.init();
    filter.p[0] = 4;
    filter.q[0] = 1;
    filter.r[0] = 3;
    float observation = 2;
    Matrix z;
    Matrix_Init(&z, 1, 1, &observation);
    KalmanFilter_Predict(&filter.value);
    zassert_equal(filter.p[0], 5);
    KalmanFilter_Correct(&filter.value, &z);
    zassert_within(filter.k[0], 5.0f / 8, 1e-6f);
    zassert_within(filter.x[0], 5.0f / 4, 1e-6f);
    zassert_within(filter.p[0], 15.0f / 8, 1e-6f);
}

ZTEST(linear_kalman, test_constant_velocity_known_prediction_and_correction) {
    Filter<2, 1> filter;
    filter.init();
    filter.f[1] = 0.5f;
    filter.x[0] = 1;
    filter.x[1] = 2;
    const float covariance[] = {4, 1, 1, 3};
    std::memcpy(filter.p, covariance, sizeof(covariance));
    filter.q[0] = 0.1f;
    filter.q[3] = 0.2f;
    filter.r[0] = 0.5f;
    KalmanFilter_Predict(&filter.value);
    const float predicted_x[] = {2, 2}, predicted_p[] = {5.85f, 2.5f, 2.5f, 3.2f};
    expect_values(filter.x, predicted_x, 2);
    expect_values(filter.p, predicted_p, 4);
    float observation = 3;
    Matrix z;
    Matrix_Init(&z, 1, 1, &observation);
    KalmanFilter_Correct(&filter.value, &z);
    const float gain[] = {117.0f / 127, 50.0f / 127};
    const float corrected_x[] = {371.0f / 127, 304.0f / 127};
    const float corrected_p[] = {117.0f / 254, 25.0f / 127, 25.0f / 127, 1407.0f / 635};
    expect_values(filter.k, gain, 2);
    expect_values(filter.x, corrected_x, 2);
    expect_values(filter.p, corrected_p, 4);
}

ZTEST(linear_kalman, test_coupled_two_channel_observation) {
    Filter<2, 2> filter;
    filter.init();
    filter.h[1] = 1;
    filter.x[0] = 1;
    filter.x[1] = -1;
    filter.p[0] = 2;
    filter.p[3] = 3;
    Matrix_Zero(&filter.value.Q);
    filter.r[3] = 2;
    float observation[] = {2, 0};
    Matrix z;
    Matrix_Init(&z, 2, 1, observation);
    KalmanFilter_Predict(&filter.value);
    KalmanFilter_Correct(&filter.value, &z);
    // S = [6 3; 3 5], det(S) = 21. These are exact rational solutions.
    const float gain[] = {10.0f / 21, -6.0f / 21, 6.0f / 21, 9.0f / 21};
    const float state[] = {5.0f / 3, 0};
    const float covariance[] = {22.0f / 21, -4.0f / 7, -4.0f / 7, 6.0f / 7};
    expect_values(filter.k, gain, 4);
    expect_values(filter.x, state, 2);
    expect_values(filter.p, covariance, 4);
}

ZTEST(linear_kalman, test_noisy_constant_reduces_rmse_and_matches_double_reference) {
    Filter<1, 1> filter;
    filter.init();
    filter.p[0] = 1;
    filter.q[0] = 0.001f;
    filter.r[0] = 0.25f;
    double reference_x = 0, reference_p = 1, raw_error = 0, estimate_error = 0;
    constexpr float truth = 3;
    const float noise[] = {-0.6f, 0.4f, -0.2f, 0.7f, -0.3f};
    float observation = 0;
    Matrix z;
    Matrix_Init(&z, 1, 1, &observation);
    for (unsigned i = 0; i < 1000; ++i) {
        observation = truth + noise[i % 5];
        reference_p += 0.001;
        const double gain = reference_p / (reference_p + 0.25);
        reference_x += gain * (double(observation) - reference_x);
        reference_p *= 1 - gain;
        KalmanFilter_Predict(&filter.value);
        KalmanFilter_Correct(&filter.value, &z);
        zassert_within(double(filter.x[0]), reference_x, 2e-5);
        zassert_within(double(filter.p[0]), reference_p, 2e-6);
        zassert_true(filter.p[0] >= 0);
        if (i >= 100) {
            const double raw_residual = double(observation) - double(truth);
            const double estimate_residual = double(filter.x[0]) - double(truth);
            raw_error += raw_residual * raw_residual;
            estimate_error += estimate_residual * estimate_residual;
        }
    }
    zassert_true(std::sqrt(estimate_error / raw_error) < 0.2, "filtered RMSE must be below 20%% of measurement RMSE");
}

ZTEST(linear_kalman, test_instances_and_reinitialization_are_independent) {
    Filter<1, 1> first, second;
    first.init();
    second.init();
    first.x[0] = 10;
    second.x[0] = -5;
    first.f[0] = 2;
    KalmanFilter_Predict(&first.value);
    zassert_equal(first.x[0], 20);
    zassert_equal(second.x[0], -5);
    zassert_equal(second.p[0], 1000);
    first.init();
    zassert_equal(first.x[0], 0);
    zassert_equal(first.f[0], 1);
    zassert_equal(second.x[0], -5);
}

ZTEST(linear_kalman, test_benchmark_predict_correct) {
    Filter<2, 1> filter;
    filter.init();
    filter.f[1] = 0.001f;
    filter.r[0] = 0.1f;
    float observation = 0;
    Matrix z;
    Matrix_Init(&z, 1, 1, &observation);
    skywalker::test::benchmark("kalman.predict_correct.n2_m1", 4096, [&](std::uint32_t) {
        KalmanFilter_Predict(&filter.value);
        KalmanFilter_Correct(&filter.value, &z);
    });
    zassert_equal(filter.x[0], 0);
    zassert_equal(filter.x[1], 0);
    for (float v : filter.p) {
        zassert_true(std::isfinite(v));
    }
    zassert_true(filter.p[0] > 0 && filter.p[3] > 0);
    zassert_within(filter.p[1], filter.p[2], 1e-5f);
}

ZTEST_SUITE(matrix_math, nullptr, nullptr, nullptr, nullptr, nullptr);
ZTEST_SUITE(linear_kalman, nullptr, nullptr, nullptr, nullptr, nullptr);
```
