## CMakeLists.txt
```
cmake_minimum_required(VERSION 3.20.0)
set(INSTALLED_CONFIG ${CMAKE_CURRENT_LIST_DIR}/../../config/vehicle/installed)
set(CONF_FILE ${INSTALLED_CONFIG}/base.conf ${INSTALLED_CONFIG}/chassis.conf ${CMAKE_CURRENT_LIST_DIR}/prj.conf)
find_package(Zephyr REQUIRED HINTS $ENV{ZEPHYR_BASE})
project(sentry_chassis)
target_sources(app PRIVATE src/main.cpp)
```

## Kconfig
```
mainmenu "SkyWalker sentry chassis"
source "Kconfig.zephyr"
```

## prj.conf
```kconfig
# Fixed manual application; select a different source directory for bring-up.
# Enable the status LED only in apps which actually use it.
CONFIG_SKYWALKER_STATUS_LED=y
CONFIG_SKYWALKER_DRIVER_MOTOR=y
CONFIG_SKYWALKER_MOTOR_DJI=y
CONFIG_SKYWALKER_MOTOR_DM=y
CONFIG_SKYWALKER_LIB_CONTROL=y
CONFIG_SKYWALKER_LIB_MOTOR_CONTROL=y
CONFIG_SKYWALKER_LIB_COMMUNICATION=y
CONFIG_SKYWALKER_UART_TRANSPORT=y
CONFIG_SKYWALKER_REFEREE=y
CONFIG_SKYWALKER_INTERBOARD_ENDPOINT=y
CONFIG_SKYWALKER_LIB_ROBOTICS=y
CONFIG_SKYWALKER_ROBOTICS_SWERVE=y
CONFIG_SKYWALKER_ROBOTICS_BIG_YAW=y

# Existing BMI088 acquisition/estimator reused for optional frame compensation.
CONFIG_SENSOR=y
CONFIG_BMI08X=y
CONFIG_SKYWALKER_IMU=y
CONFIG_SKYWALKER_IMU_BMI088=y
CONFIG_SKYWALKER_IMU_RECEIVER=y
CONFIG_SKYWALKER_ATTITUDE_EKF=y
```

## vision_execute.conf
```kconfig
CONFIG_VEHICLE_VISION_EXECUTE=y
CONFIG_VEHICLE_LOCK_PITCH=n
```

## vision_observe.conf
```kconfig
CONFIG_VEHICLE_VISION_OBSERVE=y
```

## app.overlay
```dts
#include "../../config/vehicle/installed/chassis.overlay"
```

## src/main.cpp
```c
#include <algorithm>
#include <cerrno>
#include <cmath>
#include <limits>
#include <communication/interboard/configured_interboard_transport.hpp>
#include <communication/interboard/interboard_endpoint.hpp>
#include <communication/referee/referee_receiver.hpp>
#include <core/clock.hpp>
#include <drivers/imu/bmi088_imu.hpp>
#include <drivers/imu/imu_receiver.hpp>
#include <robotics/vehicle/motion_profile.hpp>
#include <robotics/chassis/reference_v4_motion.hpp>
#include <drivers/motor/can_bus.hpp>
#include <robotics/execution/big_yaw_heading_follower.hpp>
#include <robotics/vehicle/big_yaw_profile.hpp>
#include <robotics/vehicle/chassis_profile.hpp>
#include <robotics/vehicle/diagnostics.hpp>
#include <robotics/vehicle/led_status.hpp>
#include <drivers/led/status_led.hpp>
#include <zephyr/drivers/regulator.h>

namespace {
using namespace skywalker;
using namespace robotics;
namespace installed = robotics::vehicle;
communication::AsyncUart::DmaBuffers link_dma __nocache;
enum class BigYawGate : std::uint8_t {
    None = 0,
    PeerDisabled = 1,
    BodyGyro = 3,
    PeerImu = 4,
    MissingRequest = 5,
};
std::uint32_t age(const MessageStamp &stamp, std::uint64_t now_ms) {
    return stamp.valid && now_ms >= stamp.timestamp_ms
               ? static_cast<std::uint32_t>(std::min<std::uint64_t>(now_ms - stamp.timestamp_ms, UINT32_MAX))
               : UINT32_MAX;
}
} // namespace

int main() {
    static installed::Diagnostics diagnostics;
    diagnostics.start("sentry_chassis", "chassis", "steer=0.8A; drive=0.5A; big-yaw joint limit=installed profile");
    static led::StatusLed status_led;
    const int status_led_error = status_led.start();
    if constexpr (led::StatusLed::available)
        diagnostics.event("status_led", status_led_error);
    (void)status_led.setStatus(led::LedStatus::Initializing);
    static communication::ConfiguredInterBoardTransport transport({.kind = communication::InterBoardTransportKind::Uart,
                                                                   .uart = DEVICE_DT_GET(DT_ALIAS(interboard_uart))},
                                                                  &link_dma);
    static communication::InterBoardEndpoint endpoint(transport, {BoardRole::ChassisController});
    static communication::AsyncUart::DmaBuffers referee_dma __nocache;
    static communication::RefereeReceiver referee(DEVICE_DT_GET(DT_ALIAS(referee_uart)), referee_dma);
    referee.setFrameHandler(
        [](const std::uint8_t *bytes, std::size_t size, void *context) {
            auto &link = *static_cast<communication::InterBoardEndpoint *>(context);
            (void)link.submitRefereeFrame(bytes, size, core::monotonicTimeUs() / 1000);
        },
        &endpoint);
    static motor::Motor s0(installed::steerHardware(0)), s1(installed::steerHardware(1)),
        s2(installed::steerHardware(2)), s3(installed::steerHardware(3));
    static motor::Motor d0(installed::wheelHardware(0)), d1(installed::wheelHardware(1)),
        d2(installed::wheelHardware(2)), d3(installed::wheelHardware(3));
    static motor::Motor big_drive(installed::bigYawHardware());
    static motor::Group wheels(s0, s1, s2, s3, d0, d1, d2, d3);
    static motor::CanBus steer_bus(DEVICE_DT_GET(DT_NODELABEL(can1))), drive_bus(DEVICE_DT_GET(DT_NODELABEL(can2))),
        big_bus(DEVICE_DT_GET(DT_NODELABEL(can3)));
    static SwerveHardware hardware({{&s0, &s1, &s2, &s3, &d0, &d1, &d2, &d3}}, wheels,
                                   installed::swerveHardwareConfig());
    static ChassisExecutor chassis(hardware, installed::swerveConfig(), installed::chassisExecutionConfig());
    static control::QuaternionEkf estimator({});
    static imu::Bmi088Imu body_source(DEVICE_DT_GET(DT_ALIAS(accel0)), DEVICE_DT_GET(DT_ALIAS(gyro0)),
                                      {.reference = installed::chassis_reference,
                                       .sensor_to_body = installed::chassis_sensor_to_body},
                                      &estimator);
    static imu::ImuReceiver body(body_source, {.poll_interval_us = 500, .priority = 5});
    static ImuHeadingReference body_heading;
    static ChassisMotionAdapter motion(installed::chassisMotionConfig());
    // Reference mode=1 requires BMI088 body yaw-rate compensation.
    const bool need_body = true;
    const int body_error = need_body ? body.start() : 0;
    static const auto big_yaw_config = installed::bigYawExecutionConfig();
    // One owner for the world-heading capture/integral. The executor keeps the
    // native velocity backend, sign, ratio, slew and command limits.
    static BigYawWorldHeadingFollower heading_follower(installed::bigYawHeadingFollowerConfig());
    static BigYawExecutor big_axis(big_drive, installed::bigYawMotorConfig(), big_yaw_config);
    int steer_error = installed::connections_confirmed ? steer_bus.attach(s0, s1, s2, s3) : -ENODEV;
    int drive_error = installed::connections_confirmed ? drive_bus.attach(d0, d1, d2, d3) : -ENODEV;
    int big_error = installed::connections_confirmed ? big_bus.attach(big_drive) : -ENODEV;
    if (steer_error == 0)
        steer_error = steer_bus.start();
    if (drive_error == 0)
        drive_error = drive_bus.start();
    if (big_error == 0)
        big_error = big_bus.start();
    const bool steer_started = steer_error == 0, drive_started = drive_error == 0, big_started = big_error == 0;
    const int chassis_error = steer_started && drive_started ? chassis.begin() : -ENODEV;
    if (big_error == 0)
        big_error = big_axis.begin();
    const int power_error = installed::connections_confirmed ? regulator_enable(DEVICE_DT_GET(DT_NODELABEL(power1)))
                                                             : -ENODEV;
    diagnostics.event("steer_bus", steer_error);
    diagnostics.event("drive_bus", drive_error);
    diagnostics.event("big_yaw", big_error);
    diagnostics.event("chassis", chassis_error);
    diagnostics.event("body_imu", body_error);
    diagnostics.event("motor_rail", power_error);
    std::uint64_t peer_boot = 0;
    int previous_big_commit_error = 0;
    core::TimeUs previous_cycle_us = 0, last_big_stop_dt_us = 0;
    bool big_was_requested = false, big_was_active = false, have_big_stop = false;
    WaitReason last_big_stop_reason = WaitReason::None;
    int last_big_stop_error = 0;
    BigYawGate last_big_stop_gate = BigYawGate::None;
    std::uint32_t big_stop_count = 0;
    std::uint64_t last_big_stop_ms = 0;
    float last_big_stop_drive_status = -1;
    std::int64_t deadline = k_uptime_ticks();
    const auto period = k_us_to_ticks_ceil64(installed::chassis_period_us);
    for (;;) {
        const auto now_us = core::monotonicTimeUs(), now_ms = now_us / 1000;
        const auto dt_us = previous_cycle_us && now_us > previous_cycle_us ? now_us - previous_cycle_us : 0;
        const bool cycle_valid = dt_us && dt_us <= big_yaw_config.max_cycle_us;
        previous_cycle_us = now_us;
        endpoint.poll(now_ms);
        const auto referee_state = referee.poll(core::monotonicTimeUs() / 1000);
        endpoint.setReferee(referee_state);
        const auto rx = endpoint.snapshot();
        if (rx.peer.stamp.valid && peer_boot != rx.peer.sender_boot_id) {
            peer_boot = rx.peer.sender_boot_id;
            (void)chassis.suspend(now_us, WaitReason::Reference, -ESTALE);
            (void)big_axis.suspend(now_us, WaitReason::Reference, -ESTALE);
        }
        ChassisExecutionInputs input{};
        input.command = rx.control.command;
        input.permission = referee_state.robot.chassis_output;
        input.require_permission = true;
        if (rx.control.global_action != SafetyAction::Active || !rx.online || !rx.local_boot_id ||
            rx.control.receiver_boot_id != rx.local_boot_id)
            input.command.mode = ChassisMode::Disabled;
        const auto body_snapshot = body.snapshot();
        const auto body_sample = body_heading.update(body_snapshot, input.command.mode == ChassisMode::Disabled,
                                                     now_us);
        // Unlike our old Body-frame v4 implementation, the reference sends
        // gimbal-relative translation. The absolute encoder zero is fixed.
        const auto yaw_feedback = big_drive.snapshot();
        // Use the continuous native protocol coordinate, not the raw +-PMAX
        // value: a J4310 wraps every 25 rad, which is not a multiple of 2*pi.
        // It keeps the calibrated forward zero and survives an RX gap.
        const bool encoder_valid = yaw_feedback.feedback_fresh && yaw_feedback.native_unwrapped_position_valid &&
                                   std::isfinite(yaw_feedback.native_unwrapped_position_rad) &&
                                   isFresh({yaw_feedback.feedback.timestamp_ms, 1, true}, now_ms, 100);
        input.command = referenceV4ChassisToBody(input.command, encoder_valid,
                                                 yaw_feedback.native_unwrapped_position_rad,
                                                 installed::reference_big_yaw_forward_zero_rad,
                                                 installed::reference_big_yaw.direction,
                                                 installed::reference_big_yaw.gear_ratio,
                                                 installed::chassis_spin_forward_scale,
                                                 installed::chassis_spin_lateral_scale);
        input.command = motion.update(input.command, body_sample, rx.gimbal_imu, rx.local_boot_id,
                                      input.command.mode == ChassisMode::Disabled, now_ms, rx.peer);
        input.transport_ready = steer_error == 0 && drive_error == 0 && chassis_error == 0 && power_error == 0 &&
                                rx.online;
        // This fixed manual entry uses the real peer RC authority and bounded
        // current profiles; measured-power/referee execution is a later stage.
        auto status = chassis_error == 0 ? chassis.update(input, now_us)
                                         : chassis.suspend(now_us, WaitReason::Configuration, chassis_error, true);
        BigYawExecutionInputs big_input{};
        // 4dc29fb: consume only the endpoint's currently valid request. Never
        // renew a cached request's timestamp after it expires on the link.
        big_input.request = rx.big_yaw_request;
        auto big_gate = !rx.big_yaw_request.stamp.valid                  ? BigYawGate::MissingRequest
                        : big_input.request.mode == BigYawMode::Disabled ? BigYawGate::PeerDisabled
                                                                         : BigYawGate::None;
        bool heading_follow_active = false;
        if (big_input.request.mode == BigYawMode::FollowCenter && !installed::big_yaw_heading_lock_enabled) {
            // The wire rate is a *world* rate for the head, while the native
            // velocity backend takes a physical joint rate. The follower owns
            // heading capture and the rate PI; the executor still applies
            // direction/ratio, slew and the joint limit exactly once.
            const bool body_gyro_valid = body_snapshot.state == imu::State::Running &&
                                         core::fresh(body_snapshot.sample.gyro_rad_s.stamp, now_us, 50000) &&
                                         core::finite(body_snapshot.sample.gyro_rad_s.value);
            float joint_rate = 0;
            int follow_error = -ESTALE;
            if (body_gyro_valid) {
                BigYawWorldHeadingInputs follow{};
                follow.head = rx.gimbal_imu;
                follow.now_ms = now_ms;
                follow.body_rate_rad_s = body_snapshot.sample.gyro_rad_s.value.z;
                follow.desired_world_rate_rad_s = big_input.request.target_rate_rad_s;
                // A missed interval stages no motor output this cycle; do not
                // integrate a heading step over it either.
                follow.dt_s = cycle_valid ? static_cast<float>(dt_us) * 1e-6f : 0;
                follow_error = heading_follower.step(follow, joint_rate);
            }
            if (follow_error < 0) {
                big_input.request.mode = BigYawMode::Disabled;
                big_gate = body_gyro_valid ? BigYawGate::PeerImu : BigYawGate::BodyGyro;
            }
            else {
                heading_follow_active = true;
                big_input.request.target_rate_rad_s = std::clamp(joint_rate, -big_yaw_config.rate_abs_max_rad_s,
                                                                 big_yaw_config.rate_abs_max_rad_s);
            }
        }
        if (!heading_follow_active && !installed::big_yaw_heading_lock_enabled)
            heading_follower.reset();
        big_input.head = rx.gimbal_imu;
        big_input.peer_boot_id = rx.peer.sender_boot_id;
        big_input.local_boot_id = rx.local_boot_id;
        big_input.peer_online = rx.online;
        big_input.transport_ready = big_error == 0 && power_error == 0 && rx.online;
        const auto big_status = big_error == 0 ? big_axis.update(big_input, now_us)
                                               : big_axis.suspend(now_us, WaitReason::Configuration, big_error, true);
        // One writer publishes each of the three physical buses once per cycle.
        if (steer_started) {
            const int error = steer_bus.commit().error;
            if (error < 0)
                status.error = error;
        }
        if (drive_started) {
            const int error = drive_bus.commit().error;
            if (error < 0)
                status.error = error;
        }
        if (big_started) {
            const int error = big_bus.commit().error;
            if (error != previous_big_commit_error) {
                diagnostics.event("big_yaw_commit", error);
                previous_big_commit_error = error;
            }
        }
        endpoint.setStatus(status);
        endpoint.setBigYawFeedback(big_axis.feedback());
        const auto feedback = big_axis.feedback();
        const auto big_motor = big_drive.snapshot();
        // Retain short interruptions across the 20 ms diagnostic sampling period.
        // Enabling -> withdrawn also counts, even before the first Active state.
        if ((big_was_requested && !big_status.requested) || (big_was_active && !feedback.armed)) {
            have_big_stop = true;
            last_big_stop_reason = big_status.reason;
            last_big_stop_error = big_status.error ? big_status.error : big_motor.last_fault.error;
            last_big_stop_gate = big_gate;
            last_big_stop_dt_us = dt_us;
            ++big_stop_count;
            last_big_stop_ms = now_ms;
            last_big_stop_drive_status = big_motor.native_drive_status_valid ? float(big_motor.native_drive_status)
                                                                             : -1;
        }
        big_was_requested = big_status.requested;
        big_was_active = feedback.armed;
        const auto reason = chassis_error || big_error || power_error ? installed::DiagnosticReason::InitFailed
                            : !rx.online                              ? installed::DiagnosticReason::PeerStale
                            : status.reason == WaitReason::Feedback || big_status.reason == WaitReason::Feedback
                                ? installed::DiagnosticReason::FeedbackStale
                            : status.state == RunState::Active || big_status.state == RunState::Active
                                ? installed::DiagnosticReason::Ready
                                : installed::DiagnosticReason::CommandStale;
        const int execution_error = status.error < 0 ? status.error : big_status.error;
        (void)status_led.setStatus(
            installed::statusLedFor(reason, status.state == RunState::Active || big_status.state == RunState::Active,
                                    false, execution_error));
#if defined(CONFIG_SKYWALKER_VEHICLE_DIAGNOSTICS)
        const auto big_reason = big_error || power_error                   ? installed::DiagnosticReason::InitFailed
                                : !rx.online                               ? installed::DiagnosticReason::PeerStale
                                : big_status.reason == WaitReason::Command ? installed::DiagnosticReason::CommandStale
                                : big_status.reason == WaitReason::Transport
                                    ? installed::DiagnosticReason::TransportError
                                : big_status.reason == WaitReason::Feedback ? installed::DiagnosticReason::FeedbackStale
                                : big_status.reason == WaitReason::Reference ? installed::DiagnosticReason::ImuStale
                                : big_status.reason == WaitReason::Configuration
                                    ? installed::DiagnosticReason::Configuration
                                : big_status.reason == WaitReason::Drive ? installed::DiagnosticReason::TransportError
                                : big_status.reason == WaitReason::Power ? installed::DiagnosticReason::Permission
                                : big_status.reason == WaitReason::Cycle ? installed::DiagnosticReason::CycleInvalid
                                : feedback.armed                         ? installed::DiagnosticReason::Ready
                                                                         : installed::DiagnosticReason::Disarmed;
        const float unavailable = std::numeric_limits<float>::quiet_NaN();
        const auto &hd = heading_follower.diagnostics();
        const std::array<float, 30>
            trace{109,                                                              // I19 chassis schema
                  float(unsigned(big_gate)),                                        // I20 live gate
                  float(unsigned(big_status.reason)),                               // I21 live execution reason
                  float(rx.gimbal_imu.valid),                                       // I22 peer heading usable
                  rx.gimbal_imu.valid ? rx.gimbal_imu.yaw_rad : unavailable,        // I23 peer world yaw
                  rx.gimbal_imu.valid ? rx.gimbal_imu.yaw_rate_rad_s : unavailable, // I24 peer world rate
                  body_snapshot.state == imu::State::Running &&
                          core::fresh(body_snapshot.sample.gyro_rad_s.stamp, now_us, 50000)
                      ? body_snapshot.sample.gyro_rad_s.value.z
                      : unavailable,                    // I25 body gyro z
                  rx.big_yaw_request.target_rate_rad_s, // I26 received world intent
                  heading_follower.initialized() ? heading_follower.targetHeadingRad()
                                                 : unavailable, // I27 target heading
                  heading_follower.initialized() ? heading_follower.headingErrorRad() : unavailable, // I28 error
                  big_axis.nativeVelocityStaged() ? big_axis.stagedJointRateRadS()
                                                  : unavailable, // I29 post-slew joint rate
                  big_motor.native_position_valid ? big_motor.native_position_rad : unavailable, // I30 raw encoder
                  big_motor.native_unwrapped_position_valid ? float(big_motor.native_unwrapped_position_rad)
                                                            : unavailable, // I31 unwrapped
                  big_motor.native_unwrapped_position_valid ? float(big_motor.native_wrap_count)
                                                            : unavailable, // I32 wrap count
                  big_motor.native_drive_status_valid ? float(big_motor.native_drive_status)
                                                      : unavailable, // I33 DM status
                  float(unsigned(big_motor.last_fault.reason)),      // I34 last motor fault reason
                  float(big_stop_count & 0xffff),                    // I35 stop count
                  float(last_big_stop_ms & 0xffff),                  // I36 stop time low
                  float((last_big_stop_ms >> 16) & 0xffff),          // I37 stop time high
                  float(hd.capture_count & 0xffff),                  // I38 heading captures
                  float(hd.capture_reason),                          // I39 last capture cause
                  heading_follower.rateIntegralRadS(),               // I40 integral
                  last_big_stop_drive_status,                        // I41 DM status at stop
                  float(hd.capture_ms & 0xffff),                     // I42 capture time low
                  float((hd.capture_ms >> 16) & 0xffff),             // I43 capture time high
                  float(hd.clamp_count & 0xffff),                    // I44 90-degree clamp entries
                  float(previous_big_commit_error),                  // I45 CAN commit error
                  heading_follower.initialized() ? heading_follower.worldRateRadS()
                                                 : unavailable, // I46 legacy world rate before body compensation
                  0,                                            // I47 reserved; native executor restored to 4dc29fb
                  0};                                           // I48 reserved (legacy immediate stop capture)
        diagnostics.status({.reason = big_reason,
                            .valid = feedback.valid,
                            .enabled = feedback.armed,
                            .target = big_input.request.target_rate_rad_s,
                            .feedback = feedback.actual_rate_rad_s,
                            .age_ms = age(rx.big_yaw_request.stamp, now_ms),
                            .dt_us = float(have_big_stop ? last_big_stop_dt_us : dt_us),
                            .effort = big_motor.feedback.torque_nm,
                            .detail = float(unsigned(have_big_stop ? last_big_stop_reason : big_status.reason)),
                            .error = big_error          ? big_error
                                     : power_error      ? power_error
                                     : have_big_stop    ? last_big_stop_error
                                     : big_status.error ? big_status.error
                                                        : previous_big_commit_error,
                            .extra0 = float(unsigned(big_motor.state)),
                            .extra1 = float(unsigned(have_big_stop ? last_big_stop_gate : big_gate)),
                            .extended = true,
                            .extension = trace});
#endif
        deadline += period;
        const auto ticks = k_uptime_ticks();
        if (deadline <= ticks)
            deadline += ((ticks - deadline) / period + 1) * period;
        k_sleep(K_TIMEOUT_ABS_TICKS(deadline));
    }
}
```

## src/board_config.hpp
```c
// TODO(legacy): historical private implementation. The active entry now uses
// samples/robotics/common/vehicle_bench.hpp and central vehicle calibration.
#pragma once

#include <array>
#include <cstdint>

#include <zephyr/device.h>
#include <zephyr/devicetree.h>
#include <zephyr/drivers/gpio.h>
#include <zephyr/kernel.h>

#include <robotics/swerve/swerve_chassis.hpp>
#include <communication/interboard/configured_interboard_transport.hpp>
#include "chassis_hardware.hpp"

namespace board_config {

inline constexpr bool connections_configured = false;
inline constexpr bool require_power_budget = true;
inline constexpr std::uint32_t command_timeout_ms = 100, heartbeat_timeout_ms = 100, permission_timeout_ms = 300,
                               feedback_stable_ms = 30, recovery_retry_ms = 100;
// The estimator is disabled until calibrated with this robot's power measurements.
inline constexpr bool power_model_calibrated = false;
inline constexpr float idle_power_w = 0, power_per_abs_amp_w = 0, bench_effort_scale = 0.15f;
inline constexpr float velocity_safety_rad_s = 40, temperature_limit_c = 70;
inline constexpr std::array<float, 8> motor_direction = {1, 1, 1, 1, 1, 1, 1, 1}; // steer 4, drive 4

#if DT_NODE_HAS_STATUS(DT_ALIAS(interboard_uart), okay)
inline const device *interboard_uart = DEVICE_DT_GET(DT_ALIAS(interboard_uart));
#else
inline const device *interboard_uart = nullptr;
#endif
// Change only kind to select the physical link; both boards must agree.
inline const skywalker::communication::ConfiguredInterBoardTransport::Config interboard_transport = [] {
    using namespace skywalker::communication;
    ConfiguredInterBoardTransport::Config c{};
    c.kind = InterBoardTransportKind::Uart;
    c.uart = interboard_uart;
#if DT_NODE_HAS_STATUS(DT_ALIAS(interboard_rs485), okay)
    c.rs485.uart = DEVICE_DT_GET(DT_ALIAS(interboard_rs485));
#endif
    c.rs485.role = Rs485InterBoardTransport::Role::Responder;
#if DT_NODE_HAS_STATUS(DT_ALIAS(interboard_can), okay)
    c.can.can = DEVICE_DT_GET(DT_ALIAS(interboard_can));
#endif
    c.can.tx_id = 0x601;
    c.can.rx_id = 0x600;
    return c;
}();
#if DT_NODE_HAS_STATUS(DT_NODELABEL(can1), okay)
inline const device *can1 = DEVICE_DT_GET(DT_NODELABEL(can1));
#else
inline const device *can1 = nullptr;
#endif
#if DT_NODE_HAS_STATUS(DT_NODELABEL(can2), okay)
inline const device *can2 = DEVICE_DT_GET(DT_NODELABEL(can2));
#else
inline const device *can2 = nullptr;
#endif

// Original wiring: all eight motors on CAN1. Set drive_can to can2 when the
// four M3508 are physically on CAN2. Confirm wiring before opening the gate.
inline const device *steer_can = can1;
inline const device *drive_can = can1;

inline skywalker::motor::dji::Config steerConfig(std::uint8_t id) {
    return skywalker::motor::dji::gm6020({
        .id = id,
        .current_limit_a = 1.5f,
        .encoder_zero_ticks = 0,
        .current_mode_confirmed = false,
        .timing = {20, 20, 30, 100},
    });
}

inline skywalker::motor::dji::Config driveConfig(std::uint8_t id) {
    return skywalker::motor::dji::m3508({
        .id = id,
        .current_limit_a = 1.5f,
        .gear_ratio = 3591.0f / 187.0f,
        .timing = {20, 20, 30, 100},
    });
}

// Order: steer FL, FR, RL, RR; drive FL, FR, RL, RR. All four GM6020
// current-control modes and encoder zeroes must be confirmed on the real robot.
inline const std::array<ChassisMotorConnection, 8> motors{{
    {steer_can, steerConfig(1)},
    {steer_can, steerConfig(2)},
    {steer_can, steerConfig(3)},
    {steer_can, steerConfig(4)},
    {drive_can, driveConfig(1)},
    {drive_can, driveConfig(2)},
    {drive_can, driveConfig(3)},
    {drive_can, driveConfig(4)},
}};

inline skywalker::robotics::SwerveChassis::Config chassisConfig() {
    using namespace skywalker::robotics;
    SwerveChassis::Config c{};
    c.kinematics.locations = {ModuleLocation{0.2f, 0.2f}, {0.2f, -0.2f}, {-0.2f, 0.2f}, {-0.2f, -0.2f}};
    c.kinematics.max_wheel_velocity_m_s = 0.5f;
    for (auto &m : c.modules) {
        m.wheel_radius_m = 0.05f;
        m.drive.regulator.feedback = {0.03f, 0.1f, 0, 0, -0.3f, 0.3f, -0.3f, 0.3f, 0, 0.001f, 0.02f};
        m.drive.reference_slew = {10, 10};
        m.drive.requested_velocity_abs_max_rad_s = 10;
        m.drive.effort_abs_max = 0.3f;
        m.steer.velocity = m.drive;
        m.steer.position = {3, 0, 0, 0, -10, 10, -10, 10, 0.01f, 0.001f, 0.02f};
    }
    return c;
}

} // namespace board_config
```

## src/chassis_executor.cpp
```c
#include "chassis_executor.hpp"
#include <cerrno>
#include <cmath>
#include <limits>
using namespace skywalker;
using namespace skywalker::robotics;
RunStatus ChassisExecutor::begin() {
    if (checked_) return status_;
    return update(core::monotonicTimeUs());
}
void ChassisExecutor::suspend() {
    (void)hardware_.suspend();
    prepared_ = false;
    limiter_.reset();
}
RunStatus ChassisExecutor::update(core::TimeUs now_us) {
    const auto now = now_us / 1000;
    const bool valid_cycle = have_time_ && now_us > previous_us_ && now_us - previous_us_ <= 20000;
    const float dt = valid_cycle ? float(now_us - previous_us_) / 1000000.0f : 0;
    previous_us_ = now_us;
    have_time_ = true;
    const auto rx = link_.snapshot();
    const auto finish = [&](RunState state, WaitReason reason, int error = 0) {
        status_.state = state;
        status_.reason = reason;
        status_.error = error;
        status_.ready = prepared_ && (hardware_.ready() || hardware_.armed() || hardware_.enabling());
        status_.generation = generation_;
        status_.stamp = {now, status_.stamp.sequence + 1, true};
        return status_;
    };
    if (!checked_) {
        checked_ = true;
        config_error_ = board_config::connections_configured ? chassis_.validate() : -ENODEV;
        if (!std::isfinite(board_config::bench_effort_scale) || board_config::bench_effort_scale < 0 ||
            board_config::bench_effort_scale > 1 || !std::isfinite(board_config::idle_power_w) ||
            board_config::idle_power_w < 0 || !std::isfinite(board_config::power_per_abs_amp_w) ||
            board_config::power_per_abs_amp_w < 0 ||
            (board_config::power_model_calibrated && board_config::power_per_abs_amp_w <= 0))
            config_error_ = -EINVAL;
    }
    if (config_error_ < 0) return finish(RunState::Blocked, WaitReason::Configuration, config_error_);
    if (!initialized_) {
        if (now < retry_ms_) return finish(RunState::Recovering, WaitReason::Transport, -EAGAIN);
        const int ret = hardware_.init();
        if (ret < 0) {
            retry_ms_ = now + board_config::recovery_retry_ms;
            if (ret == -EINVAL || ret == -ENOTSUP || ret == -ENODEV || ret == -ERANGE || ret == -EBUSY || ret == -ENOSPC)
                config_error_ = ret;
            return finish(config_error_ < 0 ? RunState::Blocked : RunState::Recovering, WaitReason::Configuration, ret);
        }
        initialized_ = true;
    }
    if (rx.peer.stamp.valid && peer_boot_ != rx.peer.sender_boot_id) {
        peer_boot_ = rx.peer.sender_boot_id;
        suspend();
    }
    const auto &command = rx.control.command;
    const bool online = rx.online && isFresh(rx.peer.stamp, now, board_config::heartbeat_timeout_ms);
    const bool fresh = isFresh(command.stamp, now, board_config::command_timeout_ms);
    const bool requested = online && fresh && command.mode != ChassisMode::Disabled &&
                           rx.control.global_action == SafetyAction::Active;
    const auto &constraint = rx.constraint;
    const bool budget_fresh = constraint.power_valid && forwardedFresh(constraint.stamp, constraint.power_age_ms,
                                                                        now, board_config::permission_timeout_ms);
    const bool budget_allowed = !board_config::require_power_budget ||
                                (budget_fresh && board_config::power_model_calibrated);
    const bool context = rx.local_boot_id && rx.control.receiver_boot_id == rx.local_boot_id &&
                         rx.control.resume_generation == generation_;
    // Withdrawal never waits for feedback, retry deadlines or preparation.
    if ((hardware_.armed() || hardware_.enabling()) && (!requested || !budget_allowed || !context))
        suspend();
    if (hardware_.hasBlockingFault()) {
        suspend();
        return finish(RunState::Blocked, WaitReason::Drive, -EIO);
    }
    ChassisFeedback feedback{};
    if (!hardware_.armed() && !hardware_.enabling()) {
        const int ret = hardware_.pollRecovery(now);
        if (ret < 0) {
            prepared_ = false;
            return finish(RunState::Recovering, WaitReason::Feedback, ret);
        }
        if (!prepared_) {
            int reset = hardware_.read(feedback);
            if (reset == 0) reset = chassis_.reset(feedback);
            if (reset < 0) { suspend(); return finish(RunState::Recovering, WaitReason::Reference, reset); }
            if (generation_ == std::numeric_limits<std::uint32_t>::max()) {
                config_error_ = -EOVERFLOW;
                suspend();
                return finish(RunState::Blocked, WaitReason::Configuration, config_error_);
            }
            ++generation_;
            ready_ms_ = now;
            prepared_ = true;
            limiter_.reset();
        }
    }
    if (!requested)
        return finish(online && fresh && command.mode == ChassisMode::Disabled ? RunState::Disabled : RunState::Recovering,
                      online ? WaitReason::Command : WaitReason::Transport);
    if (!budget_allowed) return finish(RunState::Recovering, WaitReason::Power, -EAGAIN);
    // Re-evaluate after preparing: preparation may have advanced generation_.
    if (!rx.local_boot_id || rx.control.receiver_boot_id != rx.local_boot_id ||
        rx.control.resume_generation != generation_ || command.stamp.timestamp_ms <= ready_ms_)
        return finish(RunState::Recovering, WaitReason::Command, -EAGAIN);
    if (hardware_.enabling()) return finish(RunState::Recovering, WaitReason::Drive);
    if (!hardware_.armed()) {
        const int ret = hardware_.arm();
        if (ret < 0) prepared_ = false;
        return finish(RunState::Recovering, WaitReason::Drive, ret);
    }
    if (!valid_cycle) { suspend(); return finish(RunState::Recovering, WaitReason::Cycle, -ESTALE); }
    int ret = hardware_.read(feedback);
    ChassisOutput output{};
    if (ret == 0) ret = chassis_.step(command, feedback, dt, output);
    float scale = board_config::bench_effort_scale;
    if (ret == 0 && board_config::power_model_calibrated && budget_fresh) {
        ChassisPowerDecision power{};
        ret = limiter_.step({hardware_.estimatedPowerW(), constraint.power_limit_w, constraint.buffer_energy_j}, dt, power);
        scale = power.effort_scale;
    }
    if (ret == 0) ret = hardware_.apply(output, scale);
    if (ret < 0) { suspend(); return finish(RunState::Recovering, WaitReason::Drive, ret); }
    status_.last_command_sequence = command.stamp.sequence;
    return finish(RunState::Active, WaitReason::None);
}
```

## src/chassis_executor.hpp
```c
// TODO(legacy): historical private implementation. The active entry now uses
// samples/robotics/common/vehicle_bench.hpp and central vehicle calibration.
#pragma once
#include <core/clock.hpp>
#include <communication/interboard/interboard_endpoint.hpp>
#include <robotics/execution/run_status.hpp>
#include <robotics/chassis/chassis_power_limiter.hpp>
#include "board_config.hpp"
// Owns the complete chassis control/recovery sequence on one execution thread.
class ChassisExecutor {
public:
    explicit ChassisExecutor(skywalker::communication::InterBoardEndpoint &link) : link_(link) {}
    skywalker::robotics::RunStatus begin();
    skywalker::robotics::RunStatus update(skywalker::core::TimeUs now_us);
private:
    void suspend();
    skywalker::communication::InterBoardEndpoint &link_;
    DjiChassisHardware hardware_{board_config::motors};
    skywalker::robotics::SwerveChassis chassis_{board_config::chassisConfig()};
    skywalker::robotics::ChassisPowerLimiter limiter_{};
    skywalker::robotics::RunStatus status_{};
    bool checked_ = false, initialized_ = false, prepared_ = false, have_time_ = false;
    int config_error_ = 0;
    std::uint64_t peer_boot_ = 0, retry_ms_ = 0, ready_ms_ = 0;
    skywalker::core::TimeUs previous_us_ = 0;
    std::uint32_t generation_ = 0;
};
```

## src/chassis_hardware.cpp
```c
#include "chassis_hardware.hpp"

#include <cerrno>
#include <cmath>

#include <zephyr/kernel.h>

#include "board_config.hpp"

using namespace skywalker;

const device *DjiChassisHardware::secondaryCan(const std::array<ChassisMotorConnection, 8> &connections) {
    for (const auto &connection : connections)
        if (connection.can != connections[0].can)
            return connection.can;
    return nullptr;
}

DjiChassisHardware::DjiChassisHardware(const std::array<ChassisMotorConnection, 8> &connections)
    : connections_(connections), motors_{{motor::Motor(connections[0].config), motor::Motor(connections[1].config),
                                          motor::Motor(connections[2].config), motor::Motor(connections[3].config),
                                          motor::Motor(connections[4].config), motor::Motor(connections[5].config),
                                          motor::Motor(connections[6].config), motor::Motor(connections[7].config)}},
      group_(motors_[0], motors_[1], motors_[2], motors_[3], motors_[4], motors_[5], motors_[6], motors_[7]),
      first_bus_(connections[0].can), second_bus_(secondaryCan(connections)), buses_{{&first_bus_, &second_bus_}} {
    can_devices_[0] = connections[0].can;
    can_devices_[1] = secondaryCan(connections);
}

int DjiChassisHardware::init() {
    if (initialized_)
        return 0;
    if (!board_config::connections_configured)
        return -ENODEV;
    if (can_devices_[0] == nullptr || !device_is_ready(can_devices_[0]))
        return -ENODEV;

    bus_count_ = can_devices_[1] == nullptr ? 1 : 2;
    if (bus_count_ == 2 && !device_is_ready(can_devices_[1]))
        return -ENODEV;

    for (std::size_t i = 0; i < motors_.size(); ++i) {
        if (connections_[i].can == nullptr ||
            (connections_[i].can != can_devices_[0] && connections_[i].can != can_devices_[1]))
            return -ENOTSUP;
        if (board_config::motor_direction[i] != 1.0f && board_config::motor_direction[i] != -1.0f)
            return -EINVAL;
        const int described = motor::dji::describe(connections_[i].config, descriptors_[i]);
        if (described < 0)
            return described;
        auto required = motor::CommandCurrent | motor::FeedbackVelocity | motor::FeedbackPosition |
                        motor::FeedbackCurrent;
        if (i < 4)
            required |= motor::FeedbackAbsolutePosition;
        if ((motors_[i].info().capabilities & required) != required)
            return -ENOTSUP;
        for (std::size_t j = 0; j < i; ++j) {
            if (connections_[i].can != connections_[j].can)
                continue;
            if (descriptors_[i].feedback_id == descriptors_[j].feedback_id ||
                (descriptors_[i].command_id == descriptors_[j].command_id &&
                 descriptors_[i].command_slot == descriptors_[j].command_slot))
                return -EINVAL;
        }
        motor_bus_index_[i] = connections_[i].can == can_devices_[0] ? 0 : 1;
    }

    const auto config = board_config::chassisConfig();
    for (std::size_t i = 0; i < 4; ++i)
        if (config.modules[i].steer.velocity.effort_abs_max > descriptors_[i].configured_current_limit_a ||
            config.modules[i].drive.effort_abs_max > descriptors_[i + 4].configured_current_limit_a)
            return -ERANGE;

    // Resume only unfinished initialization stages; never reattach live members.
    while (attached_count_ < motors_.size()) {
        const auto i = attached_count_;
        const int ret = buses_[motor_bus_index_[i]]->attach(motors_[i]);
        if (ret < 0) return ret;
        ++attached_count_;
    }
    while (started_count_ < bus_count_) {
        const int ret = buses_[started_count_]->start();
        if (ret < 0) return ret;
        ++started_count_;
    }
    initialized_ = true;
    return 0;
}

int DjiChassisHardware::validateFeedback(std::size_t index, const motor::MotorSnapshot &snapshot,
                                         bool require_reference) const {
    const motor::Feedback &f = snapshot.feedback;
    if (!snapshot.feedback_fresh)
        return -ESTALE;
    if (snapshot.state == motor::MotorState::Offline || snapshot.state == motor::MotorState::Fault)
        return -EHOSTDOWN;
    auto required = motor::FeedbackVelocity | motor::FeedbackCurrent;
    if (index < 4)
        required |= motor::FeedbackAbsolutePosition;
    if (require_reference)
        required |= motor::FeedbackPosition;
    if ((f.valid & required) != required || !std::isfinite(f.velocity_rad_s) || !std::isfinite(f.current_a) ||
        (index < 4 && !std::isfinite(f.absolute_position_rad)) ||
        (require_reference && (!snapshot.position_reference_valid || !std::isfinite(f.position_rad))))
        return -ENODATA;
    if (require_reference && stable_ && snapshot.reference_generation != references_[index])
        return -ESTALE;
    if (std::fabs(f.velocity_rad_s) > board_config::velocity_safety_rad_s)
        return -ERANGE;
    if ((f.valid & motor::FeedbackTemperature) &&
        (!std::isfinite(f.temperature_c) || f.temperature_c >= board_config::temperature_limit_c))
        return -ERANGE;
    return 0;
}

int DjiChassisHardware::read(robotics::ChassisFeedback &out) {
    if (!initialized_)
        return -EACCES;
    robotics::ChassisFeedback next{};
    auto stamps = stamps_;
    float power = board_config::idle_power_w;
    for (std::size_t i = 0; i < motors_.size(); ++i) {
        const auto snapshot = motors_[i].snapshot();
        const int ret = validateFeedback(i, snapshot, true);
        if (ret < 0)
            return ret;
        const motor::Feedback &f = snapshot.feedback;
        const float sign = board_config::motor_direction[i];
        if (i < 4) {
            next.module[i].steer_absolute_rad = sign * f.absolute_position_rad;
            next.module[i].steer_continuous_rad = sign * f.position_rad;
            next.module[i].steer_velocity_rad_s = sign * f.velocity_rad_s;
        }
        else
            next.module[i - 4].drive_velocity_rad_s = sign * f.velocity_rad_s;
        stamps[i] = f.timestamp_ms;
        power += std::fabs(f.current_a) * board_config::power_per_abs_amp_w;
    }
    stamps_ = stamps;
    estimated_power_w_ = power;
    out = next;
    return 0;
}

int DjiChassisHardware::suspend() {
    ready_ = stable_ = false;
    next_retry_ms_ = 0;
    if (!initialized_ || stopped_)
        return 0;
    stopped_ = true;
    group_.disable();
    return 0;
}

int DjiChassisHardware::pollRecovery(std::uint64_t now) {
    if (!initialized_ || armed())
        return -EACCES;
    if (now < next_retry_ms_)
        return -EAGAIN;
    const auto fail = [&](int error) {
        suspend();
        next_retry_ms_ = now + board_config::recovery_retry_ms;
        return error;
    };

    const auto group_status = group_.status();
    if (group_status.enable_pending)
        return -EAGAIN;
    if (!stopped_) {
        // A requested run that is neither active nor enabling has lost its
        // permit. Withdraw every target before rebuilding the control state.
        suspend();
        return -EAGAIN;
    }
    for (std::size_t i = 0; i < bus_count_; ++i) {
        const auto bus_status = buses_[i]->status();
        if (bus_status.state == motor::BusState::Recovering) {
            ready_ = stable_ = false;
            return -EAGAIN;
        }
        if (bus_status.state != motor::BusState::Running)
            return fail(bus_status.last_error < 0 ? bus_status.last_error : -EHOSTDOWN);
    }
    if (!group_.ready()) {
        ready_ = stable_ = false;
        if (hasBlockingFault()) return -EIO;
        bool fault = false;
        bool fresh = true;
        for (const auto &motor : motors_) {
            const auto snapshot = motor.snapshot();
            fault = fault || snapshot.state == motor::MotorState::Fault;
            fresh = fresh && snapshot.feedback_fresh;
        }
        if (fault && fresh) {
            next_retry_ms_ = now + board_config::recovery_retry_ms;
            const int ret = group_.clearFault();
            if (ret < 0 && ret != -EBUSY && ret != -EAGAIN) return ret;
        }
        return -EAGAIN;
    }

    if (!stable_) {
        for (std::size_t i = 0; i < motors_.size(); ++i) {
            const auto snapshot = motors_[i].snapshot();
            const int checked = validateFeedback(i, snapshot, false);
            if (checked < 0)
                return fail(checked);
            const double seed = i < 4 ? static_cast<double>(snapshot.feedback.absolute_position_rad) : 0.0;
            const int ret = motors_[i].reseedPosition(seed);
            if (ret < 0)
                return fail(ret);
            first_stamps_[i] = snapshot.feedback.timestamp_ms;
            references_[i] = motors_[i].snapshot().reference_generation;
        }
        stable_ = true;
        stable_since_ms_ = now;
        return -EAGAIN;
    }

    robotics::ChassisFeedback feedback{};
    const int read_result = read(feedback);
    if (read_result < 0)
        return fail(read_result);
    for (std::size_t i = 0; i < motors_.size(); ++i)
        if (stamps_[i] == first_stamps_[i])
            return -EAGAIN;
    if (now < stable_since_ms_ || now - stable_since_ms_ < board_config::feedback_stable_ms)
        return -EAGAIN;
    if (!group_.ready())
        return fail(-EAGAIN);
    ready_ = true;
    return 0;
}

int DjiChassisHardware::arm() {
    if (!initialized_ || !ready_)
        return -EAGAIN;
    if (armed() || group_.status().enable_pending)
        return 0;
    robotics::ChassisFeedback feedback{};
    const int checked = read(feedback);
    if (checked < 0) {
        suspend();
        return checked;
    }
    const int ret = group_.enable();
    if (ret < 0) {
        suspend();
        return ret;
    }
    stopped_ = false;
    return 0;
}

int DjiChassisHardware::apply(const robotics::ChassisOutput &out, float scale) {
    if (!armed()) {
        suspend();
        return -EACCES;
    }
    if (!std::isfinite(scale) || scale < 0 || scale > 1) {
        suspend();
        return -EINVAL;
    }
    std::array<float, 8> current{};
    for (std::size_t i = 0; i < 4; ++i) {
        current[i] = out.module[i].steer_effort * scale * board_config::motor_direction[i];
        current[i + 4] = out.module[i].drive_effort * scale * board_config::motor_direction[i + 4];
    }
    for (std::size_t i = 0; i < current.size(); ++i) {
        if (!std::isfinite(current[i]) || std::fabs(current[i]) > descriptors_[i].configured_current_limit_a) {
            suspend();
            return -ERANGE;
        }
    }
    for (std::size_t i = 0; i < motors_.size(); ++i) {
        const int ret = motors_[i].setCurrent(current[i]);
        if (ret < 0) {
            suspend();
            return ret;
        }
    }
    int first_error = 0;
    for (std::size_t i = 0; i < bus_count_; ++i) {
        const auto result = buses_[i]->commit();
        if (result.error < 0 && first_error == 0)
            first_error = result.error;
    }
    if (first_error < 0)
        suspend();
    return first_error;
}

int DjiChassisHardware::clearFault() {
    if (!initialized_)
        return -EACCES;
    return group_.clearFault();
}

bool DjiChassisHardware::hasBlockingFault() const {
    for (const auto &motor : motors_) {
        const auto snapshot = motor.snapshot();
        if (snapshot.state != motor::MotorState::Fault) continue;
        if (snapshot.last_fault.reason != motor::FaultReason::UnexpectedDisabled &&
            snapshot.last_fault.reason != motor::FaultReason::EnableTimeout) return true;
    }
    return false;
}
```

## src/latest.hpp
```c
#pragma once
#include <cerrno>
#include <zephyr/kernel.h>
// Application-owned coherent snapshots; no I/O or callbacks while holding the lock.
template <class T> class Latest {
public:
    Latest() {
        k_mutex_init(&mutex_);
    }
    int put(const T &value) {
        if (k_mutex_lock(&mutex_, K_NO_WAIT) < 0)
            return -EAGAIN;
        value_ = value;
        k_mutex_unlock(&mutex_);
        return 0;
    }
    int get(T &value) {
        if (k_mutex_lock(&mutex_, K_NO_WAIT) < 0)
            return -EAGAIN;
        value = value_;
        k_mutex_unlock(&mutex_);
        return 0;
    }

private:
    k_mutex mutex_{};
    T value_{};
};
```
