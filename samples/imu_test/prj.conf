## CMakeLists.txt
```
cmake_minimum_required(VERSION 3.20.0)

find_package(Zephyr REQUIRED HINTS $ENV{ZEPHYR_BASE})
project(imu_test)

target_sources(app PRIVATE src/main.c)
```

## prj.conf
```kconfig
CONFIG_CPP=y
CONFIG_STD_CPP20=y
CONFIG_REQUIRES_FULL_LIBCPP=y
CONFIG_MAIN_STACK_SIZE=8192
CONFIG_LOG=y
CONFIG_SERIAL=y
CONFIG_UART_ASYNC_API=y
CONFIG_NOCACHE_MEMORY=y
CONFIG_PWM=y
CONFIG_SENSOR=y
CONFIG_BMI08X=y
CONFIG_SKYWALKER_LIB_VOFA=y
CONFIG_SKYWALKER_IMU=y
CONFIG_SKYWALKER_IMU_BMI088=y
CONFIG_SKYWALKER_IMU_HEATER=y
CONFIG_SKYWALKER_ATTITUDE_EKF=y
CONFIG_FPU=y
CONFIG_FPU_SHARING=y

# USB CDC ACM carries VOFA JustFloat; console stays on the board UART.
CONFIG_USB_DEVICE_STACK_NEXT=y
CONFIG_CDC_ACM_SERIAL_INITIALIZE_AT_BOOT=y
CONFIG_CDC_ACM_SERIAL_PRODUCT_STRING="SkyWalker Telemetry"
CONFIG_USBD_CDC_ACM_LOG_LEVEL_WRN=y
```

## app.overlay
```dts
/* Shared CAN1 motors and independent Pitch CAN2 use the board wiring. */
/ {
    aliases {
        telemetry-uart = &cdc_acm_uart0;
    };
};

&zephyr_udc0 {
    cdc_acm_uart0: cdc_acm_uart0 {
        compatible = "zephyr,cdc-acm-uart";
        label = "VOFA";
    };
};
```

## boards/dm_mc02.overlay
```dts
/ {
    aliases {
        telemetry-uart = &usart1;
    };
};
&usart1 {
    current-speed = <115200>;
};
```

## src/main.c
```c
#include <zephyr/kernel.h>
#include <zephyr/device.h>
#include <zephyr/devicetree.h>
#include "drivers/imu/imu.h"
#include "lib/vofa/vofa.h"

#define VOFA_SEND_PERIOD_MS 5U

int main(void) {
    const struct device *imu_dev = DEVICE_DT_GET(DT_NODELABEL(imu));
    const struct device *uart_dev = DEVICE_DT_GET(DT_NODELABEL(usart1));
    if (!device_is_ready(imu_dev)) {
        printk("IMU device not ready\n");
        return -1;
    }
    if (!device_is_ready(uart_dev)) {
        printk("UART device not ready\n");
        return -1;
    }

    Vofa vofa;
    vofa_init(&vofa, uart_dev);

    imu_data *data = imu_dev->data;

    uint32_t now = k_uptime_get_32();
    uint32_t t_last = now, t_heat = now, t_send = now;

    while (1) {
        now = k_uptime_get_32();
        float dt = (now - t_last) / 1000.0f;
        t_last = now;

        imu_fetch(imu_dev);
        imu_estimate(imu_dev, dt);

        if (now - t_heat >= 100) {
            int ret = imu_heat_control(imu_dev, 50.0f, (now - t_heat) / 1000.0f);
            if (ret < 0) {
                printk("IMU heat control failed: %d\n", ret);
                return ret;
            }
            t_heat = now;
        }

        if (now - t_send >= VOFA_SEND_PERIOD_MS) {
            float out[3] = {data->angle[0], data->angle[1], data->angle[2]};
            vofa_send(&vofa, out, 3);
            t_send = now;
        }

        k_usleep(1000);
    }
    return 0;
}
```

## src/main.cpp
```c
#include <drivers/imu/bmi088_imu.hpp>
#include <drivers/imu/imu_heater.hpp>
#include <core/attitude.hpp>
#include <core/clock.hpp>
#include <lib/vofa/vofa.h>
#include <zephyr/logging/log.h>
#include <cerrno>
LOG_MODULE_REGISTER(imu_bench, LOG_LEVEL_INF);
namespace imu = skywalker::imu;
namespace core = skywalker::core;
namespace {
skywalker::control::QuaternionEkf estimator({});
imu::Bmi088Imu source(DEVICE_DT_GET(DT_ALIAS(accel0)), DEVICE_DT_GET(DT_ALIAS(gyro0)), {}, &estimator);
imu::ImuHeater heater({.pwm = PWM_DT_SPEC_GET(DT_ALIAS(imu_heater))});
Vofa vofa{};
}
int main() {
    const int hr = heater.init(), ir = source.init();
    const int vr = vofa_init(&vofa, DEVICE_DT_GET(DT_ALIAS(telemetry_uart)));
    LOG_INF("IMU=%d heater=%d VOFA=%d", ir, hr, vr);
    if (ir < 0) {
        if (!hr)
            heater.disable();
        return ir;
    }
    core::TimeUs next = 0;
    int last = 0;
    for (;;) {
        const int r = source.service();
        if (r != -EAGAIN && r != last) {
            LOG_WRN("IMU sample=%d", r);
            last = r;
        }
        const auto s = source.snapshot();
        const auto now = core::monotonicTimeUs();
        if (!hr)
            heater.update(s.sample.temperature_c, now);
        if (!vr && now >= next) {
            next = now + 10000;
            const auto e = core::euler(s.sample.orientation.value);
            const float v[] =
                {e.roll, e.pitch, e.yaw, s.sample.temperature_c.value, heater.snapshot().duty, float(s.fresh_mask)};
            vofa_send(&vofa, v, 6);
        }
        k_usleep(500);
    }
}
```
