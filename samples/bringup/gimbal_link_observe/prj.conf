## CMakeLists.txt
```
cmake_minimum_required(VERSION 3.20.0)
get_filename_component(INSTALLED_CONFIG "${CMAKE_CURRENT_SOURCE_DIR}/../../../config/vehicle/installed" ABSOLUTE)
set(CONF_FILE "${INSTALLED_CONFIG}/base.conf" "${INSTALLED_CONFIG}/gimbal.conf" "${CMAKE_CURRENT_SOURCE_DIR}/prj.conf")
find_package(Zephyr REQUIRED HINTS $ENV{ZEPHYR_BASE})
project(gimbal_link_observe)
target_sources(app PRIVATE src/main.cpp)
```

## prj.conf
```kconfig
CONFIG_SKYWALKER_ROBOTICS_SWERVE=n
CONFIG_SKYWALKER_LIB_COMMUNICATION=y
CONFIG_SKYWALKER_UART_TRANSPORT=y
CONFIG_SKYWALKER_INTERBOARD_ENDPOINT=y
```

## src/main.cpp
```c
#include <robotics/vehicle/diagnostics.hpp>
#include <robotics/vehicle/calibration.hpp>
#include <core/clock.hpp>
#include <zephyr/kernel.h>
#include <zephyr/device.h>
#include <zephyr/devicetree.h>
using namespace skywalker;
using namespace skywalker::robotics;
namespace installed = skywalker::robotics::vehicle;
using installed::DiagnosticReason;
#include <communication/interboard/configured_interboard_transport.hpp>
#include <communication/interboard/interboard_endpoint.hpp>
#include "../../../robotics/common/operator_controls.hpp"
communication::AsyncUart::DmaBuffers link_dma __nocache;
communication::ConfiguredInterBoardTransport transport({.kind = communication::InterBoardTransportKind::Uart,
                                                        .uart = DEVICE_DT_GET(DT_ALIAS(interboard_uart))},
                                                       &link_dma);

communication::InterBoardEndpoint endpoint(transport, {BoardRole::GimbalController});
int main() {
    installed::Diagnostics diagnostics;
    diagnostics.start("gimbal_link_observe", "gimbal", "observe only");
    for (;;) {
        const auto now = static_cast<std::uint64_t>(k_uptime_get());
        endpoint.poll(now);
        const auto peer = endpoint.snapshot();
        diagnostics.status({.reason = peer.online ? DiagnosticReason::Ready : DiagnosticReason::PeerStale,
                            .valid = peer.online,
                            .enabled = false,
                            .target = peer.big_yaw_request.target_rate_rad_s,
                            .feedback = peer.big_yaw_feedback.actual_rate_rad_s,
                            .age_ms = peer.peer.stamp.valid && now >= peer.peer.stamp.timestamp_ms
                                          ? std::uint32_t(now - peer.peer.stamp.timestamp_ms)
                                          : UINT32_MAX,
                            .detail = float(peer.operator_control_valid),
                            .error = peer.error,
                            .extra0 = float(peer.rejected_frames),
                            .extra1 = float(peer.big_yaw_feedback.valid)});
        k_sleep(K_MSEC(2));
    }
}
```
