## CMakeLists.txt
```
cmake_minimum_required(VERSION 3.20.0)
find_package(Zephyr REQUIRED HINTS $ENV{ZEPHYR_BASE})
project(swerve_bench)
# Temporary dual-speed diagnostic; select src/main.cpp to restore swerve control.
target_sources(app PRIVATE src/dual_speed.cpp)
```

## sample.yaml
```
sample:
  name: SkyWalker swerve on-board bench
  description: Standalone DM MC02 hardware exercise; requires the documented wiring
common:
  tags: [skywalker, hardware]
  platform_allow: [dm_mc02/stm32h723xx]
  build_only: true
tests:
  sample.skywalker.robotics.swerve: {}
  sample.skywalker.robotics.swerve.diagnostic:
    extra_args: EXTRA_CONF_FILE=diagnostic.conf
```

## prj.conf
```kconfig
CONFIG_CPP=y
CONFIG_STD_CPP20=y
CONFIG_REQUIRES_FULL_LIBCPP=y
CONFIG_MAIN_STACK_SIZE=8192
CONFIG_LOG=y
CONFIG_LOG_MODE_DEFERRED=y
CONFIG_CBPRINTF_FP_SUPPORT=y
CONFIG_CAN=y
CONFIG_SERIAL=y
CONFIG_SKYWALKER_DRIVER_MOTOR=y
CONFIG_SKYWALKER_MOTOR_DJI=y
CONFIG_SKYWALKER_LIB_ROBOTICS=y
```

## app.overlay
```dts
/* MC02 CAN1: GM6020 steer ID1. CAN2: M3508 wheel ID1.
 * Wiring and calibrated hardware values live in robotics/vehicle/calibration.hpp.
 */
/ {};
```

## src/main.cpp
```c
#include <cerrno>
#include <cmath>
#include <limits>
#include <core/clock.hpp>
#include <drivers/motor/can_bus.hpp>
#include <drivers/motor/group.hpp>
#include <lib/vofa/vofa.h>
#include <robotics/swerve/swerve_kinematics.hpp>
#include "../../common/rc_controls.hpp"
#include "../../common/sample_diagnostics.hpp"
#include <zephyr/kernel.h>
#include <zephyr/logging/log.h>
#include "board_config.hpp"
LOG_MODULE_REGISTER(swerve_bench, LOG_LEVEL_INF);
static_assert(DT_NODE_HAS_COMPAT(DT_ALIAS(telemetry_uart), zephyr_cdc_acm_uart),
              "Swerve telemetry requires a USB CDC ACM telemetry-uart");

int main() {
    using namespace skywalker;
    using namespace skywalker::robotics;
    namespace input = samples::control;
    const auto steer_config = bench::steerHardware(), drive_config = bench::driveHardware();
    static motor::Motor steer(steer_config), drive(drive_config);
    static motor::Group group(steer, drive);
    static motor::CanBus steer_bus(bench::steer_can), drive_bus(bench::drive_can);
    const auto module_config = bench::moduleConfig();
    SwerveModule module(module_config);
    SwerveKinematics kinematics(bench::kinematicsConfig(module_config));
    int ret = bench::hardware_confirmed && bench::steer_can != bench::drive_can ? module.validate() : -EINVAL;
    if (ret == 0)
        ret = kinematics.reset(ModuleTargets{});
    if (ret == 0)
        ret = steer_bus.attach(steer);
    if (ret == 0)
        ret = drive_bus.attach(drive);
    if (ret == 0)
        ret = steer_bus.start();
    if (ret == 0)
        ret = drive_bus.start();
    if (ret < 0) {
        LOG_ERR("configuration=%d", ret);
        return ret;
    }
    static communication::AsyncUart::DmaBuffers remote_dma __nocache;
    static communication::RemoteReceiver remote(DEVICE_DT_GET(DT_ALIAS(remote_uart)), remote_dma,
                                                input::receiverConfig());
    ret = remote.start();
    if (ret < 0)
        return ret;
    static Vofa vofa{};
    const auto uart = DEVICE_DT_GET(DT_ALIAS(telemetry_uart));
    const int vofa_error = vofa_init(&vofa, uart);
    LOG_INF("GM6020 ID%u %s; M3508 ID%u %s; independent automatic recovery", unsigned(steer_config.id),
            bench::steer_can->name, unsigned(drive_config.id), bench::drive_can->name);
    LOG_INF("RC both Down + centered 500ms then left Middle, Up=manual. Left Down stops. No alignment gate.");
    input::RcControlAdapter adapter;
    input::SampleDiagnostics diagnostics;
    communication::RemoteReceiver::Snapshot remote_snapshot{};
    ChassisCommand command{};
    command.source = ControlSource::Remote;
    ModuleTargets targets{};
    ModuleOutput output{};
    bool zero_captured = !bench::capture_startup_zero;
    float steer_zero_rad = 0;
    auto previous_us = core::monotonicTimeUs();
    std::uint64_t next_log_ms = 0, next_vofa_ms = 0;
    int last_call_error = 0;
    std::uint64_t accepted_targets = 0;
    for (;;) {
        k_sleep(K_USEC(bench::control_period_us));
        const auto now_us = core::monotonicTimeUs(), now = now_us / 1000;
        const float dt = now_us > previous_us ? float(now_us - previous_us) / 1000000 : 0;
        previous_us = now_us;
        (void)remote.snapshot(remote_snapshot);
        const auto &rc = adapter.update(remote_snapshot.remote, now);
        const auto diagnostic = diagnostics.update(now, rc.run_allowed,
                                                   !rc.fresh || rc.remote.left_switch == RcSwitch::Down);
        bool requested = rc.run_allowed;
        if (!diagnostic.input_paused && rc.fresh &&
            (!command.stamp.valid || sequenceAfter(rc.remote.stamp.sequence, command.stamp.sequence))) {
            command.mode = requested ? ChassisMode::BodyVelocity : ChassisMode::Disabled;
            command.vx_m_s = input::RcControlAdapter::normalize(rc.remote.analog.left_y) * bench::test_speed_m_s;
            command.vy_m_s = -input::RcControlAdapter::normalize(rc.remote.analog.left_x) * bench::test_speed_m_s;
            command.wz_rad_s = 0;
            command.stamp = rc.remote.stamp;
        }
        if (requested && !isFresh(command.stamp, now, 100)) {
            adapter.withdraw();
            requested = false;
        }
        if (!requested) {
            command.mode = ChassisMode::Disabled;
            command.vx_m_s = command.vy_m_s = command.wz_rad_s = 0;
            group.disable();
        }
        else {
            const int error = group.enable();
            if (error < 0)
                last_call_error = error;
        }
        if (diagnostic.execution_paused && requested)
            continue;
        const auto sv = steer.snapshot(), dv = drive.snapshot();
        constexpr auto steer_fields = motor::FeedbackAbsolutePosition | motor::FeedbackVelocity;
        const bool steer_measured = sv.feedback_fresh && (sv.feedback.valid & steer_fields) == steer_fields &&
                                    std::isfinite(sv.feedback.absolute_position_rad) &&
                                    std::isfinite(sv.feedback.velocity_rad_s);
        if (!zero_captured && steer_measured) {
            steer_zero_rad = sv.feedback.absolute_position_rad;
            zero_captured = true;
        }
        ModuleFeedback f{};
        f.steer_absolute_rad = bench::steer_direction * (sv.feedback.absolute_position_rad - steer_zero_rad);
        f.steer_velocity_rad_s = bench::steer_direction * sv.feedback.velocity_rad_s;
        f.drive_velocity_rad_s = bench::drive_direction * dv.feedback.velocity_rad_s;
        f.steer_valid = requested && zero_captured && steer_measured && sv.state == motor::MotorState::Active;
        f.drive_valid = requested && dv.state == motor::MotorState::Active && dv.feedback_fresh &&
                        (dv.feedback.valid & motor::FeedbackVelocity) && std::isfinite(f.drive_velocity_rad_s);
        f.steer_feedback_stamp_ms = sv.feedback.timestamp_ms;
        f.steer_enable_generation = sv.enable_generation;
        f.steer_reference_generation = sv.reference_generation;
        f.drive_enable_generation = dv.enable_generation;
        const int solve_error = kinematics.solve(command, targets);
        const int step_error = solve_error == 0 ? module.step(targets[0], f, dt, output) : solve_error;
        if (step_error < 0) {
            last_call_error = step_error;
            if (solve_error < 0)
                output = {};
        }
        else
            ++accepted_targets;
        const int steer_error = output.steer_output_valid
                                    ? steer.setCurrent(bench::steer_direction * output.steer_effort,
                                                       output.steer_enable_generation)
                                    : steer.invalidateComputedEffort();
        const int drive_error = output.drive_output_valid
                                    ? drive.setCurrent(bench::drive_direction * output.drive_effort,
                                                       output.drive_enable_generation)
                                    : drive.invalidateComputedEffort();
        if (steer_error < 0)
            last_call_error = steer_error;
        if (drive_error < 0)
            last_call_error = drive_error;
        const int sb_error = steer_bus.commit().error, db_error = drive_bus.commit().error;
        if (sb_error < 0)
            last_call_error = sb_error;
        if (db_error < 0)
            last_call_error = db_error;
        if (vofa_error == 0 && now >= next_vofa_ms) {
            next_vofa_ms = now + 10;
            const float missing = std::numeric_limits<float>::quiet_NaN();
            const float channels[16] =
                {command.vx_m_s,
                 command.vy_m_s,
                 output.optimized_angle_rad,
                 steer_measured && zero_captured ? f.steer_absolute_rad : missing,
                 output.steer_output_valid ? output.steer_reference_rad : missing,
                 output.steer_output_valid ? output.alignment_error_rad : missing,
                 output.drive_target_rad_s,
                 dv.feedback_fresh ? f.drive_velocity_rad_s : missing,
                 output.steer_output_valid ? bench::steer_direction * output.steer_effort : 0,
                 sv.feedback_fresh && (sv.feedback.valid & motor::FeedbackCurrent) ? sv.feedback.current_a : missing,
                 output.drive_output_valid ? bench::drive_direction * output.drive_effort : 0,
                 dv.feedback_fresh && (dv.feedback.valid & motor::FeedbackCurrent) ? dv.feedback.current_a : missing,
                 float(rc.fresh),
                 float(requested),
                 float(output.steer_output_valid),
                 float(output.drive_output_valid)};
            (void)vofa_send(&vofa, channels, 16);
        }
        if (now >= next_log_ms) {
            next_log_ms = now + 1000;
            LOG_INF(
                "run=%d seq=%llu target=%.3f/%.3f state=%u/%u output=%d/%d current=%.3f/%.3f feedback=%d/%d call=%d can=%u/%u",
                requested, static_cast<unsigned long long>(accepted_targets), double(output.optimized_angle_rad),
                double(output.drive_target_rad_s), unsigned(sv.state), unsigned(dv.state), output.steer_output_valid,
                output.drive_output_valid, double(output.steer_effort), double(output.drive_effort), sv.feedback_fresh,
                dv.feedback_fresh, last_call_error, unsigned(steer_bus.status().state),
                unsigned(drive_bus.status().state));
        }
    }
}
```

## src/board_config.hpp
```c
#pragma once
#include <zephyr/device.h>
#include <zephyr/devicetree.h>
#include <drivers/motor/dji_motor.hpp>
#include <robotics/swerve/swerve_module.hpp>
#include "../../common/chassis_bench.hpp"
namespace bench {
// TODO(wiring): confirm actual split topology; steer and wheel use separate CAN.
inline const device *steer_can = DEVICE_DT_GET(DT_NODELABEL(can1));
inline const device *drive_can = DEVICE_DT_GET(DT_NODELABEL(can2));
inline constexpr bool hardware_confirmed = skywalker::robotics::vehicle::connections_confirmed;
inline skywalker::motor::dji::Config steerHardware() {
    return skywalker::samples::chassis::steerConfig(0);
}
inline skywalker::motor::dji::Config driveHardware() {
    return skywalker::samples::chassis::driveConfig(0);
}
inline constexpr float steer_direction = skywalker::robotics::vehicle::steer[0].direction;
inline constexpr float drive_direction = skywalker::robotics::vehicle::wheel[0].direction;
inline constexpr float test_speed_m_s = 0.1f;
inline skywalker::robotics::SwerveModule::Config moduleConfig() {
    return skywalker::samples::chassis::controllerConfig().modules[0];
}
}
```

## src/dual_speed.cpp
```c
// Reciprocating steer / constant-speed drive CAN diagnostic. Original swerve control remains in main.cpp.
#include <cerrno>
#include <cmath>
#include <control/velocity_motor.hpp>
#include <control/position_motor.hpp>
#include <drivers/motor/can_bus.hpp>
#include <core/clock.hpp>
#include <zephyr/kernel.h>
#include <zephyr/logging/log.h>
#include "../../common/rc_controls.hpp"
#include "board_config.hpp"
LOG_MODULE_REGISTER(dual_speed, LOG_LEVEL_INF);
namespace {
constexpr float kRequestedVelocityAbsMaxRadS = 50.0f;
constexpr float kSoftwareCurrentAbsMaxA = 0.8f;
constexpr float kDeadbandRadS = 0.20f;
constexpr float kVelocityFilterTauS = 0.025f;
control_motor_velocity_config makeVelocityLoopConfig() {
    control_motor_velocity_config config{};
    config.regulator.feedback = {
        .kp = 0.4f,
        .ki = 0.1f,
        .kd = 0.0f,
        .derivative_tau_s = 0.0f,
        .integral_min = -0.5f,
        .integral_max = 0.5f,
        .output_min = -kSoftwareCurrentAbsMaxA,
        .output_max = kSoftwareCurrentAbsMaxA,
        .deadband = 0.0f,
        .dt_min_s = 0.001f,
        .dt_max_s = 0.020f,
    };
    config.regulator.feedforward = {
        .k_bias = 0.0f,
        .k_static = 0.005f,
        .k_velocity = 0.0f,
        .k_acceleration = 0.0f,
        .k_gravity = 0.0f,
        .velocity_epsilon = 0.0f,
        .acceleration_epsilon = 0.0f,
        .gravity_model = CONTROL_GRAVITY_NONE,
    };
    config.reference_slew = {
        .rising_rate_per_s = 100.0f,
        .falling_rate_per_s = 100.0f,
    };
    config.measurement_filter_tau_s = kVelocityFilterTauS;
    config.soft_deadband_rad_s = kDeadbandRadS;
    config.requested_velocity_abs_max_rad_s = kRequestedVelocityAbsMaxRadS;
    config.effort_abs_max = kSoftwareCurrentAbsMaxA;
    return config;
}

skywalker::control::VelocityMotor::Config makeMotorConfig() {
    skywalker::control::VelocityMotor::Config config{};
    config.loop = makeVelocityLoopConfig();
    config.effort_unit = skywalker::control::EffortUnit::Ampere;

    return config;
}

skywalker::control::PositionMotor::Config makeSteerConfig() {
    skywalker::control::PositionMotor::Config config{};
    // Reuse the swerve's position/velocity cascade and current limits.
    config.loop = bench::moduleConfig().steer;
    config.loop.position.output_min = -bench::dual_steer_speed_limit_rad_s;
    config.loop.position.output_max = bench::dual_steer_speed_limit_rad_s;
    config.loop.velocity.requested_velocity_abs_max_rad_s = bench::dual_steer_speed_limit_rad_s;
    config.effort_unit = skywalker::control::EffortUnit::Ampere;

    config.reference = skywalker::control::PositionReference::AbsoluteNearest;
    return config;
}

} // namespace

int main() {
    using namespace skywalker;
    namespace input = samples::control;
    const auto steer_config = bench::steerHardware(), drive_config = bench::driveHardware();
    static motor::Motor steer(steer_config), drive(drive_config);
    static motor::CanBus steer_bus(bench::steer_can), drive_bus(bench::drive_can);
    static control::PositionMotor steer_axis(steer, makeSteerConfig());
    static control::VelocityMotor drive_axis(drive, makeMotorConfig());
    static communication::AsyncUart::DmaBuffers remote_dma __nocache;
    static communication::RemoteReceiver remote(DEVICE_DT_GET(DT_ALIAS(remote_uart)), remote_dma,
                                                input::receiverConfig());
    int ret = bench::hardware_confirmed && bench::steer_can != bench::drive_can ? 0 : -EINVAL;
    if (ret == 0)
        ret = steer_bus.attach(steer);
    if (ret == 0)
        ret = drive_bus.attach(drive);
    if (ret == 0)
        ret = steer_bus.start();
    if (ret == 0)
        ret = drive_bus.start();
    if (ret == 0)
        ret = steer_axis.configure();
    if (ret == 0)
        ret = drive_axis.configure();
    if (ret == 0)
        ret = remote.start();
    if (ret < 0)
        return ret;
    LOG_INF("DUAL_SPEED GM6020 ID%u %s POSITION; M3508 ID%u %s speed=%.3f rad/s", unsigned(steer_config.id),
            bench::steer_can->name, unsigned(drive_config.id), bench::drive_can->name, double(bench::dual_drive_rad_s));
    LOG_INF("RC both Down + centered 500ms then left Middle. Motor recovery needs no re-arm.");
    input::RcControlAdapter adapter;
    communication::RemoteReceiver::Snapshot remote_snapshot{};
    bool previous_requested = false, center_valid = false;
    float center = 0;
    core::TimeUs started_us = 0, next_log_us = 0;
    auto previous_us = core::monotonicTimeUs();
    int last_call_error = 0;
    for (;;) {
        k_sleep(K_USEC(bench::control_period_us));
        const auto now_us = core::monotonicTimeUs();
        const float dt = now_us > previous_us ? float(now_us - previous_us) / 1000000 : 0;
        previous_us = now_us;
        (void)remote.snapshot(remote_snapshot);
        const auto &rc = adapter.update(remote_snapshot.remote, now_us / 1000);
        const bool requested = rc.run_allowed;
        if (requested && !previous_requested) {
            started_us = now_us;
            center_valid = false;
        }
        previous_requested = requested;
        const auto elapsed_ms = requested ? (now_us - started_us) / 1000 : 0;
        const auto phase_ms = elapsed_ms < 500 ? 0 : (elapsed_ms - 500) % bench::dual_steer_period_ms;
        const double phase = 6.28318530718 * double(phase_ms) / double(bench::dual_steer_period_ms);
        const float relative_target = elapsed_ms < 500 ? 0 : bench::dual_steer_amplitude_rad * std::sin(phase);
        const float drive_target = elapsed_ms < 500 ? 0 : bench::dual_drive_rad_s;
        const auto sv = steer.snapshot();
        if (requested && !center_valid && sv.feedback_fresh && (sv.feedback.valid & motor::FeedbackAbsolutePosition) &&
            std::isfinite(sv.feedback.absolute_position_rad)) {
            center = sv.feedback.absolute_position_rad;
            center_valid = true;
        }
        const int se = requested ? steer.enable() : steer.disable();
        const int de = requested ? drive.enable() : drive.disable();
        if (se < 0)
            last_call_error = se;
        if (de < 0)
            last_call_error = de;
        if (requested) {
            if (center_valid) {
                const int error = steer_axis.update(center + relative_target, dt);
                if (error < 0)
                    last_call_error = error;
            }
            else
                (void)steer_axis.reset();
            const int error = drive_axis.update(drive_target, dt);
            if (error < 0)
                last_call_error = error;
        }
        const int sb = steer_bus.commit().error, db = drive_bus.commit().error;
        if (sb < 0)
            last_call_error = sb;
        if (db < 0)
            last_call_error = db;
        if (now_us >= next_log_us) {
            next_log_us = now_us + 1000000;
            const auto position = steer_axis.telemetry();
            const auto velocity = drive_axis.telemetry();
            LOG_INF(
                "run=%d center=%d elapsed=%llu relative=%.3f 6020 target=%.3f actual=%.3f output=%d wait=%u; 3508 target=%.3f actual=%.3f output=%d wait=%u call=%d",
                requested, center_valid, static_cast<unsigned long long>(elapsed_ms), double(relative_target),
                position.requested_position_rad, position.position_rad, position.output_valid && requested,
                unsigned(position.issue), double(velocity.target_rad_s), double(velocity.motor.feedback.velocity_rad_s),
                velocity.output_valid && requested, unsigned(velocity.issue), last_call_error);
        }
    }
}
```
