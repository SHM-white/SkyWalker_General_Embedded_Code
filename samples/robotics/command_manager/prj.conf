## CMakeLists.txt
```
cmake_minimum_required(VERSION 3.20.0)
find_package(Zephyr REQUIRED HINTS $ENV{ZEPHYR_BASE})
project(command_manager_bench LANGUAGES C CXX)
target_sources(app PRIVATE
    src/main.cpp src/telemetry.cpp)
```

## Kconfig
```
mainmenu "Three-source command manager bench"
source "Kconfig.zephyr"
config COMMAND_MANAGER_VOFA
    bool "Emit final commands through USB VOFA"
    default n
```

## sample.yaml
```
sample:
  name: SkyWalker three-source command manager bench
  description: Observe remote, vision and referee command arbitration without actuators
common:
  tags: [skywalker, hardware]
  platform_allow: [dm_mc02/stm32h723xx]
  build_only: true
tests:
  sample.skywalker.robotics.command_manager: {}
```

## prj.conf
```kconfig
CONFIG_CPP=y
CONFIG_STD_CPP20=y
CONFIG_REQUIRES_FULL_LIBCPP=y
CONFIG_MAIN_STACK_SIZE=8192
CONFIG_HEAP_MEM_POOL_SIZE=0
CONFIG_LOG=y
CONFIG_CBPRINTF_FP_SUPPORT=y
CONFIG_SERIAL=y
CONFIG_UART_ASYNC_API=y
CONFIG_NOCACHE_MEMORY=y
CONFIG_SKYWALKER_LIB_COMMUNICATION=y
CONFIG_SKYWALKER_UART_TRANSPORT=y
CONFIG_SKYWALKER_REMOTE_DR16=y
CONFIG_SKYWALKER_REMOTE_RECEIVER=y
CONFIG_SKYWALKER_REFEREE=y
CONFIG_SKYWALKER_INTERBOARD=n
CONFIG_SKYWALKER_VISION=y
CONFIG_SKYWALKER_VISION_AB=y
CONFIG_SKYWALKER_VISION_RECEIVER=y
CONFIG_SKYWALKER_LIB_ROBOTICS=y
CONFIG_SKYWALKER_ROBOTICS_COMMAND=y
CONFIG_SKYWALKER_ROBOTICS_SAFETY=n
CONFIG_SKYWALKER_ROBOTICS_SWERVE=n
CONFIG_SKYWALKER_ROBOTICS_GIMBAL=n
CONFIG_SKYWALKER_DRIVER_MOTOR=n
CONFIG_SKYWALKER_IMU=n
```

## vofa.conf
```kconfig
CONFIG_COMMAND_MANAGER_VOFA=y
CONFIG_SKYWALKER_LIB_VOFA=y
CONFIG_USB_DEVICE_STACK_NEXT=y
CONFIG_CDC_ACM_SERIAL_INITIALIZE_AT_BOOT=y
CONFIG_CDC_ACM_SERIAL_PRODUCT_STRING="SkyWalker Command Bench"
CONFIG_USBD_CDC_ACM_LOG_LEVEL_WRN=y
```

## app.overlay
```dts
/ {
    aliases {
        remote-uart = &uart5;
        vision-uart = &uart7;
        referee-uart = &usart1;
        telemetry-uart = &cdc_acm_uart0;
    };
};
&uart7 {
    current-speed = <115200>;
};
&usart1 { current-speed = <115200>; };
```

## src/main.cpp
```c
#include "board_config.hpp"
#include "telemetry.hpp"
#include <robotics/command/receiver_sources.hpp>
#include "../../common/rc_controls.hpp"
#include <zephyr/logging/log.h>
LOG_MODULE_REGISTER(command_manager_bench, LOG_LEVEL_INF);

namespace {
using namespace skywalker;
static communication::AsyncUart::DmaBuffers rc_dma __nocache;
static communication::AsyncUart::DmaBuffers vision_dma __nocache;
static communication::AsyncUart::DmaBuffers referee_dma __nocache;
static communication::RemoteReceiver remote(bench::inputs.remote_uart, rc_dma, bench::inputs.remote);
static communication::vision::AbProtocol protocol(bench::inputs.protocol);
static communication::vision::VisionReceiver vision(bench::inputs.vision_uart, vision_dma, protocol,
                                                    bench::inputs.vision);
static communication::RefereeReceiver referee(bench::inputs.referee_uart, referee_dma,
                                              bench::inputs.referee_timeout_ms);
static robotics::RemoteSource remote_source(remote);
class ArmedRemoteSource final : public robotics::ICommandSource {
public:
    robotics::SourceRole role() const override {
        return robotics::SourceRole::Operator;
    }
    int start() override {
        return remote_source.start();
    }
    int sample(robotics::SourceSample &out) override {
        const int ret = remote_source.sample(out);
        if (ret != 0)
            return ret;
        auto &input = std::get<robotics::RemoteState>(out.value);
        const auto &state = controls_.update(input, k_uptime_get());
        if (!state.run_allowed)
            input.left_switch = robotics::RcSwitch::Down;
        return 0;
    }

private:
    samples::control::RcControlAdapter controls_{{true}};
} armed_remote_source;
static robotics::VisionSource vision_source(vision);
static robotics::RefereePermissionSource permission_source(referee);
static robotics::CommandManager manager(bench::manager);
static bench::Telemetry telemetry;
}

int main() {
    int ret = manager.registerSource(armed_remote_source);
    if (ret == 0)
        ret = manager.registerSource(vision_source);
    if (ret == 0)
        ret = manager.bindPermissions(permission_source);
    if (ret == 0)
        ret = manager.start();
    if (ret < 0) {
        LOG_ERR("command service start: %d", ret);
        return ret;
    }
    const int output = telemetry.start(bench::telemetry_uart);
    LOG_INF("command service started; telemetry=%d; command observation bench", output);
    robotics::CommandSnapshot frame{};
    for (;;) {
        if (manager.snapshot(frame) == 0)
            telemetry.emit(frame);
        k_sleep(K_MSEC(10));
    }
}
```

## src/board_config.hpp
```c
#pragma once
#include <robotics/command/receiver_sources.hpp>
#include <communication/vision/ab_protocol.hpp>
#include <robotics/command/command_manager.hpp>
#include <zephyr/devicetree.h>

namespace bench {
struct InputConfig {
    const device *remote_uart = nullptr, *vision_uart = nullptr, *referee_uart = nullptr;
    skywalker::communication::RemoteReceiver::Config remote{};
    skywalker::communication::vision::AbProtocol::Config protocol{};
    skywalker::communication::vision::VisionReceiver::Config vision{};
    std::uint32_t referee_timeout_ms = 500;
};
inline const InputConfig inputs{
    .remote_uart = DEVICE_DT_GET(DT_ALIAS(remote_uart)),
    .vision_uart = DEVICE_DT_GET(DT_ALIAS(vision_uart)),
    .referee_uart = DEVICE_DT_GET(DT_ALIAS(referee_uart)),
    .remote = {.decoder = {.decode_wheel = true}},
};
#ifdef CONFIG_COMMAND_MANAGER_VOFA
inline const device *telemetry_uart = DEVICE_DT_GET(DT_ALIAS(telemetry_uart));
#else
inline const device *telemetry_uart = nullptr;
#endif
inline const skywalker::robotics::CommandManager::Config manager = [] {
    skywalker::robotics::CommandManager::Config c{};
    c.mapper.input_profile = skywalker::robotics::RemoteInputProfile::PhysicalRemote;
    c.max_chassis_vx_m_s = 0.5f;
    c.max_chassis_vy_m_s = 0.5f;
    c.max_chassis_wz_rad_s = 1.0f;
    c.max_gimbal_yaw_rate_rad_s = 1.0f;
    c.max_gimbal_pitch_rate_rad_s = 0.8f;
    c.input_timeout_ms = 100;
    c.permission_timeout_ms = 300;
    c.vision_timeout_us = 100000;
    c.expected_vision_reference = {1, 1};
    c.override_enter_norm = 0.15f;
    c.override_exit_norm = 0.05f;
    c.override_release_us = 200000;
    return c;
}();
}
```

## src/input_sources.cpp
```c
#include "input_sources.hpp"
#include <cerrno>
#include <zephyr/kernel.h>

namespace bench {
int InputSources::start() {
    if (started_)
        return -EALREADY;
    started_ = true;
    remote_start_error_ = remote_.start();
    vision_start_error_ = vision_.start();
    referee_error_ = referee_uart_.init();
    if (remote_start_error_ < 0)
        return remote_start_error_;
    if (vision_start_error_ < 0)
        return vision_start_error_;
    return referee_error_;
}

InputFrame InputSources::poll() {
    InputFrame frame{};
    auto now_ms = static_cast<std::uint64_t>(k_uptime_get());
    int sr = referee_uart_.service(now_ms);
    if (sr == -EACCES && now_ms >= referee_init_retry_ms_) {
        referee_init_retry_ms_ = now_ms + 100;
        sr = referee_uart_.init();
    }
    if (sr == 0)
        referee_error_ = 0;
    else if (sr != -EAGAIN && (sr != -EACCES || referee_error_ == 0))
        referee_error_ = sr;

    communication::AsyncUart::RxChunk chunk{};
    for (unsigned budget = 0; budget < 8; ++budget) {
        const int rr = referee_uart_.read(chunk);
        if (rr == -EOVERFLOW) {
            referee_.discardPartial();
            ++referee_resets_;
            continue;
        }
        if (rr == -EAGAIN)
            break;
        if (rr < 0) {
            if (rr != -EACCES || referee_error_ == 0)
                referee_error_ = rr;
            break;
        }
        const int pr = referee_.processBytes(chunk.bytes, chunk.size, chunk.timestamp_ms);
        if (pr < 0)
            referee_error_ = pr;
    }
    now_ms = static_cast<std::uint64_t>(k_uptime_get());
    referee_.processBytes(nullptr, 0, now_ms);
    // result 已清零；-EAGAIN 不写，-ESTALE 则写旧值并标 online=false。
    const int fs = referee_.snapshot(now_ms, frame.commands.referee);
    if (fs != 0 && fs != -EAGAIN && fs != -ESTALE)
        referee_error_ = fs;

    (void)remote_.snapshot(rc_);
    const auto vs = vision_.snapshot();
    frame.commands.remote = rc_.remote;
    frame.commands.vision = vs.link.aim;
    frame.remote_state = rc_.state;
    frame.vision_state = vs.state;
    frame.remote_error = remote_start_error_ < 0 ? remote_start_error_ : rc_.uart_error;
    frame.vision_error = vision_start_error_ < 0 ? vision_start_error_ : vs.uart_error;
    frame.referee_error = referee_error_;
    frame.remote_dropped = rc_.dropped;
    frame.vision_dropped = vs.dropped;
    frame.referee_dropped = referee_uart_.droppedChunks();
    frame.referee_resets = referee_resets_;
    return frame;
}
}
```

## src/input_sources.hpp
```c
#pragma once
#include <communication/remote/remote_receiver.hpp>
#include <communication/vision/ab_protocol.hpp>
#include <communication/vision/vision_receiver.hpp>
#include <communication/referee/referee_service.hpp>
#include <robotics/command/command_inputs.hpp>

namespace bench {
using namespace skywalker;
namespace vision = communication::vision;

struct InputFrame {
    robotics::CommandInputs inputs{};
    communication::RemoteReceiver::State remote_state{};
    vision::VisionReceiver::State vision_state{};
    int remote_error = 0, vision_error = 0, referee_error = 0;
    std::uint32_t remote_dropped = 0, vision_dropped = 0, referee_dropped = 0;
    std::uint32_t referee_resets = 0;
};

class InputSources {
public:
    struct Config {
        const device *remote_uart = nullptr, *vision_uart = nullptr, *referee_uart = nullptr;
        communication::RemoteReceiver::Config remote{};
        vision::AbProtocol::Config protocol{};
        vision::VisionReceiver::Config vision{};
        communication::RefereeVersion referee_version = communication::RefereeVersion::Rm2026V1_3;
        std::uint32_t referee_timeout_ms = 500;
    };

    InputSources(const Config &c, communication::AsyncUart::DmaBuffers &r, communication::AsyncUart::DmaBuffers &v,
                 communication::AsyncUart::DmaBuffers &f)
        : remote_(c.remote_uart, r, c.remote), protocol_(c.protocol), vision_(c.vision_uart, v, protocol_, c.vision),
          referee_uart_(c.referee_uart, f), referee_(c.referee_version, c.referee_timeout_ms) {
    }
    [[nodiscard]] int start();
    InputFrame poll();

private:
    communication::RemoteReceiver remote_;
    vision::AbProtocol protocol_; // 必须在 vision_ 之前构造并持续存活。
    vision::VisionReceiver vision_;
    communication::AsyncUart referee_uart_;
    communication::RefereeService referee_;
    communication::RemoteReceiver::Snapshot rc_{}; // 长期保留，不能每轮清零。
    int remote_start_error_ = 0, vision_start_error_ = 0, referee_error_ = 0;
    std::uint32_t referee_resets_ = 0;
    std::uint64_t referee_init_retry_ms_ = 0;
    bool started_ = false;
};
}
```

## src/telemetry.cpp
```c
#include "telemetry.hpp"
#include <zephyr/logging/log.h>
LOG_MODULE_REGISTER(command_telemetry, LOG_LEVEL_INF);
namespace bench {
using namespace skywalker;
namespace {
const char *source(robotics::ControlSource s) {
    switch (s) {
    case robotics::ControlSource::None:
        return "None";
    case robotics::ControlSource::Remote:
        return "Remote";
    case robotics::ControlSource::KeyboardMouse:
        return "KeyboardMouse";
    case robotics::ControlSource::Vision:
        return "Vision";
    case robotics::ControlSource::Autonomous:
        return "Autonomous";
    }
    return "Unknown";
}
const char *mode(robotics::OperatorMode m) {
    switch (m) {
    case robotics::OperatorMode::Safe:
        return "Safe";
    case robotics::OperatorMode::Manual:
        return "Manual";
    case robotics::OperatorMode::Auto:
        return "Auto";
    }
    return "Unknown";
}
long long age(const robotics::MessageStamp &s, std::uint64_t now) {
    return s.valid && now >= s.timestamp_ms ? static_cast<long long>(now - s.timestamp_ms) : -1;
}
}
int Telemetry::start(const device *uart) {
#ifdef CONFIG_COMMAND_MANAGER_VOFA
    const int ret = vofa_init(&vofa_, uart);
    vofa_ready_ = ret == 0;
    return ret;
#else
    (void)uart;
    return 0;
#endif
}
void Telemetry::emit(const robotics::CommandSnapshot &f) {
    const auto &d = f.decision;
    const auto now = static_cast<std::uint64_t>(k_uptime_get());
    const auto &c = d.command;
    if (now >= next_log_ms_) {
        next_log_ms_ = now + 100;
        LOG_INF("seq=%u mode=%s override=%u quiet=%u error=%d reasons(c/g/s)=%08x/%08x/%08x", c.stamp.sequence,
                mode(d.operator_mode), unsigned(d.manual_override), unsigned(d.override_quiet), d.error,
                d.chassis_reasons, d.gimbal_reasons, d.shooter_reasons);
        LOG_INF(
            "chassis[%u %s] v=%.2f/%.2f/%.2f gimbal[%u %s] q=%.2f/%.2f rate=%.2f/%.2f shooter[%u %s] hz=%.2f speed=%.2f",
            unsigned(c.chassis.mode), source(c.chassis.source), double(c.chassis.vx_m_s), double(c.chassis.vy_m_s),
            double(c.chassis.wz_rad_s), unsigned(c.gimbal.mode), source(c.gimbal.source),
            double(c.gimbal.yaw_target_rad), double(c.gimbal.pitch_target_rad), double(c.gimbal.yaw_rate_rad_s),
            double(c.gimbal.pitch_rate_rad_s), unsigned(c.shooter.mode), source(c.shooter.source),
            double(c.shooter.fire_rate_hz), double(c.shooter.requested_bullet_speed_m_s));
        const auto &r = f.observed.referee.robot;
        const auto &v = f.observed.vision.stamp;
        const long long va = v.valid && now >= v.time_us / 1000 ? static_cast<long long>(now - v.time_us / 1000) : -1;
        LOG_INF(
            "age_ms(-1=NA) rc=%lld vision=%lld permit(g/c/s)=%lld/%lld/%lld state(rc/v)=%u/%u uart=%d/%d/%d drop=%u/%u/%lld sample=%d/%d/%d vofa=%u/%d",
            age(f.observed.remote.stamp, now), va, age(r.gimbal_output.stamp, now), age(r.chassis_output.stamp, now),
            age(r.shooter_output.stamp, now), unsigned(f.remote.state), unsigned(f.vision.state), f.remote.error,
            f.vision.error, f.permission.error, f.remote.dropped, f.vision.dropped,
            f.permission.dropped_available ? static_cast<long long>(f.permission.dropped) : -1LL, f.remote.sample_error,
            f.vision.sample_error, f.permission.sample_error, vofa_rejected_, last_vofa_error_);
        if (d.selected_vision.stamp.valid) {
            const auto &v = d.selected_vision.value;
            LOG_INF("vision_seq=%llu reference=%u/%u acceleration=%.2f/%.2f",
                    static_cast<unsigned long long>(d.selected_vision.stamp.sequence), v.reference.frame_id,
                    v.reference.epoch, double(v.yaw.acceleration_rad_s2), double(v.pitch.acceleration_rad_s2));
        }
    }
#ifdef CONFIG_COMMAND_MANAGER_VOFA
    if (vofa_ready_ && now >= next_vofa_ms_) {
        next_vofa_ms_ = now + 20;
        const auto reasons = d.reasons();
        const float values[VOFA_MAX_FLOATS] = {float(d.operator_mode),   float(c.gimbal.source),
                                               float(c.chassis.mode),    float(c.gimbal.mode),
                                               float(c.shooter.mode),    c.chassis.vx_m_s,
                                               c.chassis.vy_m_s,         c.chassis.wz_rad_s,
                                               c.gimbal.yaw_target_rad,  c.gimbal.pitch_target_rad,
                                               c.gimbal.yaw_rate_rad_s,  c.gimbal.pitch_rate_rad_s,
                                               c.shooter.fire_rate_hz,   c.shooter.requested_bullet_speed_m_s,
                                               float(reasons & 0xffffu), float(reasons >> 16)};
        last_vofa_error_ = vofa_send(&vofa_, values, VOFA_MAX_FLOATS);
        if (last_vofa_error_ < 0)
            ++vofa_rejected_;
    }
#endif
}
}
```

## src/telemetry.hpp
```c
#pragma once
#include "input_sources.hpp"
#include <lib/vofa/vofa.h>

namespace bench {
class Telemetry {
public:
    int start(const device *vofa_uart);
    void emit(const InputFrame &, const skywalker::robotics::CommandDecision &, int step_error);

private:
    Vofa vofa_{};
    bool vofa_ready_ = false;
    std::uint64_t next_log_ms_ = 0, next_vofa_ms_ = 0;
    std::uint32_t vofa_rejected_ = 0;
    int last_vofa_error_ = 0;
};
}
```
