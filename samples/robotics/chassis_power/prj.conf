## CMakeLists.txt
```
cmake_minimum_required(VERSION 3.20.0)
find_package(Zephyr REQUIRED HINTS $ENV{ZEPHYR_BASE})
project(chassis_power_bench)
target_sources(app PRIVATE src/main.cpp)
```

## sample.yaml
```
sample:
  name: SkyWalker chassis power bench
  description: Actual referee permissions and budgets drive the eight-motor power limiting chain
common:
  tags: [skywalker, hardware, chassis, referee]
  platform_allow: [dm_mc02/stm32h723xx]
  build_only: true
tests:
  sample.skywalker.robotics.chassis_power: {}
```

## prj.conf
```kconfig
CONFIG_CPP=y
CONFIG_STD_CPP20=y
CONFIG_REQUIRES_FULL_LIBCPP=y
CONFIG_MAIN_STACK_SIZE=8192
CONFIG_LOG=y
CONFIG_LOG_MODE_DEFERRED=y
CONFIG_CAN=y
CONFIG_SERIAL=y
CONFIG_NOCACHE_MEMORY=y
CONFIG_UART_ASYNC_API=y
CONFIG_SKYWALKER_DRIVER_MOTOR=y
CONFIG_SKYWALKER_MOTOR_DJI=y
CONFIG_SKYWALKER_LIB_ROBOTICS=y
CONFIG_SKYWALKER_ROBOTICS_SWERVE=y
CONFIG_SKYWALKER_LIB_COMMUNICATION=y
CONFIG_SKYWALKER_UART_TRANSPORT=y
CONFIG_SKYWALKER_REFEREE=y
CONFIG_SKYWALKER_REMOTE_DR16=n
CONFIG_SKYWALKER_INTERBOARD=n
```

## measurement_diagnostic.conf
```kconfig
CONFIG_SAMPLE_DIAGNOSTIC_SCENARIO=7
```

## app.overlay
```dts
/* MC02 USART1 PA10 RX / PA9 TX; referee User TX -> PA10, common GND. */
/ { aliases { referee-uart = &usart1; }; };
&usart1 { current-speed = <115200>; };
```

## src/main.cpp
```c
#include "board_config.hpp"
#include "../../common/chassis_bench.hpp"

int main() {
    return skywalker::samples::chassis::run(bench::steer_can, bench::drive_can, true, bench::referee_uart);
}
```

## src/board_config.hpp
```c
#pragma once
#include <zephyr/device.h>
#include <zephyr/devicetree.h>
#include "../../common/chassis_can.hpp"
namespace bench {
inline const device *steer_can = skywalker::samples::chassis::steer_can;
inline const device *drive_can = skywalker::samples::chassis::drive_can;
// TODO(wiring/profile): confirm referee User UART and select RM2027 when enabling the referee input.
inline const device *referee_uart = DEVICE_DT_GET(DT_ALIAS(referee_uart));
}
```
