## CMakeLists.txt
```
cmake_minimum_required(VERSION 3.20.0)
find_package(Zephyr REQUIRED HINTS $ENV{ZEPHYR_BASE})
project(big_yaw)
target_sources(app PRIVATE src/main.cpp)
```

## sample.yaml
```
sample:
  name: Big Yaw continuous velocity bench
  description: Independent DM4310 velocity inner loop, production expiry and recovery context
common:
  tags: [robotics, motor, can]
  platform_allow: [dm_mc02]
  build_only: true
tests:
  sample.robotics.big_yaw: {}
  sample.robotics.big_yaw.diagnostic:
    extra_args: EXTRA_CONF_FILE=diagnostic.conf
```

## prj.conf
```kconfig
CONFIG_CPP=y
CONFIG_STD_CPP20=y
CONFIG_REQUIRES_FULL_LIBCPP=y
CONFIG_MAIN_STACK_SIZE=8192
CONFIG_CAN=y
CONFIG_SERIAL=y
CONFIG_LOG=y
CONFIG_CBPRINTF_FP_SUPPORT=y
CONFIG_SKYWALKER_DRIVER_MOTOR=y
CONFIG_SKYWALKER_MOTOR_DM=y
CONFIG_SKYWALKER_LIB_CONTROL=y
CONFIG_SKYWALKER_LIB_MOTOR_CONTROL=y
CONFIG_SKYWALKER_LIB_ROBOTICS=y
CONFIG_SKYWALKER_ROBOTICS_BIG_YAW=y

CONFIG_SKYWALKER_LIB_COMMUNICATION=y
CONFIG_SKYWALKER_UART_TRANSPORT=y
CONFIG_SKYWALKER_REMOTE_DR16=y
CONFIG_SKYWALKER_REMOTE_RECEIVER=y
CONFIG_UART_ASYNC_API=y
CONFIG_NOCACHE_MEMORY=y
CONFIG_SKYWALKER_INTERBOARD=n
CONFIG_SKYWALKER_REFEREE=n
```

## app.overlay
```dts
/* TODO(wiring): chassis board big-Yaw occupies its reserved CAN2. */
&can2 { status = "okay"; bitrate = <1000000>; };
```

## src/main.cpp
```c
#include "../../common/chassis_can.hpp"
#include "../../common/rc_controls.hpp"
#include "../../common/sample_diagnostics.hpp"
#include <core/clock.hpp>
#include <drivers/motor/can_bus.hpp>
#include <robotics/vehicle/big_yaw_profile.hpp>
#include <zephyr/kernel.h>
#include <zephyr/logging/log.h>
#if defined(CONFIG_BOARD_DM_MC02)
#include <zephyr/drivers/regulator.h>
#endif
LOG_MODULE_REGISTER(big_yaw_bench, LOG_LEVEL_INF);
using namespace skywalker;
using namespace skywalker::robotics;
int main() {
    namespace input = skywalker::samples::control;
    static_assert(input::diagnostic_scenario == input::DiagnosticScenario::None ||
                  input::diagnostic_scenario == input::DiagnosticScenario::InputPause ||
                  input::diagnostic_scenario == input::DiagnosticScenario::ExecutionPause ||
                  input::diagnostic_scenario == input::DiagnosticScenario::StatusPause);
    static communication::AsyncUart::DmaBuffers remote_dma __nocache;
    static communication::RemoteReceiver remote(DEVICE_DT_GET(DT_ALIAS(remote_uart)), remote_dma,
                                                input::receiverConfig());
    static motor::Motor drive(vehicle::bigYawHardware());
    static motor::CanBus bus(samples::chassis::big_yaw_can);
    static BigYawExecutor axis(drive, vehicle::bigYawMotorConfig(), vehicle::bigYawExecutionConfig());
    const int remote_error = remote.start();
    if (remote_error < 0)
        return remote_error;
    bool started = false;
    int ret = 0;
    if (vehicle::connections_confirmed) {
        ret = bus.attach(drive);
        if (ret == 0)
            ret = bus.start();
#if defined(CONFIG_BOARD_DM_MC02)
        if (ret == 0)
            ret = regulator_enable(DEVICE_DT_GET(DT_NODELABEL(power1)));
#endif
        if (ret == 0)
            ret = axis.begin();
        started = ret == 0;
    }
    LOG_INF("RC safe+center 0.5s then left Middle, Up=manual; right Down spin 0.1 rad/s; confirmed=%d setup=%d",
            vehicle::connections_confirmed, ret);
    communication::RemoteReceiver::Snapshot snapshot{};
    input::RcControlAdapter adapter;
    input::SampleDiagnostics diagnostics;
    std::uint64_t next_log = 0;
    BigYawRequest request{};
    RunStatus published{};
    int commit_error = 0;
    for (;;) {
        const auto now = core::monotonicTimeUs(), ms = now / 1000;
        (void)remote.snapshot(snapshot);
        const auto &rc = adapter.update(snapshot.remote, ms);
        const auto diagnostic = diagnostics.update(ms, rc.run_allowed,
                                                   !rc.fresh || rc.remote.left_switch == RcSwitch::Down);
        if (!diagnostic.input_paused && rc.fresh &&
            (!request.stamp.valid || sequenceAfter(rc.remote.stamp.sequence, request.stamp.sequence))) {
            request.mode = rc.run_allowed ? BigYawMode::FollowCenter : BigYawMode::Disabled;
            request.target_rate_rad_s = rc.spin_requested ? .1f : 0;
            request.stamp = rc.remote.stamp;
            request.source_sequence = rc.remote.stamp.sequence;
            request.receiver_boot_id = 1;
            request.permission = {rc.fresh, vehicle::connections_confirmed && rc.run_allowed, rc.remote.stamp};
        }
        if (!rc.run_allowed) {
            request.mode = BigYawMode::Disabled;
            request.target_rate_rad_s = 0;
            request.permission.enabled = false;
        }
        if (!diagnostic.execution_paused || !rc.run_allowed || rc.clear_estop) {
            if (started) {
                BigYawExecutionInputs in{};
                in.request = request;
                in.local_boot_id = 1;
                in.peer_online = true;
                in.transport_ready = started;
                in.clear_estop = rc.clear_estop;
                axis.update(in, now);
                commit_error = bus.commit().error;
            }
            else
                axis.suspend(now, WaitReason::Configuration, ret ? ret : -ENODEV, true);
            if (!diagnostic.status_paused)
                published = axis.status();
        }
        if (ms >= next_log) {
            next_log = ms + 200;
            const auto f = axis.feedback();
            LOG_INF(
                "requested=%d run=%u wait=%u ready=%d active=%d target=%f actual=%f status_seq=%u fresh=%d error=%d commit=%d rc=%d",
                published.requested, unsigned(published.state), unsigned(published.reason), published.ready, f.armed,
                double(request.target_rate_rad_s), double(f.actual_rate_rad_s), published.stamp.sequence,
                isFresh(published.stamp, ms, 100), published.error, commit_error, rc.fresh);
        }
        k_sleep(K_MSEC(5));
    }
}
```
