## CMakeLists.txt
```
cmake_minimum_required(VERSION 3.20.0)
set(CONF_FILE
    "${CMAKE_CURRENT_SOURCE_DIR}/../../../config/vehicle/installed/base.conf"
    "${CMAKE_CURRENT_SOURCE_DIR}/../../../config/vehicle/installed/gimbal.conf"
    "${CMAKE_CURRENT_SOURCE_DIR}/prj.conf")
find_package(Zephyr REQUIRED HINTS $ENV{ZEPHYR_BASE})
project(inertial_gimbal)
target_sources(app PRIVATE src/main.cpp)
```

## Kconfig
```
mainmenu "Head inertial gimbal bench"

config INERTIAL_GIMBAL_LOCK_PITCH
    bool "Hold Pitch in its prepared mechanical position"
    default y
    help
        First validate yaw compensation while manually rotating the carrier.
        Release Pitch only after directions, IMU transform and limits are measured.

rsource "../common/sample_control.Kconfig"
source "Kconfig.zephyr"
```

## sample.yaml
```
sample:
  name: SkyWalker head inertial gimbal
  description: Head RS485 IMU, independent inertial reference session and two-CAN mechanical executor
common:
  tags: [skywalker, hardware, motor, imu]
  platform_allow: [dm_mc02/stm32h723xx]
  build_only: true
tests:
  sample.skywalker.robotics.inertial_gimbal.pitch_locked: {}
  sample.skywalker.robotics.inertial_gimbal.pitch_free:
    extra_args: EXTRA_CONF_FILE=pitch_free.conf
```

## prj.conf
```kconfig
CONFIG_CPP=y
CONFIG_STD_CPP20=y
CONFIG_REQUIRES_FULL_LIBCPP=y
CONFIG_MAIN_STACK_SIZE=8192
CONFIG_LOG=y
CONFIG_SERIAL=y
CONFIG_UART_ASYNC_API=y
CONFIG_NOCACHE_MEMORY=y
CONFIG_CAN=y
CONFIG_FPU=y
CONFIG_FPU_SHARING=y
CONFIG_SKYWALKER_DRIVER_MOTOR=y
CONFIG_SKYWALKER_MOTOR_DJI=y
CONFIG_SKYWALKER_MOTOR_DM=y
CONFIG_SKYWALKER_LIB_CONTROL=y
CONFIG_SKYWALKER_LIB_MOTOR_CONTROL=y
CONFIG_SKYWALKER_LIB_COMMUNICATION=y
CONFIG_SKYWALKER_UART_TRANSPORT=y
CONFIG_SKYWALKER_REMOTE_DR16=y
CONFIG_SKYWALKER_REMOTE_RECEIVER=y
CONFIG_SKYWALKER_LIB_VOFA=y
CONFIG_SKYWALKER_LIB_ROBOTICS=y
CONFIG_SKYWALKER_ROBOTICS_COMMAND=y
CONFIG_SKYWALKER_COMMAND_SERVICE=y
CONFIG_SKYWALKER_COMMAND_PERIOD_MS=10
CONFIG_SKYWALKER_ROBOTICS_GIMBAL=y
CONFIG_SKYWALKER_ROBOTICS_SWERVE=n
CONFIG_SKYWALKER_REFEREE=n
CONFIG_SKYWALKER_INTERBOARD=n
CONFIG_SKYWALKER_IMU=y
CONFIG_SKYWALKER_IMU_RECEIVER=y
CONFIG_SKYWALKER_IMU_DM_CAN=y
CONFIG_INERTIAL_GIMBAL_LOCK_PITCH=y
```

## pitch_free.conf
```kconfig
CONFIG_INERTIAL_GIMBAL_LOCK_PITCH=n
```

## app.overlay
```dts
/* MC02: small Yaw on CAN1, Pitch on CAN2, RC on UART5.
 * External head IMU owns RS485-2 / USART2 RX DMA8 and TX DMA11; VOFA owns USART1.
 * Reserve DMA1/2 for board SPI2, 5/7 for vision and 6 for remote UART5.
 */
&usart2 {
    current-speed = <2000000>;
    dmas = <&dmamux1 8 43 STM32_DMA_PERIPH_RX>,
           <&dmamux1 11 44 STM32_DMA_PERIPH_TX>;
    dma-names = "rx", "tx";
};
&usart1 {
    current-speed = <115200>;
};
```

## src/main.cpp
```c
#include "board_config.hpp"
#include "../../common/rc_controls.hpp"
#include "../../common/sample_diagnostics.hpp"

#include <cerrno>
#include <cmath>
#include <core/clock.hpp>
#include <drivers/motor/can_bus.hpp>
#include <limits>
#include <robotics/vehicle/diagnostics.hpp>
#include <robotics/command/receiver_sources.hpp>
#include <robotics/execution/snapshot_cache.hpp>
#include <zephyr/logging/log.h>
#include <zephyr/sys/atomic.h>

LOG_MODULE_REGISTER(inertial_gimbal_bench, LOG_LEVEL_INF);
using namespace skywalker;
using namespace skywalker::robotics;

namespace {
vehicle::Diagnostics vehicle_diagnostics;
communication::AsyncUart::DmaBuffers remote_dma __nocache;
communication::RemoteReceiver remote(board_config::remote_uart, remote_dma, samples::control::receiverConfig());
RemoteSource remote_source(remote);
atomic_t input_paused = 0, execution_paused = 0, status_paused = 0, head_paused = 0;
atomic_t estop = 0, clear_requested = 0;
class PausableRemote final : public ICommandSource {
public:
    SourceRole role() const override {
        return remote_source.role();
    }
    int start() override {
        return remote_source.start();
    }
    int sample(SourceSample &out) override {
        return atomic_get(&input_paused) ? -EAGAIN : remote_source.sample(out);
    }
} input;
CommandManager commands(board_config::command_policy);
imu::DmImuCanSource head_source(inertial_bench::head_sensor());
imu::ImuReceiver head(head_source, inertial_bench::head_receiver);
motor::Motor yaw(board_config::yawHardware()), pitch(board_config::pitchHardware());
motor::Group group(yaw, pitch);
motor::CanBus yaw_bus(board_config::yaw_can), pitch_bus(board_config::pitch_can);
GimbalExecutor executor(yaw, pitch, group, board_config::yawMotorConfig(), board_config::yaw,
                        board_config::pitchMotorConfig(), board_config::pitch, board_config::execution_policy);
InertialGimbalAdapter adapter(inertial_bench::controller());
struct Observation {
    InertialGimbalOutput inertial{};
    RunStatus execution{};
    core::Stamp head_stamp{};
    core::TimeUs duration_us = 0;
    std::uint32_t overruns = 0;
    int yaw_commit_error = 0, pitch_commit_error = 0;
    int startup_error = 0;
};
SnapshotCache<Observation> observation;
K_SEM_DEFINE(telemetry_ready, 0, 1);

void telemetryTask(void *, void *, void *) {
    k_sem_take(&telemetry_ready, K_FOREVER);
    for (;;) {
        Observation seen{};
        (void)observation.snapshot(seen);
        const auto now_us = core::monotonicTimeUs();
        const bool head_valid = seen.head_stamp.valid && now_us >= seen.head_stamp.time_us;
        const auto head_age_ms = head_valid ? (now_us - seen.head_stamp.time_us) / 1000
                                            : std::numeric_limits<std::uint32_t>::max();
        const bool fresh = head_valid && head_age_ms < board_config::command_timeout_ms;
        const bool active = seen.execution.state == RunState::Active;
        const auto reason = seen.startup_error || seen.execution.state == RunState::Blocked
                                ? vehicle::DiagnosticReason::InitFailed
                            : !fresh ? vehicle::DiagnosticReason::ImuStale
                            : active ? vehicle::DiagnosticReason::Ready
                                     : vehicle::DiagnosticReason::Disarmed;
        vehicle_diagnostics.status({.reason = reason,
                                    .valid = fresh && seen.inertial.yaw_output_valid,
                                    .enabled = active,
                                    .target = seen.inertial.command.yaw_rate_rad_s,
                                    .feedback = seen.inertial.head_yaw_rad,
                                    .age_ms = static_cast<std::uint32_t>(head_age_ms),
                                    .dt_us = float(seen.duration_us),
                                    .detail = float(unsigned(seen.execution.reason)),
                                    .error = seen.startup_error ? seen.startup_error : seen.execution.error,
                                    .extra0 = seen.inertial.head_pitch_rad,
                                    .extra1 = seen.inertial.pitch_error_rad});
        k_sleep(K_MSEC(20));
    }
}
} // namespace
K_THREAD_DEFINE(telemetry_thread, 4096, telemetryTask, nullptr, nullptr, nullptr, 7, K_FP_REGS, 0);

int main() {
    vehicle_diagnostics.start("inertial_gimbal", "gimbal",
                              "yaw<=4rad/s,pitch<=5rad/s,yaw_effort<=1.2A,pitch_effort<=0.8Nm");
    int ret = head.start();
    vehicle_diagnostics.event("head.start", ret);
    if (ret == 0)
        ret = commands.registerSource(input);
    if (ret == 0)
        ret = commands.start();
    const int source_startup_error = ret;
    vehicle_diagnostics.event("sources.start", ret);
    k_sem_give(&telemetry_ready);
    LOG_INF("inertial head bench: motor_confirmation=%d mounting_confirmation=%d pitch_lock=%d",
            board_config::connections_configured, inertial_bench::mounting_configured,
            IS_ENABLED(CONFIG_INERTIAL_GIMBAL_LOCK_PITCH));
    const bool split = board_config::yaw_can != board_config::pitch_can;
    bool attached = false, yaw_started = false, pitch_started = !split, configured = false;
    bool blocked = !board_config::connections_configured;
    int setup_error = blocked ? -EACCES : 0;
    if (!blocked) {
        ret = split ? yaw_bus.attach(yaw) : yaw_bus.attach(yaw, pitch);
        if (ret == 0 && split)
            ret = pitch_bus.attach(pitch);
        attached = ret == 0;
        blocked = ret < 0;
        setup_error = ret;
    }
    core::TimeUs retry_us = 0, previous_us = 0;
    Observation current{};
    current.startup_error = source_startup_error;
    imu::Snapshot head_cache{};
    samples::control::RcControlAdapter controls;
    samples::control::SampleDiagnostics diagnostics;
    communication::RemoteReceiver::Snapshot operator_cache{};
    for (;;) {
        (void)remote.snapshot(operator_cache);
        const auto &operator_state = controls.update(operator_cache.remote, k_uptime_get());
        const auto exercise = diagnostics.update(k_uptime_get(), current.execution.state == RunState::Active,
                                                 !operator_state.fresh ||
                                                     operator_state.remote.left_switch == RcSwitch::Down);
        atomic_set(&input_paused, exercise.input_paused);
        atomic_set(&execution_paused, exercise.execution_paused);
        atomic_set(&status_paused, exercise.status_paused);
        atomic_set(&head_paused, exercise.head_paused);
        if (operator_state.clear_estop)
            atomic_set(&clear_requested, 1);
        if (atomic_get(&execution_paused) && operator_state.run_allowed && !operator_state.clear_estop &&
            !board_config::emergencyStopRequested()) {
            k_sleep(K_MSEC(5));
            continue;
        }
        const auto now = core::monotonicTimeUs();
        if (previous_us && now - previous_us > board_config::execution_policy.max_cycle_us)
            ++current.overruns;
        previous_us = now;
        if (attached && !blocked && !configured && now >= retry_us) {
            retry_us = now + 100000;
            ret = 0;
            if (!yaw_started) {
                ret = yaw_bus.start();
                yaw_started = ret == 0;
            }
            if (ret == 0 && !pitch_started) {
                ret = pitch_bus.start();
                pitch_started = ret == 0;
            }
            if (ret == 0) {
                ret = executor.begin();
                configured = ret == 0;
                blocked = ret < 0;
            }
            else if (ret == -EINVAL || ret == -ENODEV || ret == -ENOTSUP || ret == -ENOSPC || ret == -EBUSY)
                blocked = true;
            setup_error = ret;
        }
        CommandSnapshot frame{};
        (void)commands.snapshot(frame);
        if (!atomic_get(&head_paused))
            head_cache = head.snapshot();
        InertialGimbalInputs inertial{};
        inertial.head = head_cache;
        inertial.yaw = yaw.snapshot();
        inertial.pitch = pitch.snapshot();
        inertial.command = frame.decision.command.gimbal;
        if (!operator_state.run_allowed)
            inertial.command.mode = GimbalMode::Disabled;
        inertial.source_stamp = sourceStamp(frame, inertial.command.source);
        inertial.prerequisites_ready = configured && inertial_bench::mounting_configured;
        current.inertial = adapter.update(inertial, now);
        GimbalExecutionInputs request{};
        request.command = current.inertial.command;
        request.source_stamp = current.inertial.source_stamp;
        request.transport_ready = configured;
        request.yaw_output_valid = current.inertial.yaw_output_valid;
        request.pitch_output_valid = current.inertial.pitch_output_valid;
        request.emergency_stop = atomic_get(&estop) || board_config::emergencyStopRequested();
        request.clear_estop = atomic_set(&clear_requested, 0) || board_config::takeEmergencyResetRequest();
        current.execution = configured
                                ? executor.update(request, now)
                                : executor.suspend(now, blocked ? WaitReason::Configuration : WaitReason::Transport,
                                                   setup_error, blocked);
        current.yaw_commit_error = yaw_started ? yaw_bus.commit().error : 0;
        current.pitch_commit_error = split && pitch_started ? pitch_bus.commit().error : 0;
        current.head_stamp = head_cache.sample.orientation.stamp;
        current.duration_us = core::monotonicTimeUs() - now;
        if (!atomic_get(&status_paused))
            observation.publish(current);
        k_sleep(K_MSEC(5));
    }
}
```

## src/board_config.hpp
```c
#pragma once

#include <robotics/vehicle/gimbal_profile.hpp>

namespace board_config {
namespace calibration = skywalker::robotics::vehicle;
inline constexpr bool connections_configured = calibration::connections_confirmed;
inline constexpr std::uint32_t command_timeout_ms = calibration::gimbal_command_timeout_ms;
inline constexpr std::uint16_t yaw_encoder_zero_ticks = calibration::small_yaw.encoder_zero_ticks;
inline constexpr std::uint16_t yaw_travel_low_ticks = calibration::yaw_low_ticks;
inline constexpr std::uint16_t yaw_travel_high_ticks = calibration::yaw_high_ticks;
inline constexpr float dji_encoder_ticks_per_turn = 8192.0f;
inline constexpr float two_pi = calibration::two_pi;
inline constexpr float yaw_min_angle_rad = calibration::yaw_min_rad;
inline constexpr float yaw_max_angle_rad = calibration::yaw_max_rad;
inline constexpr float yaw_center_rad = calibration::yaw_center_rad;
#if DT_NODE_HAS_STATUS(DT_ALIAS(remote_uart), okay)
inline const device *remote_uart = DEVICE_DT_GET(DT_ALIAS(remote_uart));
#else
inline const device *remote_uart = nullptr;
#endif
inline const device *yaw_can = DEVICE_DT_GET(DT_NODELABEL(can1));
inline const device *pitch_can = DEVICE_DT_GET(DT_NODELABEL(can2));
using calibration::pitchHardware;
using calibration::pitchMotorConfig;
using calibration::yawHardware;
using calibration::yawMotorConfig;
inline constexpr auto yaw = calibration::yawAxisConfig();
inline constexpr auto pitch = calibration::pitchAxisConfig();
inline constexpr float yaw_command_sign = calibration::small_yaw.direction;
inline constexpr float pitch_command_sign = calibration::pitch.direction;

// Connect physical estop/reset inputs here. RC disable remains recoverable.
inline bool emergencyStopRequested() {
    return false;
}
inline bool takeEmergencyResetRequest() {
    return false;
}

inline const auto command_policy = calibration::gimbalCommandConfig();
inline const auto execution_policy = calibration::gimbalExecutionConfig();
} // namespace board_config

#include <drivers/imu/imu_receiver.hpp>
#include <robotics/gimbal/inertial_gimbal.hpp>

namespace inertial_bench {
inline constexpr bool mounting_configured = skywalker::robotics::vehicle::imu_mounting_confirmed;
inline constexpr skywalker::imu::ImuReceiver::Config head_receiver{.poll_interval_us = 1000, .priority = 6};
inline auto head_sensor() {
    return skywalker::robotics::vehicle::headSensorConfig();
}
inline skywalker::robotics::InertialGimbalAdapter::Config controller() {
    skywalker::robotics::InertialGimbalAdapter::Config c{};
    c.yaw = board_config::yaw;
    c.pitch = board_config::pitch;
    c.yaw_direction = skywalker::robotics::vehicle::small_yaw.direction;
    c.pitch_direction = skywalker::robotics::vehicle::pitch.direction;
    c.pitch_locked = IS_ENABLED(CONFIG_INERTIAL_GIMBAL_LOCK_PITCH);
    c.allow_unknown_quality = true;
    c.yaw_kp = c.pitch_kp = 3;
    return c;
}
} // namespace inertial_bench
```
