## CMakeLists.txt
```
cmake_minimum_required(VERSION 3.20.0)
find_package(Zephyr REQUIRED HINTS $ENV{ZEPHYR_BASE})
project(vehicle_integration)
target_sources(app PRIVATE src/main.cpp)
```

## Kconfig
```
mainmenu "Staged two-board vehicle integration"
rsource "../common/vehicle.Kconfig"
source "Kconfig.zephyr"
```

## sample.yaml
```
sample:
  name: SkyWalker two-board vehicle integration
  description: Eight-wheel chassis plus independent big Yaw and inertial head, with staged sources and shooter contracts
common:
  tags: [skywalker, hardware, vehicle]
  platform_allow: [dm_mc02/stm32h723xx]
  build_only: true
tests:
  sample.skywalker.robotics.vehicle.gimbal.manual: {}
  sample.skywalker.robotics.vehicle.chassis.manual:
    extra_args: EXTRA_CONF_FILE=chassis.conf
  sample.skywalker.robotics.vehicle.gimbal.vision_observe:
    extra_args: EXTRA_CONF_FILE=vision_observe.conf
  sample.skywalker.robotics.vehicle.gimbal.vision_execute:
    extra_args: EXTRA_CONF_FILE=vision_execute.conf
  sample.skywalker.robotics.vehicle.gimbal.referee:
    extra_args: EXTRA_CONF_FILE=referee.conf
  sample.skywalker.robotics.vehicle.gimbal.shooting:
    extra_args: EXTRA_CONF_FILE=shooting.conf
  sample.skywalker.robotics.vehicle.chassis.power:
    extra_args: EXTRA_CONF_FILE="chassis.conf;power.conf"
```

## prj.conf
```kconfig
CONFIG_CPP=y
CONFIG_STD_CPP20=y
CONFIG_REQUIRES_FULL_LIBCPP=y
CONFIG_MAIN_STACK_SIZE=16384
CONFIG_HEAP_MEM_POOL_SIZE=0
CONFIG_LOG=y
CONFIG_LOG_MODE_DEFERRED=y
CONFIG_SERIAL=y
CONFIG_UART_ASYNC_API=y
CONFIG_NOCACHE_MEMORY=y
CONFIG_CAN=y
CONFIG_FPU=y
CONFIG_FPU_SHARING=y
CONFIG_ENTROPY_GENERATOR=y
CONFIG_THREAD_STACK_INFO=y
CONFIG_INIT_STACKS=y
CONFIG_SKYWALKER_DRIVER_MOTOR=y
CONFIG_SKYWALKER_MOTOR_DJI=y
CONFIG_SKYWALKER_MOTOR_DM=y
CONFIG_SKYWALKER_LIB_CONTROL=y
CONFIG_SKYWALKER_LIB_MOTOR_CONTROL=y
CONFIG_SKYWALKER_LIB_COMMUNICATION=y
CONFIG_SKYWALKER_UART_TRANSPORT=y
CONFIG_SKYWALKER_REMOTE_DR16=y
CONFIG_SKYWALKER_REMOTE_RECEIVER=y
CONFIG_SKYWALKER_REFEREE=y
CONFIG_SKYWALKER_INTERBOARD_ENDPOINT=y
CONFIG_SKYWALKER_LIB_ROBOTICS=y
CONFIG_SKYWALKER_ROBOTICS_COMMAND=y
CONFIG_SKYWALKER_COMMAND_SERVICE=y
CONFIG_SKYWALKER_ROBOTICS_SWERVE=y
CONFIG_SKYWALKER_ROBOTICS_GIMBAL=y
CONFIG_SKYWALKER_ROBOTICS_INERTIAL_GIMBAL=y
CONFIG_SKYWALKER_ROBOTICS_BIG_YAW=y
CONFIG_SKYWALKER_ROBOTICS_SHOOTER=y
CONFIG_SKYWALKER_IMU=y
CONFIG_SKYWALKER_IMU_RECEIVER=y
CONFIG_SKYWALKER_IMU_DM_RS485=y
CONFIG_SKYWALKER_VISION=y
CONFIG_SKYWALKER_VISION_AB=y
CONFIG_SKYWALKER_VISION_RECEIVER=y

CONFIG_VEHICLE_SAMPLE_CONTROLS=y
```

## chassis.conf
```kconfig
CONFIG_VEHICLE_CHASSIS_ROLE=y
```

## diagnostic.conf
```kconfig
CONFIG_SAMPLE_DIAGNOSTIC_SCENARIO=1
```

## power.conf
```kconfig
CONFIG_VEHICLE_REFEREE=y
CONFIG_VEHICLE_POWER_BUDGET=y
```

## shooting.conf
```kconfig
CONFIG_VEHICLE_REFEREE=y
CONFIG_VEHICLE_VISION_EXECUTE=y
CONFIG_VEHICLE_SHOOTING=y
CONFIG_VEHICLE_LOCK_PITCH=n
```

## app.overlay
```dts
#include "../common/vehicle_mc02.overlay"
```

## src/main.cpp
```c
#include "../../common/vehicle_bench.hpp"

int main() {
    return skywalker::samples::vehicle::run();
}
```
