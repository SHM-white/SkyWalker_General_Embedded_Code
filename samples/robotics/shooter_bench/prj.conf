## CMakeLists.txt
```
cmake_minimum_required(VERSION 3.20.0)
find_package(Zephyr REQUIRED HINTS $ENV{ZEPHYR_BASE})
project(shooter_bench LANGUAGES C CXX)
target_sources(app PRIVATE src/main.cpp)
```

## Kconfig
```
mainmenu "Shooter bench"
config SHOOTER_UNLOADED_FEED
    bool "Empty mechanism indexing without referee constraints"
    default y
config SHOOTER_MOUSE_AIM_TELEMETRY
    bool "Use the 19-channel mouse/gimbal tuning telemetry layout"
    depends on SKYWALKER_LIB_VOFA
    default n
    help
        Intended for the shared-CAN gimbal sample; gimbal measurements remain
        invalid in this shooter-only entry point.
rsource "../common/sample_control.Kconfig"
source "Kconfig.zephyr"
```

## sample.yaml
```
sample:
  name: Friction and dial staged shooter bench
common:
  tags: [skywalker, hardware, shooter]
  platform_allow: [dm_mc02/stm32h723xx]
  build_only: true
tests:
  sample.skywalker.robotics.shooter_bench: {}
  sample.skywalker.robotics.shooter_bench.loaded:
    extra_args: EXTRA_CONF_FILE=loaded.conf
  sample.skywalker.robotics.shooter_bench.diagnostic:
    extra_args: EXTRA_CONF_FILE=diagnostic.conf
```

## prj.conf
```kconfig
CONFIG_CPP=y
CONFIG_STD_CPP20=y
CONFIG_REQUIRES_FULL_LIBCPP=y
CONFIG_MAIN_STACK_SIZE=8192
CONFIG_HEAP_MEM_POOL_SIZE=0
CONFIG_LOG=y
CONFIG_SERIAL=y
CONFIG_UART_ASYNC_API=y
CONFIG_NOCACHE_MEMORY=y
CONFIG_CAN=y
CONFIG_SKYWALKER_DRIVER_MOTOR=y
CONFIG_SKYWALKER_MOTOR_DJI=y
CONFIG_SKYWALKER_MOTOR_DM=y
CONFIG_SKYWALKER_LIB_MOTOR_CONTROL=y
CONFIG_SKYWALKER_LIB_COMMUNICATION=y
CONFIG_SKYWALKER_UART_TRANSPORT=y
CONFIG_SKYWALKER_REMOTE_DR16=y
CONFIG_SKYWALKER_REMOTE_RECEIVER=y
CONFIG_SKYWALKER_REFEREE=n
CONFIG_SKYWALKER_INTERBOARD=n
CONFIG_SKYWALKER_LIB_ROBOTICS=y
CONFIG_SKYWALKER_COMMAND_SERVICE=y
CONFIG_SKYWALKER_ROBOTICS_GIMBAL=y
CONFIG_SKYWALKER_ROBOTICS_SHOOTER=y
CONFIG_SKYWALKER_ROBOTICS_SWERVE=n
```

## loaded.conf
```kconfig
CONFIG_SHOOTER_UNLOADED_FEED=n
```

## app.overlay
```dts
/ {};
```

## src/main.cpp
```c
#include "../../common/shooter_bench.hpp"
int main() { return skywalker::samples::shooter::run(false, IS_ENABLED(CONFIG_SHOOTER_UNLOADED_FEED)); }
```
