## CMakeLists.txt
```
cmake_minimum_required(VERSION 3.20.0)
find_package(Zephyr REQUIRED HINTS $ENV{ZEPHYR_BASE})
project(four_swerve_bench)
target_sources(app PRIVATE src/main.cpp)
```

## sample.yaml
```
sample:
  name: SkyWalker four swerve suspended bench
  description: Eight real motors on two physical CAN buses with independent chassis recovery
common:
  tags: [skywalker, hardware, chassis]
  platform_allow: [dm_mc02/stm32h723xx]
  build_only: true
tests:
  sample.skywalker.robotics.four_swerve: {}
```

## prj.conf
```kconfig
CONFIG_CPP=y
CONFIG_STD_CPP20=y
CONFIG_REQUIRES_FULL_LIBCPP=y
CONFIG_MAIN_STACK_SIZE=8192
CONFIG_LOG=y
CONFIG_LOG_MODE_DEFERRED=y
CONFIG_CAN=y
CONFIG_SERIAL=y
CONFIG_SKYWALKER_DRIVER_MOTOR=y
CONFIG_SKYWALKER_MOTOR_DJI=y
CONFIG_SKYWALKER_LIB_ROBOTICS=y
CONFIG_SKYWALKER_ROBOTICS_SWERVE=y

CONFIG_SKYWALKER_LIB_COMMUNICATION=y
CONFIG_SKYWALKER_UART_TRANSPORT=y
CONFIG_SKYWALKER_REMOTE_DR16=y
CONFIG_SKYWALKER_REMOTE_RECEIVER=y
CONFIG_UART_ASYNC_API=y
CONFIG_NOCACHE_MEMORY=y
CONFIG_SKYWALKER_INTERBOARD=n
CONFIG_SKYWALKER_REFEREE=n
```

## app.overlay
```dts
/* MC02 CAN1 steer GM6020 ID1..4, CAN3 wheel M3508 ID1..4. */
/ {};
```

## src/main.cpp
```c
#include "board_config.hpp"
#include "../../common/chassis_bench.hpp"

int main() {
    return skywalker::samples::chassis::run(bench::steer_can, bench::drive_can, false);
}
```

## src/board_config.hpp
```c
#pragma once
#include <zephyr/device.h>
#include <zephyr/devicetree.h>
#include "../../common/chassis_can.hpp"
namespace bench {
// TODO(wiring): confirm MC02 CAN connector numbering and both terminations.
inline const device *steer_can = skywalker::samples::chassis::steer_can;
inline const device *drive_can = skywalker::samples::chassis::drive_can;
}
```
