## CMakeLists.txt
```
cmake_minimum_required(VERSION 3.20.0)
find_package(Zephyr REQUIRED HINTS $ENV{ZEPHYR_BASE})
project(yaw_gimbal_bench)
target_sources(app PRIVATE src/main.cpp)
```

## Kconfig
```
mainmenu "SkyWalker RC bench"

source "Kconfig.zephyr"
rsource "../common/sample_control.Kconfig"
```

## sample.yaml
```
sample:
  name: SkyWalker yaw_gimbal physical bench
  description: Standalone MC02 motor exercise with DR16 controls
common:
  tags: [skywalker, hardware, motor]
  platform_allow: [dm_mc02/stm32h723xx]
  build_only: true
tests:
  sample.skywalker.robotics.yaw_gimbal: {}
  sample.skywalker.robotics.yaw_gimbal.diagnostic:
    extra_args: EXTRA_CONF_FILE=diagnostic.conf
```

## prj.conf
```kconfig
CONFIG_CPP=y
CONFIG_STD_CPP20=y
CONFIG_REQUIRES_FULL_LIBCPP=y
CONFIG_MAIN_STACK_SIZE=8192
CONFIG_LOG=y
CONFIG_CBPRINTF_FP_SUPPORT=y
CONFIG_SERIAL=y
CONFIG_CAN=y
CONFIG_SKYWALKER_DRIVER_MOTOR=y
CONFIG_SKYWALKER_MOTOR_DJI=y
CONFIG_SKYWALKER_LIB_MOTOR_CONTROL=y
CONFIG_SKYWALKER_LIB_ROBOTICS=y
CONFIG_SKYWALKER_ROBOTICS_GIMBAL=y

CONFIG_SKYWALKER_LIB_COMMUNICATION=y
CONFIG_SKYWALKER_UART_TRANSPORT=y
CONFIG_SKYWALKER_REMOTE_DR16=y
CONFIG_SKYWALKER_REMOTE_RECEIVER=y
CONFIG_UART_ASYNC_API=y
CONFIG_NOCACHE_MEMORY=y
CONFIG_SKYWALKER_INTERBOARD=n
CONFIG_SKYWALKER_REFEREE=n
```

## app.overlay
```dts
/* CAN1 is provided by the MC02 board DTS. Motor model, ID and limits are
 * configured in src/board_config.hpp.
 */
/ {
};
```

## src/main.cpp
```c
#include <cstdint>
#include <drivers/motor/can_bus.hpp>
#include <robotics/gimbal/gimbal_axis.hpp>
#include <zephyr/kernel.h>
#include <zephyr/logging/log.h>
#include "board_config.hpp"
#include "../../common/rc_controls.hpp"
#include "../../common/sample_diagnostics.hpp"

LOG_MODULE_REGISTER(yaw_bench, LOG_LEVEL_INF);

int main() {
    using namespace skywalker;
    using namespace skywalker::robotics;
    namespace input = skywalker::samples::control;
    static_assert(input::diagnostic_scenario == input::DiagnosticScenario::None ||
                  input::diagnostic_scenario == input::DiagnosticScenario::InputPause ||
                  input::diagnostic_scenario == input::DiagnosticScenario::ExecutionPause);
    static communication::AsyncUart::DmaBuffers remote_dma __nocache;
    static communication::RemoteReceiver remote(DEVICE_DT_GET(DT_ALIAS(remote_uart)), remote_dma,
                                                input::receiverConfig());
    static motor::Motor drive(bench::motorHardware());
    static motor::CanBus bus(bench::can);
    static GimbalAxis yaw(drive, bench::motorConfig(), bench::yaw);
    int ret = remote.start();
    if (ret == 0)
        ret = bus.attach(drive);
    if (ret == 0)
        ret = bus.start();
    if (ret == 0)
        ret = yaw.begin();
    if (ret < 0) {
        LOG_ERR("configuration blocked: %d", ret);
        return ret;
    }
    LOG_INF("RC safe+center 0.5s then left Middle; right X yaw, right switch Middle/Up absolute 0/0.5 rad");
    communication::RemoteReceiver::Snapshot snapshot{};
    input::RcControlAdapter adapter;
    input::SampleDiagnostics diagnostics;
    AxisCommand command{};
    command.mode = GimbalMode::Hold;
    MessageStamp source{};
    std::uint64_t next_log = 0;
    int control_error = 0, commit_error = 0;
    auto previous = k_uptime_get();
    for (;;) {
        const auto now = static_cast<std::uint64_t>(k_uptime_get());
        const float dt = (now - previous) / 1000.0f;
        previous = now;
        (void)remote.snapshot(snapshot);
        const auto &rc = adapter.update(snapshot.remote, now);
        const auto diagnostic = diagnostics.update(now, rc.run_allowed,
                                                   !rc.fresh || rc.remote.left_switch == RcSwitch::Down);
        if (!diagnostic.input_paused && rc.fresh &&
            (!source.valid || sequenceAfter(rc.remote.stamp.sequence, source.sequence))) {
            source = rc.remote.stamp;
            command.rate_rad_s = -.3f * input::RcControlAdapter::normalize(rc.remote.analog.right_x);
            command.mode = command.rate_rad_s == 0 ? GimbalMode::Hold : GimbalMode::Rate;
            if (rc.remote.right_switch != RcSwitch::Down) {
                command.mode = GimbalMode::AbsoluteAngle;
                command.target_rad = rc.remote.right_switch == RcSwitch::Middle ? 0 : .5f;
            }
        }
        const bool requested = rc.run_allowed && isFresh(source, now, 100);
        if (!diagnostic.execution_paused || !requested || rc.clear_estop) {
            if (requested) {
                const int enabled = drive.enable();
                const int updated = yaw.update(command, SafetyAction::Active, dt);
                control_error = enabled < 0 ? enabled : updated;
            }
            else {
                control_error = drive.disable();
            }
            commit_error = bus.commit().error;
        }
        if (now >= next_log) {
            next_log = now + 100;
            const auto view_now = drive.snapshot();
            const auto telemetry = yaw.telemetry();
            LOG_INF(
                "requested=%d state=%u mode=%u activation=%llu target=%.3f absolute=%.3f velocity=%.3f effort=%.3f output=%d fault=%u control=%d commit=%d rc=%d source=%u",
                requested, unsigned(view_now.state), unsigned(command.mode),
                static_cast<unsigned long long>(view_now.enable_generation), double(yaw.targetAngleRad()),
                double(view_now.feedback.absolute_position_rad), double(view_now.feedback.velocity_rad_s),
                double(telemetry.effort_command), telemetry.output_valid, unsigned(view_now.last_fault.reason),
                control_error, commit_error, rc.fresh, source.sequence);
        }
        k_sleep(K_MSEC(5));
    }
}
```

## src/board_config.hpp
```c
#pragma once
#include <zephyr/device.h>
#include <zephyr/devicetree.h>
#include <drivers/motor/dji_motor.hpp>
#include <robotics/gimbal/gimbal_axis.hpp>
namespace bench {
inline const device *can = DEVICE_DT_GET(DT_NODELABEL(can1));
inline skywalker::motor::dji::Config motorHardware() {
    return skywalker::motor::dji::gm6020({.id = 7,
                                          .current_limit_a = 1.0f,
                                          .encoder_zero_ticks = 0,
                                          .current_mode_confirmed = true,
                                          .timing = {.feedback_timeout_ms = 20,
                                                     .command_timeout_ms = 20,
                                                     .enable_timeout_ms = 100,
                                                     .retry_interval_ms = 100}});
}
// Limited topology requires calibrated DriverContinuous coordinates instead.
inline constexpr skywalker::robotics::GimbalAxisConfig yaw{skywalker::robotics::AxisTopology::Continuous, -3.14159265f,
                                                           3.14159265f, 0.5f, true};
inline skywalker::control::PositionMotor::Config motorConfig() {
    skywalker::control::PositionMotor::Config c{};
    c.effort_unit = skywalker::control::EffortUnit::Ampere;
    c.reference = yaw.topology == skywalker::robotics::AxisTopology::Continuous
                      ? skywalker::control::PositionReference::AbsoluteNearest
                      : skywalker::control::PositionReference::DriverContinuous;
    c.loop.position = {3, 0, 0, 0, -3, 3, -6, 6, .01f, .001f, .02f};
    c.loop.velocity.regulator.feedback = {.3f, .1f, 0, 0, -.3f, .3f, -.3f, .3f, 0, .001f, .02f};
    c.loop.velocity.reference_slew = {5, 5};
    c.loop.velocity.requested_velocity_abs_max_rad_s = 6;
    c.loop.velocity.effort_abs_max = .3f;
    return c;
}
}
```
