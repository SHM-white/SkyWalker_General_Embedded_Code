## CMakeLists.txt
```
cmake_minimum_required(VERSION 3.20.0)
find_package(Zephyr REQUIRED HINTS $ENV{ZEPHYR_BASE})
project(vision_bench LANGUAGES C CXX)
target_sources(app PRIVATE src/main.cpp)
```

## sample.yaml
```
sample:
  name: SkyWalker vision AB receive and VOFA
  description: Independent AB command receiver with VOFA telemetry
common:
  tags: [skywalker, hardware, uart]
  platform_allow: [dm_mc02/stm32h723xx]
  build_only: true
tests:
  sample.skywalker.communication.vision: {}
```

## prj.conf
```kconfig
CONFIG_CPP=y
CONFIG_STD_CPP20=y
CONFIG_REQUIRES_FULL_LIBCPP=y
CONFIG_MAIN_STACK_SIZE=2048
CONFIG_LOG=y
CONFIG_SERIAL=y
CONFIG_UART_ASYNC_API=y
CONFIG_NOCACHE_MEMORY=y
CONFIG_SKYWALKER_LIB_COMMUNICATION=y
CONFIG_SKYWALKER_UART_TRANSPORT=y
CONFIG_SKYWALKER_LIB_VOFA=y
CONFIG_SKYWALKER_REMOTE_DR16=n
CONFIG_SKYWALKER_REFEREE=n
CONFIG_SKYWALKER_INTERBOARD=n
CONFIG_SKYWALKER_VISION=y
CONFIG_SKYWALKER_VISION_AB=y
CONFIG_SKYWALKER_VISION_RECEIVER=y
```

## app.overlay
```dts
/ {
    aliases {
        vision-uart = &uart7;
        telemetry-uart = &usart1;
    };
};
&uart7 {
    current-speed = <115200>;
};
&usart1 {
    current-speed = <115200>;
};
```

## src/main.cpp
```c
#include "board_config.hpp"
#include <lib/vofa/vofa.h>
#include <zephyr/logging/log.h>
LOG_MODULE_REGISTER(vision_bench, LOG_LEVEL_INF);
namespace vision = skywalker::communication::vision;
namespace {
static skywalker::communication::AsyncUart::DmaBuffers dma __nocache;
vision::AbProtocol protocol(bench::protocol);
vision::VisionReceiver receiver(bench::vision_uart, dma, protocol, bench::receiver);
void telemetry(void *, void *, void *) {
    static Vofa vofa{};
    const int init = vofa_init(&vofa, bench::telemetry_uart);
    LOG_INF("VOFA init=%d", init);
    if (init < 0)
        return;
    int last_error = 0, last_send = 0;
    for (;;) {
        const auto s = receiver.snapshot();
        const auto &a = s.link.aim.value;
        const float values[] = {s.link.aim_fresh ? 1.0f : 0.0f,
                                a.control_requested ? 1.0f : 0.0f,
                                a.fire_requested ? 1.0f : 0.0f,
                                a.yaw.angle_rad,
                                a.yaw.rate_rad_s,
                                a.yaw.acceleration_rad_s2,
                                a.pitch.angle_rad,
                                a.pitch.rate_rad_s,
                                a.pitch.acceleration_rad_s2,
                                float(s.link.aim.stamp.sequence),
                                float(s.rx_chunks),
                                float(s.link.protocol.crc_errors),
                                float(s.link.protocol.invalid_frames),
                                float(s.resets),
                                float(s.dropped),
                                float(static_cast<unsigned>(s.state))};
        // The protocol permits frames shorter than the transport's max capacity.
        constexpr size_t channel_count = sizeof(values) / sizeof(values[0]);
        static_assert(channel_count <= VOFA_MAX_FLOATS);
        const int r = vofa_send(&vofa, values, static_cast<uint8_t>(channel_count));
        if (r != last_send) {
            if (r < 0)
                LOG_WRN("VOFA send=%d", r);
            last_send = r;
        }
        if (s.uart_error != last_error) {
            LOG_WRN("Vision UART status=%d", s.uart_error);
            last_error = s.uart_error;
        }
        k_sleep(K_MSEC(10));
    }
}
}
K_THREAD_DEFINE(telemetry_thread, 4096, telemetry, nullptr, nullptr, nullptr, 7, 0, 0);
int main() {
    const int r = receiver.start();
    LOG_INF("Vision receiver start=%d (AB, 115200, RX only)", r);
    return r;
}
```

## src/board_config.hpp
```c
#pragma once
#include <communication/vision/ab_protocol.hpp>
#include <communication/vision/vision_receiver.hpp>
#include <zephyr/device.h>
namespace bench {
inline const device *vision_uart = DEVICE_DT_GET(DT_ALIAS(vision_uart));
inline const device *telemetry_uart = DEVICE_DT_GET(DT_ALIAS(telemetry_uart));
inline constexpr skywalker::communication::vision::AbProtocol::Config protocol{.command_reference = {1, 1},
                                                                               .assembly_timeout_us = 20000};
inline constexpr skywalker::communication::vision::VisionReceiver::Config receiver{};
}
```
