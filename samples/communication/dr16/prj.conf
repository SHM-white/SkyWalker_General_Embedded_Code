## CMakeLists.txt
```
cmake_minimum_required(VERSION 3.20.0)
# This USB telemetry sample requires its alias override even when an IDE build
# has cached a different (or empty) DTC_OVERLAY_FILE selection.
list(APPEND EXTRA_DTC_OVERLAY_FILE "${CMAKE_CURRENT_SOURCE_DIR}/app.overlay")
find_package(Zephyr REQUIRED HINTS $ENV{ZEPHYR_BASE})
project(dr16_bench)
target_sources(app PRIVATE src/main.cpp)
```

## sample.yaml
```
sample:
  name: SkyWalker dr16 on-board bench
  description: DR16 hardware exercise using the board remote-uart; requires the documented wiring
common:
  tags: [skywalker, hardware]
  platform_allow: [dm_mc02/stm32h723xx, rm_typec/stm32f407xx]
  build_only: true
tests:
  sample.skywalker.communication.dr16: {}
```

## prj.conf
```kconfig
CONFIG_CPP=y
CONFIG_STD_CPP20=y
CONFIG_REQUIRES_FULL_LIBCPP=y
CONFIG_MAIN_STACK_SIZE=2048
CONFIG_LOG=y
CONFIG_SERIAL=y
CONFIG_UART_ASYNC_API=y
CONFIG_UART_LINE_CTRL=y
CONFIG_SKYWALKER_LIB_COMMUNICATION=y
CONFIG_SKYWALKER_UART_TRANSPORT=y
CONFIG_SKYWALKER_LIB_VOFA=y
CONFIG_SKYWALKER_REMOTE_DR16=y
CONFIG_SKYWALKER_REFEREE=n
CONFIG_SKYWALKER_INTERBOARD=n
CONFIG_SKYWALKER_REMOTE_RECEIVER=y

# Default telemetry transport: USB CDC ACM (selected in app.overlay).
CONFIG_USB_DEVICE_STACK_NEXT=y
CONFIG_CDC_ACM_SERIAL_INITIALIZE_AT_BOOT=y
CONFIG_CDC_ACM_SERIAL_PRODUCT_STRING="SkyWalker Telemetry"

# CDC ACM logs every FIFO operation at INFO; retain warnings and errors.
CONFIG_USBD_CDC_ACM_LOG_LEVEL_WRN=y
```

## app.overlay
```dts
/* Default VOFA transport: USB. Keep the board's hardware UART console. */
/ {
    aliases {
        telemetry-uart = &uart7;
    };
};

&zephyr_udc0 {
    cdc_acm_uart0: cdc_acm_uart0 {
        compatible = "zephyr,cdc-acm-uart";
        label = "VOFA";
    };
};
```

## src/main.cpp
```c
#include <cerrno>
#include <cstdint>
#include <communication/remote/remote_receiver.hpp>
#include <lib/vofa/vofa.h>
#include <zephyr/drivers/uart.h>
#include <zephyr/kernel.h>
#include <zephyr/logging/log.h>

#include "board_config.hpp"

LOG_MODULE_REGISTER(dr16_bench, LOG_LEVEL_INF);
using namespace skywalker;

namespace {
static communication::AsyncUart::DmaBuffers dma_buffers __nocache;
communication::RemoteReceiver receiver(bench::remote_uart, dma_buffers, {bench::decoder, bench::remote});

void vofaTask(void *, void *, void *) {
    static Vofa vofa{};
    const int init_ret = vofa_init(&vofa, bench::telemetry_uart);
    LOG_INF("VOFA init=%d", init_ret);
    if (init_ret < 0) {
        LOG_ERR("VOFA telemetry UART initialization failed");
        return;
    }

    communication::RemoteReceiver::Snapshot snapshot{};
    std::uint32_t last_resets = 0;
    unsigned last_dropped = 0;
    int last_uart_error = 0, last_send_error = 0;
    std::uint32_t queued_frames = 0;
    std::uint64_t next_status_ms = 0;
    LOG_INF("Telemetry device=%s, JustFloat: 16 channels, 68 bytes/frame", bench::telemetry_uart->name);
    for (;;) {
        // Keep the previous snapshot on contention, then check its original age.
        receiver.snapshot(snapshot);
        const auto &state = snapshot.remote;
        const auto &a = state.analog;
        const auto now = static_cast<std::uint64_t>(k_uptime_get());
        const bool fresh = state.online && robotics::isFresh(state.stamp, now, bench::remote.offline_timeout_ms);
        const float channels[] = {
            fresh ? 1.0f : 0.0f,
            float(a.right_x),
            float(a.right_y),
            float(a.left_x),
            float(a.left_y),
            float(unsigned(state.left_switch)),
            float(unsigned(state.right_switch)),
            float(a.wheel),
            float(state.mouse.x),
            float(state.mouse.y),
            float(state.mouse.z),
            state.mouse.left ? 1.0f : 0.0f,
            state.mouse.right ? 1.0f : 0.0f,
            float(state.keyboard.bits),
            float(state.stamp.sequence),
            float(snapshot.rx_chunks),
        };
        constexpr auto channel_count = sizeof(channels) / sizeof(channels[0]);
        static_assert(channel_count <= VOFA_MAX_FLOATS);
        // Match hello: DTR is diagnostic only, never a condition for sending.
        const int send_ret = vofa_send(&vofa, channels, static_cast<std::uint8_t>(channel_count));
        if (send_ret == 0)
            ++queued_frames;
        if (send_ret != last_send_error) {
            if (send_ret < 0)
                LOG_WRN("VOFA send failed: %d", send_ret);
            last_send_error = send_ret;
        }
        if (snapshot.uart_error != last_uart_error) {
            if (snapshot.uart_error < 0)
                LOG_ERR("DR16 UART service failed: %d", snapshot.uart_error);
            last_uart_error = snapshot.uart_error;
        }
        if (snapshot.resets != last_resets || snapshot.dropped != last_dropped) {
            LOG_WRN("DR16 RX continuity: resets=%u dropped=%u", snapshot.resets, snapshot.dropped);
            last_resets = snapshot.resets;
            last_dropped = snapshot.dropped;
        }
        if (now >= next_status_ms) {
            next_status_ms = now + 1000;
            LOG_INF("Telemetry queued=%u send=%d; DR16 state=%u online=%u seq=%u rx_chunks=%u", queued_frames, send_ret,
                    static_cast<unsigned>(snapshot.state), static_cast<unsigned>(fresh), snapshot.remote.stamp.sequence,
                    snapshot.rx_chunks);
            if constexpr (DT_NODE_HAS_COMPAT(DT_ALIAS(telemetry_uart), zephyr_cdc_acm_uart)) {
                std::uint32_t dtr = 0;
                const int ret = uart_line_ctrl_get(bench::telemetry_uart, UART_LINE_CTRL_DTR, &dtr);
                LOG_INF("USB DTR=%u query=%d (diagnostic only)", dtr, ret);
            }
        }
        k_sleep(K_MSEC(100));
    }
}
} // namespace

K_THREAD_DEFINE(vofa_thread, 4096, vofaTask, nullptr, nullptr, nullptr, 7, 0, 0);

int main() {
    const int ret = receiver.start();
    if (ret < 0) {
        LOG_ERR("Remote receiver start failed: %d", ret);
        return ret;
    }
    LOG_INF("DR16 receive and VOFA telemetry threads started");
    return 0;
}
```

## src/board_config.hpp
```c
#pragma once
#include <zephyr/device.h>
#include <communication/remote/remote_service.hpp>
namespace bench {
// static_assert(DT_NODE_HAS_COMPAT(DT_ALIAS(telemetry_uart), zephyr_cdc_acm_uart),
//               "DR16 USB telemetry requires telemetry-uart = &cdc_acm_uart0; check overlays and rebuild pristine");
inline const device *remote_uart = DEVICE_DT_GET(DT_ALIAS(remote_uart));
inline const device *telemetry_uart = DEVICE_DT_GET(DT_ALIAS(telemetry_uart));
inline constexpr skywalker::communication::Dr16Decoder::Config decoder{
    .channel_center = 1024,
    .channel_min = 364,
    .channel_max = 1684,
    .center_deadband = 0,
    .decode_wheel = true,
};
inline constexpr skywalker::communication::RemoteService::Config remote{100, 10};
}
```
