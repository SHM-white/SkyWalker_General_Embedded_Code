## CMakeLists.txt
```
cmake_minimum_required(VERSION 3.20.0)
find_package(Zephyr REQUIRED HINTS $ENV{ZEPHYR_BASE})
project(referee_bench)
target_sources(app PRIVATE src/main.cpp)
```

## sample.yaml
```
sample:
  name: SkyWalker referee on-board bench
  description: Standalone DM MC02 hardware exercise; requires the documented wiring
common:
  tags: [skywalker, hardware]
  platform_allow: [dm_mc02/stm32h723xx]
  build_only: true
tests:
  sample.skywalker.communication.referee: {}
```

## prj.conf
```kconfig
CONFIG_CPP=y
CONFIG_STD_CPP20=y
CONFIG_REQUIRES_FULL_LIBCPP=y
CONFIG_MAIN_STACK_SIZE=8192
CONFIG_LOG=y
CONFIG_CBPRINTF_FP_SUPPORT=y
CONFIG_SERIAL=y
CONFIG_UART_ASYNC_API=y
CONFIG_SKYWALKER_LIB_COMMUNICATION=y
CONFIG_SKYWALKER_UART_TRANSPORT=y
```

## rm2026.conf
```kconfig
CONFIG_SKYWALKER_REFEREE_RM2026=y
```

## app.overlay
```dts
/* MC02 USART1 PA10 RX / PA9 TX. Connect referee User TX to PA10 and common GND. */
/ { aliases { referee-uart = &usart1; }; };
&usart1 { current-speed = <115200>; };
```

## src/main.cpp
```c
#include <zephyr/kernel.h>
#include <zephyr/logging/log.h>
#include <communication/async_uart.hpp>
#include <communication/referee/referee_parser.hpp>
#include "board_config.hpp"
LOG_MODULE_REGISTER(referee_bench, LOG_LEVEL_INF);
int main() {
    using namespace skywalker;
    static communication::AsyncUart::DmaBuffers dma_buffers __nocache;
    static communication::AsyncUart uart(bench::referee_uart, dma_buffers);
    communication::RefereeParser parser;
    int ret = uart.init();
    LOG_INF("Referee physical UART init=%d protocol=%s", ret, bench::protocol_name);
    std::uint64_t next_log = 0;
    for (;;) {
        const auto now = static_cast<std::uint64_t>(k_uptime_get());
        uart.service(now);
        communication::AsyncUart::RxChunk chunk{};
        for (unsigned budget = 0; budget < 8; ++budget) {
            ret = uart.read(chunk);
            if (ret == -EOVERFLOW) {
                parser.discardPartial();
                continue;
            }
            if (ret < 0)
                break;
            parser.consume(chunk.bytes, chunk.size, chunk.timestamp_ms);
        }
        parser.consume(nullptr, 0, now);
        if (now >= next_log) {
            next_log = now + 200;
            const auto &r = parser.state();
            const auto &stats = parser.stats();
            LOG_INF(
                "online=%d frames=%u crc=%u/%u unknown=%u robot=%u outputs(g/c/s)=%d/%d/%d permission_fresh=%d limit_W=%.1f buffer_J=%.1f",
                robotics::isFresh(r.stamp, now, bench::offline_timeout_ms), stats.valid_frames, stats.crc8_errors,
                stats.crc16_errors, stats.unknown_commands, r.robot.robot_id, r.robot.gimbal_output.enabled,
                r.robot.chassis_output.enabled, r.robot.shooter_output.enabled,
                robotics::isFresh(r.robot.chassis_output.stamp, now, bench::permission_timeout_ms),
                double(r.power.chassis_power_limit_w), double(r.power.buffer_energy_j));
        }
        k_sleep(K_MSEC(1));
    }
}
```

## src/board_config.hpp
```c
#pragma once
#include <zephyr/device.h>
#include <cstdint>
namespace bench {
inline const device *referee_uart = DEVICE_DT_GET(DT_ALIAS(referee_uart));
// Kconfig fixes the protocol at build time.
#if defined(CONFIG_SKYWALKER_REFEREE_RM2027)
inline constexpr const char *protocol_name = "RM2027 V1.0.0";
#elif defined(CONFIG_SKYWALKER_REFEREE_RM2026)
inline constexpr const char *protocol_name = "RM2026 V1.3.0";
#else
#error "Select a referee protocol in Kconfig"
#endif
inline constexpr std::uint32_t offline_timeout_ms = 500, permission_timeout_ms = 300;
}
```
