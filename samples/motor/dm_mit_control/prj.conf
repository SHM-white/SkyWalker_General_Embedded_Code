## CMakeLists.txt
```
cmake_minimum_required(VERSION 3.20.0)

find_package(Zephyr REQUIRED HINTS $ENV{ZEPHYR_BASE})

project(dm_mit_control)

target_sources(app PRIVATE
    src/main.cpp
    src/dm_sample_support.cpp
)
target_include_directories(app PRIVATE include)
```

## prj.conf
```kconfig
CONFIG_CPP=y
CONFIG_STD_CPP20=y
CONFIG_REQUIRES_FULL_LIBCPP=y
CONFIG_CAN=y

CONFIG_LOG=y
CONFIG_LOG_DEFAULT_LEVEL=3

CONFIG_SERIAL=y
CONFIG_CONSOLE=y
CONFIG_UART_CONSOLE=y

CONFIG_MAIN_STACK_SIZE=8192

# Keep the debug connection alive when k_sleep() lets the CPU idle.
CONFIG_STM32_ENABLE_DEBUG_SLEEP_STOP=y

CONFIG_SKYWALKER_LIB_VOFA=y
CONFIG_UART_ASYNC_API=y
CONFIG_SKYWALKER_DRIVER_MOTOR=y
CONFIG_SKYWALKER_MOTOR_DM=y
```

## app.overlay
```dts
/* CAN1, telemetry UART, and XT30_1 power are provided by the board devicetree.
 * DM-J4310 mode, IDs, and protocol ranges are configured in src/main.cpp.
 */
/ { };
```

## src/main.cpp
```c
#include <cmath>
#include <cstdint>
#include <errno.h>

#include <zephyr/device.h>
#include <zephyr/kernel.h>
#include <zephyr/logging/log.h>

#include <dm_sample_support.hpp>
#include <drivers/motor/motor.hpp>
#include <lib/vofa/vofa.h>

LOG_MODULE_REGISTER(dm_mit_control, LOG_LEVEL_INF);

#define VOFA_UART_NODE DT_ALIAS(telemetry_uart)

#if !DT_NODE_HAS_STATUS(VOFA_UART_NODE, okay)
#error "A ready telemetry-uart alias is required for VOFA"
#endif

namespace {

constexpr std::int64_t kControlPeriodMs = 5;
constexpr std::int64_t kRunDurationMs = 200000;
constexpr float kVelocityCutoffRadS = 30.0f;
constexpr float kTemperatureCutoffC = 60.0f;

float targetTorqueNm() {
    return 0.2f;
}

} // namespace

int main() {
    const device *uart = DEVICE_DT_GET(VOFA_UART_NODE);
    static skywalker::samples::dm::Session session{DEVICE_DT_GET(DT_NODELABEL(can1)),
                                                   skywalker::motor::dm::j4310Mit(
                                                       {.id = 1,
                                                        .master_id = 0x11,
                                                        .position_max_rad = 12.5f,
                                                        .velocity_max_rad_s = 30.0f,
                                                        .torque_max_nm = 10.0f,
                                                        .torque_limit_nm = 10.0f,
                                                        .timing = {.feedback_timeout_ms = 50,
                                                                   .command_timeout_ms = 20,
                                                                   .enable_timeout_ms = 3000,
                                                                   .retry_interval_ms = 100}})};
    int ret = skywalker::samples::dm::prepare(session);
    if (ret < 0)
        return ret;
    static Vofa vofa{};
    const int vofa_error = vofa_init(&vofa, uart);
    const auto started_ms = k_uptime_get();
    std::int64_t next_log_ms = 0;
    int last_call_error = 0;
    for (;;) {
        const auto now = k_uptime_get();
        const bool requested = now - started_ms < kRunDurationMs;
        const float target = targetTorqueNm();
        const int request_error = requested ? session.motor.enable() : session.motor.disable();
        if (request_error < 0)
            last_call_error = request_error;
        if (requested) {
            const int error = session.motor.setTorque(target);
            if (error < 0)
                last_call_error = error;
        }
        const int commit_error = session.bus.commit().error;
        if (commit_error < 0)
            last_call_error = commit_error;
        const auto view = session.motor.snapshot();
        if (vofa_error == 0) {
            const float channels[6] = {target,
                                       view.native_position_rad,
                                       view.feedback.velocity_rad_s,
                                       view.feedback.torque_nm,
                                       view.native_mos_temperature_c,
                                       view.native_rotor_temperature_c};
            (void)vofa_send(&vofa, channels, 6);
        }
        if (now >= next_log_ms) {
            next_log_ms = now + 1000;
            LOG_INF("run=%d requested=%d state=%u target=%.3f fresh=%d call=%d", requested, view.enabled_requested,
                    unsigned(view.state), double(target), view.feedback_fresh, last_call_error);
        }
        k_sleep(K_MSEC(kControlPeriodMs));
    }
}
```

## include/dm_sample_support.hpp
```c
#pragma once
#include <zephyr/device.h>
#include <drivers/motor/can_bus.hpp>
#include <drivers/motor/dm_motor.hpp>
namespace skywalker::samples::dm {
struct Session {
    Session(const device *dev, motor::dm::Config cfg) : can(dev), config(cfg), motor(cfg), bus(dev) {}
    const device *can;
    motor::dm::Config config;
    motor::Motor motor;
    motor::CanBus bus;
    motor::dm::Descriptor descriptor{};
};
int prepare(Session &session);
int arm(Session &session);
int flush(Session &session);
int stop(Session &session);
}
```

## src/dm_sample_support.cpp
```c
#include <cmath>
#include <cstdint>
#include <errno.h>

#include <zephyr/device.h>
#if defined(CONFIG_BOARD_DM_MC02)
#include <zephyr/drivers/regulator.h>
#endif
#include <zephyr/kernel.h>
#include <zephyr/logging/log.h>

#include <dm_sample_support.hpp>

LOG_MODULE_REGISTER(dm_sample_support, LOG_LEVEL_INF);

namespace skywalker::samples::dm {
namespace {

#if defined(CONFIG_BOARD_DM_MC02)
const device *const xt30_1 = DEVICE_DT_GET(DT_NODELABEL(power1));
constexpr std::int64_t kMotorPowerOnDelayMs = 1500;
#endif

constexpr std::int64_t kStatusHandshakeTimeoutMs = 3000;
constexpr float kPreEnableVelocityCutoffRadS = 30.0f;
constexpr float kPreEnableTemperatureCutoffC = 60.0f;

int enableMotorPower() {
#if defined(CONFIG_BOARD_DM_MC02)
    if (!device_is_ready(xt30_1))
        return -ENODEV;
    const int ret = regulator_enable(xt30_1);
    if (ret < 0)
        return ret;
    LOG_INF("XT30_1 enabled; waiting %lld ms for motor startup", kMotorPowerOnDelayMs);
    k_sleep(K_MSEC(kMotorPowerOnDelayMs));
#endif
    return 0;
}

int waitUntilReady(Session &session) {
    const std::int64_t started_ms = k_uptime_get();
    std::int64_t next_log_ms = started_ms;
    while (k_uptime_get() - started_ms < kStatusHandshakeTimeoutMs) {
        if (session.motor.ready())
            return 0;
        const auto view = session.motor.snapshot();
        if (view.state == motor::MotorState::Fault) {
            LOG_ERR("startup fault: reason=%u error=%d status=0x%x", unsigned(view.last_fault.reason),
                    view.last_fault.error, unsigned(view.native_drive_status));
            return view.last_fault.error < 0 ? view.last_fault.error : -EHOSTDOWN;
        }
        const auto now_ms = k_uptime_get();
        if (now_ms >= next_log_ms) {
            LOG_WRN("waiting for safe DM feedback: state=%u status=0x%x stop=%u", unsigned(view.state),
                    unsigned(view.native_drive_status), unsigned(view.stop.progress));
            next_log_ms = now_ms + 1000;
        }
        k_sleep(K_MSEC(5));
    }
    LOG_ERR("operational feedback timeout: check power, CAN, ID=%u and Master ID=0x%03x",
            unsigned(session.descriptor.motor_id), unsigned(session.descriptor.master_id));
    return -ETIMEDOUT;
}

int checkSafeFeedback(const Session &session, float velocity_abs_max_rad_s, float temperature_max_c, bool before_enable,
                      motor::MotorSnapshot &snapshot) {
    if (!std::isfinite(velocity_abs_max_rad_s) || velocity_abs_max_rad_s <= 0.0f || !std::isfinite(temperature_max_c) ||
        temperature_max_c <= 0.0f)
        return -EINVAL;
    const auto view = session.motor.snapshot();
    const auto expected_state = before_enable ? motor::MotorState::Disabled : motor::MotorState::Active;
    const auto expected_status = before_enable ? motor::dm::DriveStatus::Disabled : motor::dm::DriveStatus::Enabled;
    if (view.state != expected_state || !view.feedback_fresh || (!before_enable && !view.output_permitted) ||
        !view.native_drive_status_valid || view.native_drive_status != unsigned(expected_status)) {
        LOG_ERR("feedback unavailable: state=%u status=0x%x fresh=%d", unsigned(view.state),
                unsigned(view.native_drive_status), view.feedback_fresh);
        return -EHOSTDOWN;
    }
    constexpr std::uint32_t required = motor::FeedbackPosition | motor::FeedbackVelocity | motor::FeedbackTorque |
                                       motor::FeedbackTemperature;
    const auto &feedback = view.feedback;
    if ((feedback.valid & required) != required || !view.native_temperatures_valid || !view.native_position_valid)
        return -ENODATA;
    if (!std::isfinite(feedback.position_rad) || !std::isfinite(feedback.velocity_rad_s) ||
        !std::isfinite(feedback.torque_nm) || !std::isfinite(feedback.temperature_c) ||
        !std::isfinite(view.native_position_rad) || !std::isfinite(view.native_mos_temperature_c) ||
        !std::isfinite(view.native_rotor_temperature_c))
        return -EINVAL;
    if (std::fabs(feedback.velocity_rad_s) > velocity_abs_max_rad_s ||
        view.native_mos_temperature_c >= temperature_max_c || view.native_rotor_temperature_c >= temperature_max_c) {
        LOG_ERR("safety cutoff: speed=%d limit=%d mrad/s MOS=%d rotor=%d limit=%d C",
                int(feedback.velocity_rad_s * 1000.0f), int(velocity_abs_max_rad_s * 1000.0f),
                int(view.native_mos_temperature_c), int(view.native_rotor_temperature_c), int(temperature_max_c));
        return -ERANGE;
    }
    snapshot = view;
    return 0;
}

} // namespace

int prepare(Session &session) {
    if (session.can == nullptr || !device_is_ready(session.can))
        return -ENODEV;
    int ret = motor::dm::describe(session.config, session.descriptor);
    if (ret < 0)
        return ret;
    LOG_INF("DM-J4310 id=%u master=0x%03x command=0x%03x mode=%u P/V/T=%d/%d/%d torque_limit=%d mNm",
            unsigned(session.descriptor.motor_id), unsigned(session.descriptor.master_id),
            unsigned(session.descriptor.control_id), unsigned(session.descriptor.mode),
            int(session.descriptor.limits.position_max_rad * 1000.0f),
            int(session.descriptor.limits.velocity_max_rad_s * 1000.0f),
            int(session.descriptor.limits.torque_max_nm * 1000.0f), int(session.descriptor.torque_limit_nm * 1000.0f));
    ret = session.bus.attach(session.motor);
    if (ret == 0)
        ret = session.bus.start();
    if (ret < 0) {
        LOG_ERR("CAN configuration failed: %d", ret);
        return ret;
    }
    ret = enableMotorPower();
    if (ret < 0) {
        LOG_ERR("motor power enable failed: %d", ret);
        return ret;
    }
    return waitUntilReady(session);
}

int arm(Session &session) {
    motor::MotorSnapshot pre_enable{};
    int ret = checkSafeFeedback(session, kPreEnableVelocityCutoffRadS, kPreEnableTemperatureCutoffC, true, pre_enable);
    if (ret < 0) {
        LOG_ERR("pre-enable safety check failed: %d", ret);
        return ret;
    }
    ret = session.motor.enable();
    if (ret < 0) {
        LOG_ERR("enable request failed: %d", ret);
        return ret;
    }
    const std::int64_t started_ms = k_uptime_get();
    while (k_uptime_get() - started_ms < kStatusHandshakeTimeoutMs) {
        if (session.motor.active()) {
            LOG_INF("motor active: Enable acknowledged and neutral command sent");
            return 0;
        }
        const auto view = session.motor.snapshot();
        if (view.state == motor::MotorState::Fault) {
            LOG_ERR("enable fault: reason=%u error=%d", unsigned(view.last_fault.reason), view.last_fault.error);
            return view.last_fault.error < 0 ? view.last_fault.error : -EHOSTDOWN;
        }
        k_sleep(K_MSEC(5));
    }
    (void)session.motor.disable();
    LOG_ERR("enable handshake timeout");
    return -ETIMEDOUT;
}

int readSafeFeedback(const Session &session, float velocity_abs_max_rad_s, float temperature_max_c,
                     motor::MotorSnapshot &snapshot) {
    return checkSafeFeedback(session, velocity_abs_max_rad_s, temperature_max_c, false, snapshot);
}

int flush(Session &session) {
    const auto result = session.bus.commit();
    if (result.error < 0)
        LOG_ERR("commit failed: %d", result.error);
    return result.error;
}

int stop(Session &session) {
    const int ret = session.motor.disable();
    if (ret < 0)
        LOG_ERR("disable request failed: %d", ret);
    return ret;
}

int stopAfterFailure(Session &session, int original_error) {
    const int stop_ret = stop(session);
    LOG_ERR("motor disabled after failure: cause=%d stop=%d", original_error, stop_ret);
    return stop_ret < 0 ? stop_ret : original_error;
}

} // namespace skywalker::samples::dm
```
