## CMakeLists.txt
```
cmake_minimum_required(VERSION 3.20.0)

find_package(Zephyr REQUIRED HINTS $ENV{ZEPHYR_BASE})
project(dji_m3508_raw)

target_sources(app PRIVATE src/main.cpp 
    src/dji_m3508_protocol.cpp
)
```

## prj.conf
```kconfig
CONFIG_CPP=y

CONFIG_CAN=y

CONFIG_LOG=y
CONFIG_LOG_DEFAULT_LEVEL=3

CONFIG_ASSERT=y
```

## src/main.cpp
```c
#include <zephyr/kernel.h>
#include <zephyr/device.h>
#include <zephyr/drivers/can.h>
#include <zephyr/logging/log.h>
#include "dji_m3508_protocol.hpp"

LOG_MODULE_REGISTER(dji_m3508_raw, LOG_LEVEL_INF);

struct MotorRuntime {
    skywalker::motor::dji::M3508Feedback feedback{};
    std::int64_t last_rx_ms = 0;
};

static MotorRuntime motor;


static void rxCallback(const struct device* dev, struct can_frame* frame, void* user_data){
    auto *runtime = static_cast<MotorRuntime *>(user_data);
    if (runtime == nullptr || frame == nullptr) { return; }
    if (skywalker::motor::dji::decodeM3508Feedback(*frame, runtime->feedback)){
        runtime->last_rx_ms = k_uptime_get();
    }
}

int main()
{
    const struct device *can = DEVICE_DT_GET(DT_NODELABEL(can1));

    if (!device_is_ready(can)) {
        LOG_ERR("CAN device not ready");
        return -ENODEV;
    }

    int ret = can_start(can);

    if (ret < 0 && ret != -EALREADY) {
        LOG_ERR("can_start failed: %d", ret);
        return ret;
    }

    LOG_INF("CAN ready");

    struct can_filter filter = {
        .id = 0,
        .mask = 0,
        .flags = 0,
    };

    int filter_id = can_add_rx_filter(can, rxCallback, nullptr, &filter);
    if (filter_id < 0) {
        LOG_ERR("Filter register failed");
    }

    std::int16_t current[4] = {300, 0, 0, 0};
    can_frame frame;

    while (true) {
        k_sleep(K_MSEC(20));
        skywalker::motor::dji::buildGroupCurrentFrame(frame, 0x200, current);
        int ret = can_send(can, &frame, K_MSEC(1), nullptr, nullptr);
        if (ret != 0) {
            LOG_ERR("Can send failed: %d", ret);
        }
    }

    return 0;
}
```

## src/dji_m3508_protocol.cpp
```c
#include "dji_m3508_protocol.hpp"

namespace skywalker::motor::dji {

    static std::uint16_t readBe16(const std::uint8_t *p) {
        return (static_cast<std::uint16_t>(p[0]) << 8) | static_cast<std::uint16_t>(p[1]);
    }

    bool decodeM3508Feedback(const struct can_frame &frame, M3508Feedback &out) {
        if (frame.dlc != 8) {
            return false;
        }

        out.encoder = readBe16(&frame.data[0]);
        out.rpm = static_cast<std::int16_t>(readBe16(&frame.data[2]));
        out.current_raw = static_cast<std::int16_t>(readBe16(&frame.data[4]));
        out.temperature = frame.data[6];

        return true;
    }

    void buildGroupCurrentFrame(can_frame &frame, std::uint16_t command_id, const std::int16_t current[4])
    {
        frame.id = command_id;
        frame.flags = 0;
        frame.dlc = 8;
        for (int i = 0; i < 4; i++)
        {
            frame.data[i * 2] = static_cast<std::uint8_t>((current[i] >> 8) & 0xFF);
            frame.data[i * 2 + 1] = static_cast<std::uint8_t>(current[i] & 0xFF);
        }
    }
}
```

## src/dji_m3508_protocol.hpp
```c
#pragma once

#include <cstdint>
#include <zephyr/drivers/can.h>

namespace skywalker::motor::dji
{
    struct M3508Feedback
    {
        std::uint16_t encoder = 0;
        std::int16_t rpm = 0;
        std::int16_t current_raw = 0;
        std::uint8_t temperature = 0;
    };

    bool decodeM3508Feedback(const struct can_frame &frame, M3508Feedback &out);
    void buildGroupCurrentFrame(struct can_frame &frame, std::uint16_t command_id, const std::int16_t current[4]);
}
```
