## CMakeLists.txt
```
cmake_minimum_required(VERSION 3.20.0)

find_package(Zephyr REQUIRED HINTS $ENV{ZEPHYR_BASE})

project(dm_velocity_control)

target_sources(app PRIVATE
    src/main.cpp
    src/dm_sample_support.cpp
)
target_include_directories(app PRIVATE include)
```

## prj.conf
```kconfig
CONFIG_CPP=y
CONFIG_STD_CPP20=y
CONFIG_REQUIRES_FULL_LIBCPP=y
CONFIG_CAN=y

CONFIG_LOG=y
CONFIG_LOG_DEFAULT_LEVEL=3

CONFIG_SERIAL=y
CONFIG_CONSOLE=y
CONFIG_UART_CONSOLE=y

CONFIG_MAIN_STACK_SIZE=8192

CONFIG_SKYWALKER_LIB_VOFA=y
CONFIG_UART_ASYNC_API=y
CONFIG_SKYWALKER_DRIVER_MOTOR=y
CONFIG_SKYWALKER_MOTOR_DM=y
```

## app.overlay
```dts
/ {
    aliases {
        motor0 = &dm_j4310_1;
    };

    dm_j4310_1: motor-1 {
        compatible = "dm,j4310-2ec-v1-1";
        status = "okay";
        can-bus = <&can1>;
        motor-id = <1>;
        master-id = <0x11>;
        control-mode = "velocity";

        /* Must match PMAX/VMAX/TMAX read from Damiao Assistant. */
        p-max-millirad = <12500>;
        v-max-millirad-s = <45000>;
        t-max-millinewton-meter = <18000>;
        torque-limit-millinewton-meter = <50>;
    };
};
```

## src/main.cpp
```c
#include <cmath>
#include <cstdint>
#include <errno.h>

#include <zephyr/device.h>
#include <zephyr/kernel.h>
#include <zephyr/logging/log.h>

#include <dm_sample_support.hpp>
#include <lib/vofa/vofa.h>

LOG_MODULE_REGISTER(dm_velocity_control, LOG_LEVEL_INF);

#define VOFA_UART_NODE DT_ALIAS(telemetry_uart)

#if !DT_NODE_HAS_STATUS(VOFA_UART_NODE, okay)
#error "A ready telemetry-uart alias is required for VOFA"
#endif

namespace {

constexpr std::int64_t kControlPeriodMs = 5;
constexpr float kSpeedSafetyMarginRadS = 0.5f;
constexpr float kTemperatureCutoffC = 60.0f;

float targetVelocityRadS(int64_t dt) {
    return 5.0f * std::sin(float(dt) / 1000.0f);
}

} // namespace

int main() {
    const device *uart = DEVICE_DT_GET(VOFA_UART_NODE);
    static skywalker::samples::dm::Session session{DEVICE_DT_GET(DT_NODELABEL(can3)),
                                                   skywalker::motor::dm::j4310Velocity(
                                                       {.id = 6,
                                                        .master_id = 0x11,
                                                        .position_max_rad = 12.5f,
                                                        .velocity_max_rad_s = 45.0f,
                                                        .torque_max_nm = 18.0f,
                                                        .torque_limit_nm = 0.05f,
                                                        .timing = {.feedback_timeout_ms = 50,
                                                                   .command_timeout_ms = 20,
                                                                   .enable_timeout_ms = 3000,
                                                                   .retry_interval_ms = 100}})};
    int ret = skywalker::samples::dm::prepare(session);
    if (ret < 0)
        return ret;
    static Vofa vofa{};
    const int vofa_error = vofa_init(&vofa, uart);
    const auto started_ms = k_uptime_get();
    std::int64_t next_log_ms = 0;
    int last_call_error = 0;
    for (;;) {
        const auto now = k_uptime_get();
        const bool requested = true;
        const float target = targetVelocityRadS(now - started_ms);
        const int request_error = requested ? session.motor.enable() : session.motor.disable();
        if (request_error < 0)
            last_call_error = request_error;
        if (requested) {
            const int error = session.motor.setVelocity(target);
            if (error < 0)
                last_call_error = error;
        }
        const int commit_error = session.bus.commit().error;
        if (commit_error < 0)
            last_call_error = commit_error;
        const auto view = session.motor.snapshot();
        if (vofa_error == 0) {
            const float channels[6] = {target,
                                       view.native_position_rad,
                                       view.feedback.velocity_rad_s,
                                       view.feedback.torque_nm,
                                       view.native_mos_temperature_c,
                                       view.native_rotor_temperature_c};
            (void)vofa_send(&vofa, channels, 6);
        }
        if (now >= next_log_ms) {
            next_log_ms = now + 1000;
            LOG_INF("run=%d requested=%d state=%u target=%.3f fresh=%d call=%d", requested, view.enabled_requested,
                    unsigned(view.state), double(target), view.feedback_fresh, last_call_error);
        }
        k_sleep(K_MSEC(kControlPeriodMs));
    }
}
```

## include/dm_sample_support.hpp
```c
#pragma once

#include <zephyr/device.h>

#include <drivers/motor/dm_bus.hpp>
#include <drivers/motor/dm_motor.hpp>
#include <drivers/motor/motor.hpp>

namespace skywalker::samples::dm {

// Board power hook for DmMotorBackend; invoke after CAN/filter setup.
int enableMotorPower();

struct Session {
    skywalker::motor::dm::Bus bus{};
    const struct device *motor = nullptr;
    skywalker::motor::dm::Descriptor descriptor{};
};

int prepare(Session &session, const struct device *motor);

int arm(Session &session);

// Allows fresh Disabled feedback while the bus is Safe (controller startup).
// Once armed, requires Enabled feedback; freshness and limits always apply.
int readSafeFeedback(const Session &session, float velocity_abs_max_rad_s, float temperature_max_c,
                     skywalker::motor::Feedback &feedback, skywalker::motor::dm::RawFeedback &raw);

int flush(Session &session);

int stop(Session &session);

int stopAfterFailure(Session &session, int original_error);

} // namespace skywalker::samples::dm
```

## src/dm_sample_support.cpp
```c
#include <cerrno>
#include <dm_sample_support.hpp>
#if defined(CONFIG_BOARD_DM_MC02)
#include <zephyr/drivers/regulator.h>
#endif
namespace skywalker::samples::dm {
int prepare(Session &session) {
    if (session.can == nullptr || !device_is_ready(session.can))
        return -ENODEV;
    int ret = motor::dm::describe(session.config, session.descriptor);
    if (ret == 0)
        ret = session.bus.attach(session.motor);
    if (ret == 0)
        ret = session.bus.start();
#if defined(CONFIG_BOARD_DM_MC02)
    if (ret == 0) {
        const device *power = DEVICE_DT_GET(DT_NODELABEL(power1));
        ret = device_is_ready(power) ? regulator_enable(power) : -ENODEV;
    }
#endif
    return ret;
}
int arm(Session &session) {
    return session.motor.enable();
}
int flush(Session &session) {
    return session.bus.commit().error;
}
int stop(Session &session) {
    return session.motor.disable();
}
}
```
