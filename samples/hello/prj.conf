## CMakeLists.txt
```
# Copyright (c) 2025 RobotPilots-SZU
# SPDX-License-Identifier: Apache-2.0

cmake_minimum_required(VERSION 3.20.0)

find_package(Zephyr REQUIRED HINTS $ENV{ZEPHYR_BASE})
project(hello)

target_sources(app PRIVATE src/main.c)
```

## prj.conf
```kconfig
# Minimal config — board defconfig already enables CONSOLE, UART, SERIAL, GPIO, LOG
CONFIG_PRINTK=y
CONFIG_SKYWALKER_LIB_VOFA=y
CONFIG_NOCACHE_MEMORY=y

# Keep SWD accessible when the telemetry loop sleeps and the CPU idles.
CONFIG_STM32_ENABLE_DEBUG_SLEEP_STOP=y

# Default telemetry transport: USB CDC ACM (selected in app.overlay).
CONFIG_USB_DEVICE_STACK_NEXT=y
CONFIG_CDC_ACM_SERIAL_INITIALIZE_AT_BOOT=y
CONFIG_CDC_ACM_SERIAL_PRODUCT_STRING="SkyWalker Telemetry"

# CDC ACM logs every FIFO operation at INFO; retain warnings and errors.
CONFIG_USBD_CDC_ACM_LOG_LEVEL_WRN=y
```

## app.overlay
```dts
/* Default VOFA transport: USB. Keep the board's hardware UART console. */
/ {
    aliases {
        telemetry-uart = &cdc_acm_uart0;
    };
};

&zephyr_udc0 {
    cdc_acm_uart0: cdc_acm_uart0 {
        compatible = "zephyr,cdc-acm-uart";
        label = "VOFA";
    };
};
```

## src/main.c
```c
/*
 * Copyright (c) 2025 RobotPilots-SZU
 * SPDX-License-Identifier: Apache-2.0
 */

#include <math.h>
#include <zephyr/kernel.h>
#include <zephyr/device.h>
#include <zephyr/sys/printk.h>

#include <lib/vofa/vofa.h>

#define VOFA_SEND_PERIOD_MS 10
#define SINE_PERIOD_MS 1000
#define SINE_AMPLITUDE 1.0f
#define TWO_PI 6.28318530718f

int main(void) {
    const struct device *vofa_uart = DEVICE_DT_GET(DT_ALIAS(telemetry_uart));
    if (!device_is_ready(vofa_uart)) {
        printk("VOFA UART device not ready\n");
        return -ENODEV;
    }

    Vofa vofa = {0};
    int err = vofa_init(&vofa, vofa_uart);
    if (err != 0) {
        printk("VOFA initialization failed: %d\n", err);
        return err;
    }

    printk("Hello, Skywalker!\n");
    printk("Board: %s\n", CONFIG_BOARD);

    const int64_t start_ms = k_uptime_get();
    while (1) {
        /* Keep the phase bounded to avoid float precision loss over time. */
        const int64_t phase_ms = (k_uptime_get() - start_ms) % SINE_PERIOD_MS;
        const float phase = TWO_PI * (float)phase_ms / (float)SINE_PERIOD_MS;
        const float channels[1] = {SINE_AMPLITUDE * sinf(phase)};
        vofa_send(&vofa, channels, 1);
        k_msleep(VOFA_SEND_PERIOD_MS);
    }

    return 0;
}
```
