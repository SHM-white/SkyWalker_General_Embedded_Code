## tests/execution/testcase.yaml
```yaml
tests:
  skywalker.execution.contracts:
    platform_allow: [native_sim/native/64]
    tags: [robotics, execution, recovery, interboard]
    harness: ztest
```

## tests/heading/testcase.yaml
```yaml
tests:
  skywalker.heading_control:
    platform_allow: [native_sim/native/64]
    tags: [robotics, imu, interboard]
    harness: ztest
```

## tests/motor/regression/testcase.yaml
```yaml
tests:
  skywalker.motor.regression:
    platform_allow:
      - native_sim/native/64
    tags:
      - motor
      - can
```

## tests/motor_protocols/testcase.yaml
```yaml
tests:
  skywalker.motor_protocols.contracts:
    platform_allow: [native_sim/native/64]
    tags: [motor, can, dji, dm, protocol]
    harness: ztest
```
