## boards/damiao/dm_mc02/board.yml
```yaml
board:
  name: dm_mc02
  full_name: Damiao MC02
  vendor: damiao
  socs:
    - name: stm32h723xx
```

## drivers/Kconfig
```kconfig
menu "Skywalker Device Drivers"

rsource "imu/Kconfig"

config SKYWALKER_DRIVER_MOTOR
    bool "Skywalker Motor Subsystem"
    depends on CAN
    help
        Enable Skywalker motor drivers.
        
if SKYWALKER_DRIVER_MOTOR

rsource "motor/Kconfig"

endif

endmenu
```

## drivers/imu/Kconfig
```kconfig
config SKYWALKER_IMU
    bool "Independent IMU sources and snapshots"
    depends on CPP

config SKYWALKER_IMU_BMI088
    bool "BMI088 sensor source"
    depends on SKYWALKER_IMU && SENSOR && BMI08X

config SKYWALKER_IMU_HEATER
    bool "Independent IMU PWM heater"
    depends on SKYWALKER_IMU && PWM
    select SKYWALKER_LIB_CONTROL

config SKYWALKER_IMU_DM_PROTOCOL
    bool "DM-IMU-L1 USB and RS485 protocols"
    depends on SKYWALKER_IMU

config SKYWALKER_IMU_DM_RS485
    bool "DM-IMU-L1 firmware 2.x request/reply RS485 source"
    depends on SKYWALKER_IMU && SKYWALKER_UART_TRANSPORT
    select SKYWALKER_IMU_DM_PROTOCOL

config SKYWALKER_IMU_DM_CAN
    bool "DM-IMU-L1 classic CAN active/report and request/reply source"
    depends on SKYWALKER_IMU && CAN
    help
        Uses a dedicated CAN controller with a bounded receive queue.
        Configure the IMU's interface, mode, IDs and output bitmap using the
        vendor tool. The driver does not write module configuration.

config SKYWALKER_IMU_DM_CAN_PASSIVE
    bool "Use request/reply mode in the CAN IMU application profiles"
    depends on SKYWALKER_IMU_DM_CAN
    default n
    help
        The sentry vehicle and dual_imu profiles use this to choose the
        source mode. Disabled means the module actively reports data.
        Explicit C++ Config::mode remains per instance.

config SKYWALKER_IMU_DM_CAN_SLAVE_ID
    hex "CAN IMU slave ID (module receives requests)"
    depends on SKYWALKER_IMU_DM_CAN
    range 0x0 0x7ff
    default 0x1

config SKYWALKER_IMU_DM_CAN_FEEDBACK_ID
    hex "CAN IMU master ID (module sends measurements)"
    depends on SKYWALKER_IMU_DM_CAN
    range 0x0 0x7ff
    default 0x11

config SKYWALKER_IMU_RECEIVER
    bool "Threaded IMU acquisition and optional heater"
    depends on SKYWALKER_IMU
    depends on MULTITHREADING

config SKYWALKER_IMU_RX_STACK_SIZE
    int "IMU acquisition thread stack size"
    depends on SKYWALKER_IMU_RECEIVER
    default 8192
    range 2048 16384

config SKYWALKER_IMU_RX_PRIORITY
    int "Default IMU acquisition thread priority"
    depends on SKYWALKER_IMU_RECEIVER
    default 6
    range 0 15
```

## drivers/led/Kconfig
```kconfig
config SKYWALKER_STATUS_LED
    bool "Non-blocking status LED pattern player"
    depends on CPP && LED_STRIP && MULTITHREADING
    help
        Play static WS2812 color/time patterns from a low-priority worker.
        Boards without an enabled led-strip alias use a no-op C++ facade.

config SKYWALKER_STATUS_LED_STACK_SIZE
    int "Status LED worker stack size"
    depends on SKYWALKER_STATUS_LED
    default 2048
    range 1024 8192

config SKYWALKER_STATUS_LED_PRIORITY
    int "Status LED preemptible thread priority (larger means lower priority)"
    depends on SKYWALKER_STATUS_LED
    default 12
    range 0 15
```

## drivers/motor/Kconfig
```kconfig
config SKYWALKER_MOTOR_DJI
    bool "Unified DJI CAN motor family"
    default y
    depends on CAN

config SKYWALKER_MOTOR_DM
    bool "Damiao CAN motor family"
    depends on CAN

config SKYWALKER_MOTOR_MAX_MOTORS_PER_BUS
    int "Maximum motors on one shared CAN bus"
    default 16
    range 1 32

config SKYWALKER_MOTOR_MAX_BUSES
    int "Maximum shared motor CAN buses"
    default 3
    range 1 8

config SKYWALKER_MOTOR_MAX_GROUP_MEMBERS
    int "Maximum linked motors in one group"
    default 16
    range 2 32

config SKYWALKER_MOTOR_RX_QUEUE_DEPTH
    int "Receive event queue depth per motor CAN bus"
    default 32
    range 4 128

config SKYWALKER_MOTOR_IO_STACK_SIZE
    int "I/O thread stack per motor CAN bus"
    default 3072
    range 1024 16384

config SKYWALKER_MOTOR_IO_PRIORITY
    int "I/O thread priority per motor CAN bus"
    default 5
    range 0 15
```

## dts/bindings/imu/skywalker,imu.yaml
```yaml
# SPDX-License-Identifier: Apache-2.0

description: Skywalker IMU

compatible: "skywalker,imu"

include: [base.yaml]

properties:
  accel-dev:
    type: phandle
    required: true
    description: 加速度计设备节点
  gyro-dev:
    type: phandle
    required: true
    description: 陀螺仪设备节点
  heat-dev:
    type: phandle
    required: true
    description: PWM 加热设备节点
  filter-dev:
    type: phandle
    required: true
    description: 解算滤波器设备节点（kalman_filter 等）
  heat-kp:
    type: string
    required: true
  heat-ki:
    type: string
    required: true
  heat-kd:
    type: string
    required: true
  heat-integral-max:
    type: string
    required: true
  heat-output-max:
    type: string
    required: true
  heat-deadband:
    type: string
    required: true
  heat-derivative-tau-s:
    type: string
    required: true
  heat-dt-min-s:
    type: string
    required: true
  heat-dt-max-s:
    type: string
    required: true
  heat-feedforward-ns:
    type: string
    required: true
  estimator:
    type: string
    required: true
    enum:
      - "ekf"
    description: 解算方法选择
```

## dts/bindings/kalman_filter/skywalker,kalman_filter.yaml
```yaml
# SPDX-License-Identifier: Apache-2.0

description: Skywalker Kalman Filter

compatible: "skywalker,kalman_filter"

include: [base.yaml]

properties:
  state-dim:
    type: int
    required: true
    description: 状态维度
  measure-dim:
    type: int
    required: true
    description: 测量维度
```

## dts/bindings/motor/dji,gm6020-current.yaml
```yaml
description: DJI GM6020 with current loop explicitly enabled

compatible: "dji,gm6020-current"

include: dji-motor-base.yaml

properties:
  motor-id:
    type: int
    required: true
    min: 1
    max: 7

  current-limit-ma:
    type: int
    required: true
    min: 0
    max: 3000

  current-loop-confirmed:
    type: boolean
    required: true
```

## dts/bindings/motor/dji,m2006-c610.yaml
```yaml
description: DJI M2006 motor driven by a C610 in CAN current mode

compatible: "dji,m2006-c610"

include: dji-motor-base.yaml

properties:
  motor-id:
    type: int
    required: true
    min: 1
    max: 8

  current-limit-ma:
    type: int
    required: true
    min: 0
    max: 10000
```

## dts/bindings/motor/dji,m3508-c620.yaml
```yaml
description: DJI M3508 motor driven by a C620 in CAN current mode

compatible: "dji,m3508-c620"

include: dji-motor-base.yaml

properties:
  motor-id:
    type: int
    required: true
    min: 1
    max: 8

  current-limit-ma:
    type: int
    required: true
    min: 0
    max: 20000
```

## dts/bindings/motor/dji,m3508.yaml
```yaml
description: DJI M3508 motor with CAN ESC

compatible: "dji,m3508"

include: base.yaml

properties:
  can-bus:
    type: phandle
    required: true

  feedback-id:
    type: int
    required: true

  command-id:
    type: int
    required: true

  command-slot:
    type: int
    required: true

  gear-ratio:
    type: int
    required: true
```

## dts/bindings/motor/dji-motor-base.yaml
```yaml
description: Common properties for a DJI CAN motor

include: base.yaml

properties:
  can-bus:
    type: phandle
    required: true

  motor-id:
    type: int
    required: true
    min: 1

  current-limit-ma:
    type: int
    required: true
    min: 0

  # 减速比 分子
  gear-ratio-num:
    type: int
    required: true
    min: 1

  # 减速比 分母
  gear-ratio-den:
    type: int
    required: true
    min: 1
```

## dts/bindings/motor/dm,j4310-2ec-v1-1.yaml
```yaml
description: Damiao DM-J4310-2EC V1.1 integrated CAN motor

compatible: "dm,j4310-2ec-v1-1"

include: dm-motor-base.yaml
```

## dts/bindings/motor/dm-motor-base.yaml
```yaml
description: Common properties for a Damiao CAN motor

include: base.yaml

properties:
  can-bus:
    type: phandle
    required: true

  motor-id:
    type: int
    required: true
    min: 1
    max: 15

  master-id:
    type: int
    required: true
    min: 0
    max: 2047

  control-mode:
    type: string
    required: true
    enum:
      - "mit"
      - "position-velocity"
      - "velocity"

  p-max-millirad:
    type: int
    required: true
    min: 1

  v-max-millirad-s:
    type: int
    required: true
    min: 1

  t-max-millinewton-meter:
    type: int
    required: true
    min: 1

  torque-limit-millinewton-meter:
    type: int
    required: true
    min: 1
```

## dts/bindings/pid/skywalker,pid.yaml
```yaml
# SPDX-License-Identifier: Apache-2.0

description: Skywalker PID Controller

compatible: "skywalker,pid"

include: [base.yaml]

properties:
  k-p:
    type: string
    required: true
    description: 比例增益 Kp
  k-i:
    type: string
    required: true
    description: 积分增益 Ki
  k-d:
    type: string
    required: true
    description: 微分增益 Kd
  i-max:
    type: string
    required: true
    description: I 项输出限幅
  out-max:
    type: string
    required: true
    description: 总输出限幅
  deadband:
    type: string
    required: true
    description: 死区
```

## lib/Kconfig
```kconfig
menu "Skywalker Libraries"

config SKYWALKER_LIB_MATRIX
    bool "Matrix"
    select CMSIS_DSP
    select CMSIS_DSP_MATRIX
    help
        Enable the Matrix library for matrix operations.

config SKYWALKER_LIB_MATRIX_STORAGE
    bool "Matrix flash storage"
    depends on SKYWALKER_LIB_MATRIX
    select FILE_SYSTEM
    select ZMS
    select FLASH_PAGE_LAYOUT
    select FLASH_MAP
    help
        Enable flash storage of matrices (matrix_storage_save/read...).
        Requires a flash driver on the board.

config SKYWALKER_LIB_VOFA
    bool "vofa"
    depends on SERIAL && SERIAL_SUPPORT_INTERRUPT
    select UART_INTERRUPT_DRIVEN
    help
        VOFA JustFloat telemetry and line commands over an exclusive UART.
        Uses the interrupt-driven UART API for both hardware USART and
        USB CDC ACM, with a bounded nonblocking frame queue per instance.

config SKYWALKER_LIB_CONTROL
    bool "Pure control algorithms"
    help
        Enable allocation-free PID, feedforward and reference helpers.

config SKYWALKER_LIB_KALMAN_FILTER
    bool "Linear Kalman filter"
    select SKYWALKER_LIB_CONTROL
    select SKYWALKER_LIB_MATRIX
    help
        Enable the CMSIS-DSP linear Kalman algorithm with caller-owned
        buffers and explicit initialization. No devicetree node is needed.

config SKYWALKER_LIB_MOTOR_CONTROL
    bool "C++ velocity and position motor control"
    depends on CPP && SKYWALKER_DRIVER_MOTOR
    depends on SKYWALKER_MOTOR_DJI || SKYWALKER_MOTOR_DM
    select SKYWALKER_LIB_CONTROL
    help
        Enable VelocityMotor/PositionMotor and the enabled motor-family
        backends. Includes feedback checks, timing and fault-stop handling.
        
config SKYWALKER_LIB_COMMUNICATION
    bool "Communication protocols"
    depends on CPP

config SKYWALKER_REMOTE_DR16
    bool "DR16 decoder and input service"
    default y
    depends on SKYWALKER_LIB_COMMUNICATION

config SKYWALKER_REFEREE
    bool "Versioned referee parser"
    default y
    depends on SKYWALKER_LIB_COMMUNICATION

config SKYWALKER_INTERBOARD
    bool "Interboard V1 codec, parser and session"
    default y
    depends on SKYWALKER_LIB_COMMUNICATION

config SKYWALKER_UART_TRANSPORT
    bool "Bounded asynchronous UART transport"
    depends on SKYWALKER_LIB_COMMUNICATION && SERIAL
    select UART_ASYNC_API

config SKYWALKER_INTERBOARD_ENDPOINT
    bool "Interboard endpoint with selectable transport"
    depends on SKYWALKER_INTERBOARD && ENTROPY_GENERATOR
    default y if SKYWALKER_UART_TRANSPORT

config SKYWALKER_INTERBOARD_RS485
    bool "Interboard two-wire RS485 polling transport"
    depends on SKYWALKER_INTERBOARD && SKYWALKER_UART_TRANSPORT && ENTROPY_GENERATOR
    select UART_USE_RUNTIME_CONFIGURE
    help
        Hardware-DE 8N1 UART, one coordinator and one responder. Uses a
        bounded request/reply envelope around the existing interboard frames.

config SKYWALKER_INTERBOARD_CAN
    bool "Interboard segmented classic CAN transport"
    depends on SKYWALKER_INTERBOARD && CAN && ENTROPY_GENERATOR
    help
        Dedicated CAN controller with two directional IDs, bounded packet
        reassembly and controller recovery. Do not share with a motor bus.

config SKYWALKER_REMOTE_RECEIVER
    bool "Threaded DR16 receiver"
    depends on SKYWALKER_REMOTE_DR16 && SKYWALKER_UART_TRANSPORT
    help
        Own an asynchronous UART receive task and publish coherent remote
        snapshots with reader-side expiry and transport diagnostics.

config SKYWALKER_REMOTE_RX_STACK_SIZE
    int "Remote receiver stack size"
    depends on SKYWALKER_REMOTE_RECEIVER
    default 3072
    range 1024 16384

config SKYWALKER_REMOTE_RX_PRIORITY
    int "Remote receiver thread priority"
    depends on SKYWALKER_REMOTE_RECEIVER
    default 6
    range 0 15

config SKYWALKER_LIB_ROBOTICS
    bool "Robot decision and subsystem algorithms"
    depends on CPP
    select SKYWALKER_LIB_CONTROL

config SKYWALKER_ROBOTICS_COMMAND
    bool "Manual mapper and command arbitration"
    default y
    depends on SKYWALKER_LIB_ROBOTICS

config SKYWALKER_COMMAND_SERVICE
    bool "Registered command sources and background arbitration"
    depends on SKYWALKER_ROBOTICS_COMMAND
    help
        Own a command worker and publish non-consuming snapshots.
        Register static-lifetime input and permission sources before start.

config SKYWALKER_COMMAND_STACK_SIZE
    int "Command service stack bytes"
    depends on SKYWALKER_COMMAND_SERVICE
    default 6144
    range 2048 16384

config SKYWALKER_COMMAND_PRIORITY
    int "Command service priority"
    depends on SKYWALKER_COMMAND_SERVICE
    default 5
    range 0 15

config SKYWALKER_COMMAND_PERIOD_MS
    int "Command arbitration period in milliseconds"
    depends on SKYWALKER_COMMAND_SERVICE
    default 10
    range 1 1000

config SKYWALKER_ROBOTICS_SWERVE
    bool "Four module swerve controller and bench power limiter"
    default y
    depends on SKYWALKER_LIB_ROBOTICS

config SKYWALKER_ROBOTICS_GIMBAL
    bool "Recoverable yaw gimbal"
    depends on SKYWALKER_LIB_ROBOTICS && SKYWALKER_LIB_MOTOR_CONTROL

config SKYWALKER_ATTITUDE_EKF
    bool "Instance-owned quaternion attitude EKF"
    depends on CPP
    select SKYWALKER_LIB_CONTROL

config SKYWALKER_VISION
    bool "Independent vision link"
    depends on SKYWALKER_LIB_COMMUNICATION

config SKYWALKER_VISION_AB
    bool "RM2026 AutoAim AB protocol"
    depends on SKYWALKER_VISION

config SKYWALKER_VISION_RECEIVER
    bool "Threaded vision UART receiver"
    depends on SKYWALKER_VISION && SKYWALKER_UART_TRANSPORT

config SKYWALKER_VISION_RX_STACK_SIZE
    int "Vision receiver stack bytes"
    depends on SKYWALKER_VISION_RECEIVER
    default 4096
    range 2048 16384

config SKYWALKER_VISION_RX_PRIORITY
    int "Vision receiver thread priority"
    depends on SKYWALKER_VISION_RECEIVER
    default 6
    range 0 15

endmenu
```

## tests/algorithms/testcase.yaml
```yaml
tests:
  skywalker.algorithms.unit:
    platform_allow: [native_sim/native/64]
    tags: [algorithms, control, ekf, kalman, matrix, robotics, benchmark]
    timeout: 120
```

## tests/command_manager/testcase.yaml
```yaml
tests:
  skywalker.command_manager.algorithms:
    platform_allow: [native_sim/native/64]
    tags: [robotics, command, algorithms, benchmark]
    harness: ztest
```

## tests/command_service/testcase.yaml
```yaml
tests:
  skywalker.command_service.lifecycle:
    platform_allow: [native_sim/native/64]
    tags: [robotics, command, service, threading]
    harness: ztest
```

## tests/core_contracts/testcase.yaml
```yaml
tests:
  skywalker.core.contracts:
    platform_allow: [native_sim/native/64]
    tags: [core, codec, time, contracts]
    timeout: 60
```
